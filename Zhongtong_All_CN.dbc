VERSION ""

NS_ :

BS_:

BU_: Vector__XXX

BA_DEF_ "BusType" STRING ;
BA_DEF_ BO_ "VFrameFormat" ENUM "StandardCAN","ExtendedCAN","reserved","J1939PG";
BA_DEF_DEF_ "BusType" "CAN";
BA_DEF_DEF_ "VFrameFormat" 0;

BO_ 0 ZT_00000000: 8 Vector__XXX
 SG_ 转向泵输出过载 : 62|1@1+ (1,0) [0|1] "" Vector__XXX
 SG_ 转向泵输出缺相 : 63|1@1+ (1,0) [0|1] "" Vector__XXX

CM_ BO_ 0 "转向泵输出缺相 / 转向泵输出过载 | 信号数 2";
CM_ SG_ 0 转向泵输出过载 "转向泵输出过载 [枚举: 正常|故障]";
VAL_ 0 转向泵输出过载 0 "正常" 1 "故障";
CM_ SG_ 0 转向泵输出缺相 "转向泵输出缺相 [枚举: 正常|故障]";
VAL_ 0 转向泵输出缺相 0 "正常" 1 "故障";

BO_ 2164197927 ZT_00FF0A27: 8 Vector__XXX
 SG_ 动力电池COC : 24|1@1+ (0.5,0) [0|100] "%" Vector__XXX
 SG_ 整车驱动功率 : 0|8@1+ (4,-500) [-500|500] "KW" Vector__XXX
 SG_ 绝缘电阻 : 8|8@1+ (1,0) [0|1250] "kΩ" Vector__XXX
 SG_ 动力电池功率 : 16|8@1+ (4,-500) [-500|500] "KW" Vector__XXX

BA_ "VFrameFormat" BO_ 2164197927 1;
CM_ BO_ 2164197927 "动力电池COC / 动力电池功率 | 信号数 4";
CM_ SG_ 2164197927 动力电池COC "动力电池COC";
CM_ SG_ 2164197927 整车驱动功率 "整车驱动功率";
CM_ SG_ 2164197927 绝缘电阻 "绝缘电阻";
CM_ SG_ 2164197927 动力电池功率 "动力电池功率";

BO_ 2164198183 ZT_00FF0B27: 8 Vector__XXX
 SG_ 外界环境温度 : 8|8@1+ (1,-40) [-40|210] "℃" Vector__XXX
 SG_ 车速 : 16|8@1+ (1,0) [0|255] "kmh" Vector__XXX
 SG_ 燃料电池发动机运行命令 : 24|8@1+ (1,0) [0|6] "" Vector__XXX
 SG_ 燃料电池发动机入口温度设定值 : 48|8@1+ (0.1,60) [60|80] "℃" Vector__XXX
 SG_ 故障互锁复位 : 56|8@1+ (1,0) [0|255] "" Vector__XXX

BA_ "VFrameFormat" BO_ 2164198183 1;
CM_ BO_ 2164198183 "外界环境温度 / 故障互锁复位 | 信号数 5";
CM_ SG_ 2164198183 外界环境温度 "外界环境温度";
CM_ SG_ 2164198183 车速 "车速";
CM_ SG_ 2164198183 燃料电池发动机运行命令 "燃料电池发动机运行命令 [原始公式: if(((BYTE[3]>>0)&3)==1) 0; else 1] [枚举: 开启|预留]";
CM_ SG_ 2164198183 燃料电池发动机入口温度设定值 "燃料电池发动机入口温度设定值";
CM_ SG_ 2164198183 故障互锁复位 "故障互锁复位 [原始公式: if((BYTE[7])==1) 0; else 1] [枚举: 开启|预留]";

BO_ 2264865011 ZT_UNKNOWN_06FF18F3: 8 Vector__XXX
 SG_ 字节0 : 0|8@1+ (1,0) [0|255] "" Vector__XXX
 SG_ 字节1 : 8|8@1+ (1,0) [0|255] "" Vector__XXX
 SG_ 字节2 : 16|8@1+ (1,0) [0|255] "" Vector__XXX
 SG_ 字节3 : 24|8@1+ (1,0) [0|255] "" Vector__XXX
 SG_ 字节4 : 32|8@1+ (1,0) [0|255] "" Vector__XXX
 SG_ 字节5 : 40|8@1+ (1,0) [0|255] "" Vector__XXX
 SG_ 字节6 : 48|8@1+ (1,0) [0|255] "" Vector__XXX
 SG_ 字节7 : 56|8@1+ (1,0) [0|255] "" Vector__XXX

BA_ "VFrameFormat" BO_ 2264865011 1;
CM_ BO_ 2264865011 "BMS 电池管理系统 | 无信号定义, 按原始字节输出";
CM_ SG_ 2264865011 字节0 "字节0（原始值，无信号定义）";
CM_ SG_ 2264865011 字节1 "字节1（原始值，无信号定义）";
CM_ SG_ 2264865011 字节2 "字节2（原始值，无信号定义）";
CM_ SG_ 2264865011 字节3 "字节3（原始值，无信号定义）";
CM_ SG_ 2264865011 字节4 "字节4（原始值，无信号定义）";
CM_ SG_ 2264865011 字节5 "字节5（原始值，无信号定义）";
CM_ SG_ 2264865011 字节6 "字节6（原始值，无信号定义）";
CM_ SG_ 2264865011 字节7 "字节7（原始值，无信号定义）";

BO_ 2348916432 ZT_0C019ED0: 8 Vector__XXX
 SG_ 辅助回路控制-DC/DC(直流转化) : 8|1@1+ (1,0) [0|0] "" Vector__XXX
 SG_ 辅助回路控制-油泵 : 9|1@1+ (1,0) [0|0] "" Vector__XXX
 SG_ 辅助回路控制-气泵 : 10|1@1+ (1,0) [0|0] "" Vector__XXX
 SG_ 辅助回路控制-空调 : 11|1@1+ (1,0) [0|0] "" Vector__XXX
 SG_ 辅助回路控制-PTC : 12|1@1+ (1,0) [0|0] "" Vector__XXX
 SG_ 辅助回路控制-除霜 : 13|1@1+ (1,0) [0|0] "" Vector__XXX
 SG_ 辅助回路控制 : 15|1@1+ (1,0) [0|0] "" Vector__XXX
 SG_ 低压下电通知 : 24|1@1+ (1,0) [0|0] "" Vector__XXX
 SG_ 上下电指令 : 0|8@1+ (1,0) [0|0] "" Vector__XXX
 SG_ 急停信号 : 16|8@1+ (1,0) [0|0] "" Vector__XXX
 SG_ 车速 : 32|8@1+ (1,0) [0|0] "km/h" Vector__XXX
 SG_ 整车life(生命值) : 56|8@1+ (1,0) [0|0] "" Vector__XXX

BA_ "VFrameFormat" BO_ 2348916432 1;
CM_ BO_ 2348916432 "上下电指令 / 低压下电通知 | 信号数 12";
CM_ SG_ 2348916432 辅助回路控制-DC/DC(直流转化) "辅助回路控制-DC/DC(直流转化) [枚举: 上电|下电]";
VAL_ 2348916432 辅助回路控制-DC/DC(直流转化) 0 "下电" 1 "上电";
CM_ SG_ 2348916432 辅助回路控制-油泵 "辅助回路控制-油泵 [枚举: 上电|下电]";
VAL_ 2348916432 辅助回路控制-油泵 0 "下电" 1 "上电";
CM_ SG_ 2348916432 辅助回路控制-气泵 "辅助回路控制-气泵 [枚举: 上电|下电]";
VAL_ 2348916432 辅助回路控制-气泵 0 "下电" 1 "上电";
CM_ SG_ 2348916432 辅助回路控制-空调 "辅助回路控制-空调 [枚举: 上电|下电]";
VAL_ 2348916432 辅助回路控制-空调 0 "下电" 1 "上电";
CM_ SG_ 2348916432 辅助回路控制-PTC "辅助回路控制-PTC [枚举: 上电|下电]";
VAL_ 2348916432 辅助回路控制-PTC 0 "下电" 1 "上电";
CM_ SG_ 2348916432 辅助回路控制-除霜 "辅助回路控制-除霜 [枚举: 上电|下电]";
VAL_ 2348916432 辅助回路控制-除霜 0 "下电" 1 "上电";
CM_ SG_ 2348916432 辅助回路控制 "辅助回路控制 [枚举: 使能|不使能]";
VAL_ 2348916432 辅助回路控制 0 "不使能" 1 "使能";
CM_ SG_ 2348916432 低压下电通知 "低压下电通知 [枚举: 上电|下电]";
VAL_ 2348916432 低压下电通知 0 "下电" 1 "上电";
CM_ SG_ 2348916432 上下电指令 "上下电指令 [枚举: 下高压（断开主放电回路）|上高压|VCU(整车控制器) 不控制上高压,BMS(电池管理系统) 自行上高压|无效数据]";
VAL_ 2348916432 上下电指令 85 "下高压（断开主放电回路）" 170 "上高压" 255 "VCU(整车控制器) 不控制上高压,BMS(电池管理系统) 自行上高压";
CM_ SG_ 2348916432 急停信号 "急停信号 [枚举: 急停，断开全部放电回路（接收到此信号时，按照急停策略执行控制，如先断主放电回路，延时 10s 断开油泵，气泵等辅助放电回路）|默认|无效数据]";
VAL_ 2348916432 急停信号 170 "急停，断开全部放电回路（接收到此信号时，按照急停策略执行控制，如先断主放电回路，延时 10s 断开油泵，气泵等辅助放电回路）" 255 "默认";
CM_ SG_ 2348916432 车速 "车速";
CM_ SG_ 2348916432 整车life(生命值) "整车life(生命值)";

BO_ 2349500655 ZT_0C0A88EF: 8 Vector__XXX
 SG_ 油泵电机高温停机信号 : 33|1@1+ (1,0) [0|0] "" Vector__XXX
 SG_ 油泵控制器控制指令 : 0|8@1+ (1,0) [0|0] "" Vector__XXX
 SG_ 气泵控制器控制指令 : 8|8@1+ (1,0) [0|0] "" Vector__XXX
 SG_ DC-DC 控制指令 : 16|8@1+ (1,0) [0|0] "" Vector__XXX
 SG_ 升压DC-DC控制指令 : 24|8@1+ (1,0) [0|0] "" Vector__XXX
 SG_ 6KW DC-DC 控制指令 : 40|8@1+ (1,0) [0|255] "" Vector__XXX

BA_ "VFrameFormat" BO_ 2349500655 1;
CM_ BO_ 2349500655 "3KW DC-DC 控制指令 / 6KW DC-DC 控制指令 | 信号数 8";
CM_ SG_ 2349500655 油泵电机高温停机信号 "油泵电机高温停机信号 [枚举: 正常状态|信号已激活]";
VAL_ 2349500655 油泵电机高温停机信号 0 "正常状态" 1 "信号已激活";
CM_ SG_ 2349500655 油泵控制器控制指令 "油泵控制器控制指令 [原始公式: if((BYTE[0])==85) 0; else if((BYTE[0])==170) 1; else 2] [枚举: 关机|开机|预留]";
CM_ SG_ 2349500655 气泵控制器控制指令 "气泵控制器控制指令 [原始公式: if((BYTE[1])==85) 0; else if((BYTE[1])==170) 1; else 2] [枚举: 关机|开机|预留]";
CM_ SG_ 2349500655 DC-DC 控制指令 "DC-DC 控制指令 [原始公式: if((BYTE[2])==85) 0; else if((BYTE[2])==170) 1; else 2] [枚举: 关机|开机|预留]";
CM_ SG_ 2349500655 升压DC-DC控制指令 "升压DC-DC控制指令 [原始公式: if((BYTE[3])==85) 0; else if((BYTE[3])==170) 1; else 2] [枚举: 关机|开机|预留]";
CM_ SG_ 2349500655 6KW DC-DC 控制指令 "6KW DC-DC 控制指令 [原始公式: if((BYTE[5])==85) 0; else if((BYTE[5])==170) 1; else 2] [枚举: 关机|开机|预留]";

BO_ 2352780956 ZT_0C3C969C: 8 Vector__XXX
 SG_ 整车状态 : 56|8@1+ (1,0) [0|255] "" Vector__XXX
 SG_ 驱动系统可用剩余功率 : 8|8@1+ (1,0) [0|255] "KW" Vector__XXX
 SG_ 瞬时功率百分比 : 16|8@1+ (1,-100) [-100|100] "%" Vector__XXX
 SG_ 驱动系统瞬时功率 : 0|8@1+ (1,0) [0|255] "KW" Vector__XXX
 SG_ 整车系统代码 : 40|16@1+ (1,0) [0|65535] "" Vector__XXX

BA_ "VFrameFormat" BO_ 2352780956 1;
CM_ BO_ 2352780956 "整车状态 / 整车系统代码 | 信号数 5";
CM_ SG_ 2352780956 整车状态 "整车状态 [枚举: 未上电|预充|主接触器闭合|正常工作|系统故障]";
VAL_ 2352780956 整车状态 0 "未上电" 1 "预充" 2 "主接触器闭合" 3 "正常工作" 4 "系统故障";
CM_ SG_ 2352780956 驱动系统可用剩余功率 "驱动系统可用剩余功率";
CM_ SG_ 2352780956 瞬时功率百分比 "瞬时功率百分比";
CM_ SG_ 2352780956 驱动系统瞬时功率 "驱动系统瞬时功率";
CM_ SG_ 2352780956 整车系统代码 "整车系统代码";

BO_ 2352782486 ZT_0C3C9C96: 8 Vector__XXX
 SG_ 手刹 : 8|1@1+ (1,0) [0|1] "" Vector__XXX
 SG_ 刹车 : 9|1@1+ (1,0) [0|1] "" Vector__XXX
 SG_ 后舱门 : 24|1@1+ (1,0) [0|1] "" Vector__XXX
 SG_ 后门 : 25|1@1+ (1,0) [0|1] "" Vector__XXX
 SG_ 中门 : 26|1@1+ (1,0) [0|1] "" Vector__XXX
 SG_ 前门 : 27|1@1+ (1,0) [0|1] "" Vector__XXX
 SG_ 气源1 : 0|8@1+ (0.01,0) [0|20] "Mpa" Vector__XXX
 SG_ 气源2 : 16|8@1+ (0.01,0) [0|20] "Mpa" Vector__XXX
 SG_ 气泵DCAC使能 : 48|8@1+ (1,0) [0|255] "" Vector__XXX

BA_ "VFrameFormat" BO_ 2352782486 1;
CM_ BO_ 2352782486 "中门 / 刹车 | 信号数 9";
CM_ SG_ 2352782486 手刹 "手刹 [枚举: 无效|有效]";
VAL_ 2352782486 手刹 0 "无效" 1 "有效";
CM_ SG_ 2352782486 刹车 "刹车 [枚举: 无效|有效]";
VAL_ 2352782486 刹车 0 "无效" 1 "有效";
CM_ SG_ 2352782486 后舱门 "后舱门 [枚举: 门关|门开]";
VAL_ 2352782486 后舱门 0 "门关" 1 "门开";
CM_ SG_ 2352782486 后门 "后门 [枚举: 门关|门开]";
VAL_ 2352782486 后门 0 "门关" 1 "门开";
CM_ SG_ 2352782486 中门 "中门 [枚举: 门关|门开]";
VAL_ 2352782486 中门 0 "门关" 1 "门开";
CM_ SG_ 2352782486 前门 "前门 [枚举: 门关|门开]";
VAL_ 2352782486 前门 0 "门关" 1 "门开";
CM_ SG_ 2352782486 气源1 "气源1";
CM_ SG_ 2352782486 气源2 "气源2";
CM_ SG_ 2352782486 气泵DCAC使能 "气泵DCAC使能 [原始公式: if((BYTE[6])==85) 0; else if((BYTE[6])==170) 1; else 2] [枚举: 启动|停机|预留]";

BO_ 2352846492 ZT_0C3D969C: 8 Vector__XXX
 SG_ 有无制动力 : 36|1@1+ (1,0) [0|1] "" Vector__XXX
 SG_ 有无驱动力 : 37|1@1+ (1,0) [0|1] "" Vector__XXX
 SG_ 风扇状态 : 38|1@1+ (1,0) [0|1] "" Vector__XXX
 SG_ 水泵状态 : 39|1@1+ (1,0) [0|1] "" Vector__XXX
 SG_ 绝缘检测仪故障标记 : 56|1@1+ (1,0) [0|1] "" Vector__XXX
 SG_ 辅助电源故障标记 : 57|1@1+ (1,0) [0|1] "" Vector__XXX
 SG_ 主接粘连故障标志 : 58|1@1+ (1,0) [0|1] "" Vector__XXX
 SG_ 电机故障标志 : 59|1@1+ (1,0) [0|1] "" Vector__XXX
 SG_ BMS故障标志 : 60|1@1+ (1,0) [0|1] "" Vector__XXX
 SG_ 限功标志 : 61|1@1+ (1,0) [0|1] "" Vector__XXX
 SG_ 助力泵故障标志 : 62|1@1+ (1,0) [0|1] "" Vector__XXX
 SG_ 车辆可行驶状态驾驶位是否有人 : 63|1@1+ (1,0) [0|1] "" Vector__XXX
 SG_ 制动踏板开度 : 0|8@1+ (0.4,0) [0|100] "%" Vector__XXX
 SG_ 加速踏板开度 : 8|8@1+ (0.4,0) [0|100] "%" Vector__XXX
 SG_ 车速 : 16|16@1+ (0.00390625,0) [0|250] "KM/h" Vector__XXX
 SG_ 电机制动电流 : 40|16@1+ (0.1,-1000) [-1000|500] "A" Vector__XXX

BA_ "VFrameFormat" BO_ 2352846492 1;
CM_ BO_ 2352846492 "BMS故障标志 / 主接粘连故障标志 | 信号数 17";
CM_ SG_ 2352846492 有无制动力 "有无制动力 [枚举: 无制动力|有制动力]";
VAL_ 2352846492 有无制动力 0 "无制动力" 1 "有制动力";
CM_ SG_ 2352846492 有无驱动力 "有无驱动力 [枚举: 无驱动力|有驱动力]";
VAL_ 2352846492 有无驱动力 0 "无驱动力" 1 "有驱动力";
CM_ SG_ 2352846492 风扇状态 "风扇状态 [枚举: 未工作|工作]";
VAL_ 2352846492 风扇状态 0 "未工作" 1 "工作";
CM_ SG_ 2352846492 水泵状态 "水泵状态 [枚举: 未工作|工作]";
VAL_ 2352846492 水泵状态 0 "未工作" 1 "工作";
CM_ SG_ 2352846492 绝缘检测仪故障标记 "绝缘检测仪故障标记 [枚举: 无故障|有故障]";
VAL_ 2352846492 绝缘检测仪故障标记 0 "无故障" 1 "有故障";
CM_ SG_ 2352846492 辅助电源故障标记 "辅助电源故障标记 [枚举: 无故障|有故障]";
VAL_ 2352846492 辅助电源故障标记 0 "无故障" 1 "有故障";
CM_ SG_ 2352846492 主接粘连故障标志 "主接粘连故障标志 [枚举: 无故障|有故障]";
VAL_ 2352846492 主接粘连故障标志 0 "无故障" 1 "有故障";
CM_ SG_ 2352846492 电机故障标志 "电机故障标志 [枚举: 无故障|有故障]";
VAL_ 2352846492 电机故障标志 0 "无故障" 1 "有故障";
CM_ SG_ 2352846492 BMS故障标志 "BMS故障标志 [枚举: 无故障|有故障]";
VAL_ 2352846492 BMS故障标志 0 "无故障" 1 "有故障";
CM_ SG_ 2352846492 限功标志 "限功标志 [枚举: 无限功|有限功]";
VAL_ 2352846492 限功标志 0 "无限功" 1 "有限功";
CM_ SG_ 2352846492 助力泵故障标志 "助力泵故障标志 [枚举: 无故障|有故障]";
VAL_ 2352846492 助力泵故障标志 0 "无故障" 1 "有故障";
CM_ SG_ 2352846492 车辆可行驶状态驾驶位是否有人 "车辆可行驶状态驾驶位是否有人 [枚举: 无|有]";
VAL_ 2352846492 车辆可行驶状态驾驶位是否有人 0 "无" 1 "有";
CM_ SG_ 2352846492 制动踏板开度 "制动踏板开度";
CM_ SG_ 2352846492 加速踏板开度 "加速踏板开度";
CM_ SG_ 2352846492 车速 "车速";
CM_ SG_ 2352846492 电机制动电流 "电机制动电流";

BO_ 2352848022 ZT_0C3D9C96: 8 Vector__XXX
 SG_ 车速 : 48|16@1+ (0.00390625,0) [0|250] "KM/H" Vector__XXX
 SG_ 总行驶里程 : 0|32@1+ (0.125,0) [0|500000000] "Km" Vector__XXX

BA_ "VFrameFormat" BO_ 2352848022 1;
CM_ BO_ 2352848022 "总行驶里程 / 车速 | 信号数 2";
CM_ SG_ 2352848022 车速 "车速";
CM_ SG_ 2352848022 总行驶里程 "总行驶里程";

BO_ 2352912028 ZT_0C3E969C: 8 Vector__XXX
 SG_ 驱动电机个数-1 : 0|4@1+ (1,0) [0|15] "" Vector__XXX
 SG_ 驱动电机序号-1 : 4|4@1+ (1,0) [0|15] "" Vector__XXX
 SG_ 驱动电机状态 : 8|8@1+ (1,0) [0|255] "" Vector__XXX
 SG_ 电机控制器温度 : 16|8@1+ (1,-40) [-40|215] "℃" Vector__XXX
 SG_ 驱动电机温度 : 24|8@1+ (1,-40) [-40|215] "℃" Vector__XXX
 SG_ 电机控制器母线电压-1 : 32|16@1+ (0.1,0) [0|1000] "V" Vector__XXX
 SG_ 电机控制器母线电流-1 : 48|16@1+ (0.1,-1000) [-1000|1000] "A" Vector__XXX

BA_ "VFrameFormat" BO_ 2352912028 1;
CM_ BO_ 2352912028 "电机控制器母线电压-1 / 电机控制器母线电流-1 | 信号数 7";
CM_ SG_ 2352912028 驱动电机个数-1 "驱动电机个数-1";
CM_ SG_ 2352912028 驱动电机序号-1 "驱动电机序号-1";
CM_ SG_ 2352912028 驱动电机状态 "驱动电机状态 [原始公式: if((BYTE[1])==1) 0; else if((BYTE[1])==2) 1; else if((BYTE[1])==3) 2; else if((BYTE[1])==4) 3; else if((BYTE[1])==254) 4; else 5] [枚举: 耗电|发电|关闭|准备|异常|预留]";
CM_ SG_ 2352912028 电机控制器温度 "电机控制器温度";
CM_ SG_ 2352912028 驱动电机温度 "驱动电机温度";
CM_ SG_ 2352912028 电机控制器母线电压-1 "电机控制器母线电压-1";
CM_ SG_ 2352912028 电机控制器母线电流-1 "电机控制器母线电流-1";

BO_ 2352977564 ZT_0C3F969C: 8 Vector__XXX
 SG_ 电机控制器系统状态 : 40|8@1+ (1,0) [0|3] "" Vector__XXX
 SG_ 驱动电机个数-2 : 0|4@1+ (1,0) [0|15] "" Vector__XXX
 SG_ 驱动电机序号-2 : 4|4@1+ (1,0) [0|15] "" Vector__XXX
 SG_ 电机控制器故障代码 : 48|8@1+ (1,0) [0|255] "" Vector__XXX
 SG_ 电机控制器断高压请求 : 56|8@1+ (1,0) [0|255] "" Vector__XXX
 SG_ 电机转速 : 8|16@1+ (0.5,0) [0|15000] "rmp" Vector__XXX
 SG_ 电机扭矩 : 24|16@1+ (1,-32000) [-32000|32000] "Nm" Vector__XXX

BA_ "VFrameFormat" BO_ 2352977564 1;
CM_ BO_ 2352977564 "电机扭矩 / 电机控制器故障代码 | 信号数 7";
CM_ SG_ 2352977564 电机控制器系统状态 "电机控制器系统状态 [枚举: 停止|运行|报警|故障]";
VAL_ 2352977564 电机控制器系统状态 0 "停止" 1 "运行" 2 "报警" 3 "故障";
CM_ SG_ 2352977564 驱动电机个数-2 "驱动电机个数-2";
CM_ SG_ 2352977564 驱动电机序号-2 "驱动电机序号-2";
CM_ SG_ 2352977564 电机控制器故障代码 "电机控制器故障代码";
CM_ SG_ 2352977564 电机控制器断高压请求 "电机控制器断高压请求 [原始公式: if((BYTE[7])==55) 0; else if((BYTE[7])==170) 1; else 2] [枚举: 无请求|有请求|预留]";
CM_ SG_ 2352977564 电机转速 "电机转速";
CM_ SG_ 2352977564 电机扭矩 "电机扭矩";

BO_ 2353043100 ZT_0C40969C: 8 Vector__XXX
 SG_ 制动力状态 : 24|8@1+ (1,0) [0|255] "" Vector__XXX
 SG_ 驱动力状态 : 32|8@1+ (1,0) [0|255] "" Vector__XXX
 SG_ VCU上报给远程监控的三个故障等级 : 40|8@1+ (1,0) [0|255] "" Vector__XXX
 SG_ 转向助力泵使能 : 48|8@1+ (1,0) [0|255] "" Vector__XXX
 SG_ 车辆状态 : 0|8@1+ (1,0) [0|255] "" Vector__XXX
 SG_ 运行模式 : 8|8@1+ (1,0) [0|255] "" Vector__XXX
 SG_ DC/DC状态 : 16|8@1+ (1,0) [0|255] "" Vector__XXX
 SG_ DC/DC状态（外挂DCDC,无此配置则发送0x00） : 56|8@1+ (1,0) [0|255] "" Vector__XXX

BA_ "VFrameFormat" BO_ 2353043100 1;
CM_ BO_ 2353043100 "DC/DC状态 / DC/DC状态（外挂DCDC,无此配置则发送0x00） | 信号数 8";
CM_ SG_ 2353043100 制动力状态 "制动力状态 [枚举: 无制动力|有制动力]";
VAL_ 2353043100 制动力状态 0 "无制动力" 1 "有制动力";
CM_ SG_ 2353043100 驱动力状态 "驱动力状态 [枚举: 无驱动力|有驱动力]";
VAL_ 2353043100 驱动力状态 0 "无驱动力" 1 "有驱动力";
CM_ SG_ 2353043100 VCU上报给远程监控的三个故障等级 "VCU上报给远程监控的三个故障等级 [枚举: 无故障|一级故障|二级故障|三级故障]";
VAL_ 2353043100 VCU上报给远程监控的三个故障等级 0 "无故障" 1 "一级故障" 2 "二级故障" 3 "三级故障";
CM_ SG_ 2353043100 转向助力泵使能 "转向助力泵使能 [枚举: 未工作|工作]";
VAL_ 2353043100 转向助力泵使能 0 "未工作" 1 "工作";
CM_ SG_ 2353043100 车辆状态 "车辆状态 [原始公式: if((BYTE[0])==1) 0; else if((BYTE[0])==2) 1; else if((BYTE[0])==3) 2; else if((BYTE[0])==254) 3; else if((BYTE[0])==255) 4; else 5] [枚举: 启动状态|熄火|其他状态|异常状态|无效|预留]";
CM_ SG_ 2353043100 运行模式 "运行模式 [原始公式: if((BYTE[1])==1) 0; else if((BYTE[1])==2) 1; else if((BYTE[1])==3) 2; else if((BYTE[1])==254) 3; else if((BYTE[1])==255) 4; else 5] [枚举: 纯电|混动|燃油|异常状态|无效|预留]";
CM_ SG_ 2353043100 DC/DC状态 "DC/DC状态 [原始公式: if((BYTE[2])==1) 0; else if((BYTE[2])==2) 1; else if((BYTE[2])==254) 2; else if((BYTE[2])==255) 3; else 4] [枚举: 工作|断开|异常状态|无效|预留]";
CM_ SG_ 2353043100 DC/DC状态（外挂DCDC,无此配置则发送0x00） "DC/DC状态（外挂DCDC,无此配置则发送0x00） [原始公式: if((BYTE[7])==1) 0; else if((BYTE[7])==2) 1; else if((BYTE[7])==254) 2; else if((BYTE[7])==255) 3; else 4] [枚举: 工作|断开|异常状态|无效|预留]";

BO_ 2353110166 ZT_0C419C96: 8 Vector__XXX
 SG_ DCDC温度报警 : 16|1@1+ (1,0) [0|1] "" Vector__XXX
 SG_ 制动系统报警 : 17|1@1+ (1,0) [0|1] "" Vector__XXX
 SG_ DCDC状态报警 : 18|1@1+ (1,0) [0|1] "" Vector__XXX
 SG_ 驱动电机控制器温度报警 : 19|1@1+ (1,0) [0|1] "" Vector__XXX
 SG_ 高压互锁状态报警 : 20|1@1+ (1,0) [0|1] "" Vector__XXX
 SG_ 驱动电机温度报警 : 21|1@1+ (1,0) [0|1] "" Vector__XXX
 SG_ 发动机高温报警 : 22|1@1+ (1,0) [0|1] "" Vector__XXX
 SG_ DCDC温度报警等级-1 : 24|2@1+ (1,0) [0|3] "" Vector__XXX
 SG_ DCDC温度报警等级-2 : 26|2@1+ (1,0) [0|3] "" Vector__XXX
 SG_ 驱动电机控制器温度报警等级 : 28|2@1+ (1,0) [0|3] "" Vector__XXX
 SG_ 驱动电机温度报警等级 : 30|2@1+ (1,0) [0|3] "" Vector__XXX
 SG_ 整车最高故障等级 : 0|4@1+ (1,0) [0|15] "" Vector__XXX
 SG_ 驱动电机故障总数 : 4|4@1+ (1,0) [0|15] "" Vector__XXX
 SG_ 发动机故障总数 : 8|4@1+ (1,0) [0|15] "" Vector__XXX
 SG_ 其它故障总数 : 12|4@1+ (1,0) [0|15] "" Vector__XXX

BA_ "VFrameFormat" BO_ 2353110166 1;
CM_ BO_ 2353110166 "DCDC温度报警 / DCDC温度报警等级-1 | 信号数 15";
CM_ SG_ 2353110166 DCDC温度报警 "DCDC温度报警";
CM_ SG_ 2353110166 制动系统报警 "制动系统报警";
CM_ SG_ 2353110166 DCDC状态报警 "DCDC状态报警";
CM_ SG_ 2353110166 驱动电机控制器温度报警 "驱动电机控制器温度报警";
CM_ SG_ 2353110166 高压互锁状态报警 "高压互锁状态报警";
CM_ SG_ 2353110166 驱动电机温度报警 "驱动电机温度报警";
CM_ SG_ 2353110166 发动机高温报警 "发动机高温报警";
CM_ SG_ 2353110166 DCDC温度报警等级-1 "DCDC温度报警等级-1";
CM_ SG_ 2353110166 DCDC温度报警等级-2 "DCDC温度报警等级-2";
CM_ SG_ 2353110166 驱动电机控制器温度报警等级 "驱动电机控制器温度报警等级";
CM_ SG_ 2353110166 驱动电机温度报警等级 "驱动电机温度报警等级";
CM_ SG_ 2353110166 整车最高故障等级 "整车最高故障等级";
CM_ SG_ 2353110166 驱动电机故障总数 "驱动电机故障总数";
CM_ SG_ 2353110166 发动机故障总数 "发动机故障总数";
CM_ SG_ 2353110166 其它故障总数 "其它故障总数";

BO_ 2353174172 ZT_0C42969C: 8 Vector__XXX
 SG_ 车辆能源控制模式 : 32|8@1+ (1,0) [0|255] "" Vector__XXX
 SG_ 续航里程 : 0|16@1+ (1,0) [0|65535] "km" Vector__XXX

BA_ "VFrameFormat" BO_ 2353174172 1;
CM_ BO_ 2353174172 "续航里程 / 车辆能源控制模式 | 信号数 2";
CM_ SG_ 2353174172 车辆能源控制模式 "车辆能源控制模式 [原始公式: if((((BYTE[4]+BYTE[5]*256)>>1)&255)==0) 0; else if((((BYTE[4]+BYTE[5]*256)>>1)&255)==1) 1; else if((((BYTE[4]+BYTE[5]*256)>>1)&255)==2) 2; else if((((BYTE[4]+BYTE[5]*256)>>1)&255)==4) 3; else if((((BYTE[4]+BYTE[5]*256)>>1)&255)==8) 4; else if((((BYTE[4]+BYTE[5]*256)>>1)&255)==16) 5; else if((((BYTE[4]+BYTE[5]*256)>>1)&255)==32) 6; else if((((BYTE[4]+BYTE[5]*256)>>1)&255)==64) 7; else if((((BYTE[4]+BYTE[5]*256)>>1)&255)==128) 8; else 9] [枚举: 默认|检测线模式|经济行车模式ECO|低速爬坡模式|空载超车模式S挡|高速运行模式|雪地模式|山地模式|驻坡模式|预留]";
CM_ SG_ 2353174172 续航里程 "续航里程";

BO_ 2354095260 ZT_0C50A49C: 8 Vector__XXX
 SG_ 真空泵状态 : 48|8@1+ (1,0) [0|255] "" Vector__XXX
 SG_ 油泵DCAC使能 : 8|8@1+ (1,0) [0|0] "" Vector__XXX
 SG_ 心跳信号-1 : 56|8@1+ (1,0) [0|255] "" Vector__XXX
 SG_ 油泵DCAC使能（高压） : 0|8@1+ (1,0) [0|255] "" Vector__XXX
 SG_ 气泵DCAC使能 : 16|8@1+ (1,0) [0|255] "" Vector__XXX
 SG_ DCDC使能 : 24|8@1+ (1,0) [0|255] "" Vector__XXX
 SG_ 外置DCDC使能 : 40|8@1+ (1,0) [0|255] "" Vector__XXX

BA_ "VFrameFormat" BO_ 2354095260 1;
CM_ BO_ 2354095260 "DCDC使能 / VCU_life信号 | 信号数 10";
CM_ SG_ 2354095260 真空泵状态 "真空泵状态 [枚举: 正常|故障|真空度报警]";
VAL_ 2354095260 真空泵状态 0 "正常" 1 "故障" 2 "真空度报警";
CM_ SG_ 2354095260 油泵DCAC使能 "油泵DCAC使能 [原始公式: if((BYTE[1])==85) 0; else if((BYTE[1])==102) 1; else 2] [枚举: 停机|启动|预留]";
CM_ SG_ 2354095260 心跳信号-1 "心跳信号-1";
CM_ SG_ 2354095260 油泵DCAC使能（高压） "油泵DCAC使能（高压） [原始公式: if((BYTE[0])==85) 0; else if((BYTE[0])==170) 1; else 2] [枚举: 启动|停机|预留]";
CM_ SG_ 2354095260 气泵DCAC使能 "气泵DCAC使能 [原始公式: if((BYTE[2])==85) 0; else if((BYTE[2])==170) 1; else 2] [枚举: 启动|停机|预留]";
CM_ SG_ 2354095260 DCDC使能 "DCDC使能 [原始公式: if((BYTE[3])==85) 0; else if((BYTE[3])==170) 1; else 2] [枚举: 启动|停机|预留]";
CM_ SG_ 2354095260 外置DCDC使能 "外置DCDC使能 [原始公式: if((BYTE[5])==85) 0; else if((BYTE[5])==170) 1; else 2] [枚举: 启动|停机|预留]";

BO_ 2355143836 ZT_0C60A49C: 8 Vector__XXX
 SG_ 油泵测试模式 : 0|2@1+ (1,0) [0|1] "" Vector__XXX

BA_ "VFrameFormat" BO_ 2355143836 1;
CM_ BO_ 2355143836 "油泵测试模式 | 信号数 1";
CM_ SG_ 2355143836 油泵测试模式 "油泵测试模式 [枚举: 测试无效|测试有效]";
VAL_ 2355143836 油泵测试模式 0 "测试无效" 1 "测试有效";

BO_ 2357304468 ZT_0C819C94: 8 Vector__XXX
 SG_ 高压电池继电器状态 : 24|1@1+ (1,0) [0|1] "" Vector__XXX
 SG_ 请求发动机启动标志 : 25|1@1+ (1,0) [0|1] "" Vector__XXX
 SG_ 禁止发动机停机标志 : 26|1@1+ (1,0) [0|1] "" Vector__XXX
 SG_ 请求发动机停机标志 : 27|1@1+ (1,0) [0|1] "" Vector__XXX
 SG_ 整车Ready状态 : 28|1@1+ (1,0) [0|1] "" Vector__XXX
 SG_ 外接充电激活标志 : 29|1@1+ (1,0) [0|1] "" Vector__XXX
 SG_ 车辆防盗认证标志 : 30|1@1+ (1,0) [0|1] "" Vector__XXX
 SG_ 整车碰撞信号 : 31|1@1+ (1,0) [0|1] "" Vector__XXX
 SG_ 请求暖风标志 : 34|1@1+ (1,0) [0|1] "" Vector__XXX
 SG_ 强制启动发动机标志 : 35|1@1+ (1,0) [0|1] "" Vector__XXX
 SG_ 机械附件请求标志 : 36|1@1+ (1,0) [0|1] "" Vector__XXX
 SG_ 靠边停车指令 : 37|1@1+ (1,0) [0|1] "" Vector__XXX
 SG_ 服务模式（高压电池放电） : 38|1@1+ (1,0) [0|1] "" Vector__XXX
 SG_ 恒压模式请求 : 39|1@1+ (1,0) [0|1] "" Vector__XXX
 SG_ 电转向泵激活标志 : 40|1@1+ (1,0) [0|1] "" Vector__XXX
 SG_ 电除霜激活标志 : 41|1@1+ (1,0) [0|1] "" Vector__XXX
 SG_ 电空调激活标志 : 42|1@1+ (1,0) [0|1] "" Vector__XXX
 SG_ 电打气泵激活标志 : 43|1@1+ (1,0) [0|1] "" Vector__XXX
 SG_ 手刹状态 : 44|1@1+ (1,0) [0|1] "" Vector__XXX
 SG_ GCU主动放电指令 : 45|1@1+ (1,0) [0|1] "" Vector__XXX
 SG_ 整车故障等级 : 16|8@1+ (1,0) [0|255] "" Vector__XXX
 SG_ 当前档位信息 : 48|8@1+ (1,0) [-125|130] "" Vector__XXX
 SG_ 整车需求增程器发电功率 : 0|16@1+ (1,-2000) [-2000|2000] "kW" Vector__XXX

BA_ "VFrameFormat" BO_ 2357304468 1;
CM_ BO_ 2357304468 "GCU主动放电指令 / 外接充电激活标志 | 信号数 24";
CM_ SG_ 2357304468 高压电池继电器状态 "高压电池继电器状态 [枚举: OFF|ON]";
VAL_ 2357304468 高压电池继电器状态 0 "OFF" 1 "ON";
CM_ SG_ 2357304468 请求发动机启动标志 "请求发动机启动标志 [枚举: OFF|ON]";
VAL_ 2357304468 请求发动机启动标志 0 "OFF" 1 "ON";
CM_ SG_ 2357304468 禁止发动机停机标志 "禁止发动机停机标志 [枚举: OFF|ON]";
VAL_ 2357304468 禁止发动机停机标志 0 "OFF" 1 "ON";
CM_ SG_ 2357304468 请求发动机停机标志 "请求发动机停机标志 [枚举: OFF|ON]";
VAL_ 2357304468 请求发动机停机标志 0 "OFF" 1 "ON";
CM_ SG_ 2357304468 整车Ready状态 "整车Ready状态 [枚举: No Ready|Ready]";
VAL_ 2357304468 整车Ready状态 0 "No Ready" 1 "Ready";
CM_ SG_ 2357304468 外接充电激活标志 "外接充电激活标志 [枚举: OFF|ON]";
VAL_ 2357304468 外接充电激活标志 0 "OFF" 1 "ON";
CM_ SG_ 2357304468 车辆防盗认证标志 "车辆防盗认证标志 [枚举: OFF|ON]";
VAL_ 2357304468 车辆防盗认证标志 0 "OFF" 1 "ON";
CM_ SG_ 2357304468 整车碰撞信号 "整车碰撞信号 [枚举: OFF|ON]";
VAL_ 2357304468 整车碰撞信号 0 "OFF" 1 "ON";
CM_ SG_ 2357304468 请求暖风标志 "请求暖风标志 [枚举: OFF|ON]";
VAL_ 2357304468 请求暖风标志 0 "OFF" 1 "ON";
CM_ SG_ 2357304468 强制启动发动机标志 "强制启动发动机标志 [枚举: OFF|ON]";
VAL_ 2357304468 强制启动发动机标志 0 "OFF" 1 "ON";
CM_ SG_ 2357304468 机械附件请求标志 "机械附件请求标志 [枚举: OFF|ON]";
VAL_ 2357304468 机械附件请求标志 0 "OFF" 1 "ON";
CM_ SG_ 2357304468 靠边停车指令 "靠边停车指令 [枚举: OFF|ON]";
VAL_ 2357304468 靠边停车指令 0 "OFF" 1 "ON";
CM_ SG_ 2357304468 服务模式（高压电池放电） "服务模式（高压电池放电） [枚举: OFF|ON]";
VAL_ 2357304468 服务模式（高压电池放电） 0 "OFF" 1 "ON";
CM_ SG_ 2357304468 恒压模式请求 "恒压模式请求 [枚举: 无指令|指令]";
VAL_ 2357304468 恒压模式请求 0 "无指令" 1 "指令";
CM_ SG_ 2357304468 电转向泵激活标志 "电转向泵激活标志 [枚举: OFF|ON]";
VAL_ 2357304468 电转向泵激活标志 0 "OFF" 1 "ON";
CM_ SG_ 2357304468 电除霜激活标志 "电除霜激活标志 [枚举: OFF|ON]";
VAL_ 2357304468 电除霜激活标志 0 "OFF" 1 "ON";
CM_ SG_ 2357304468 电空调激活标志 "电空调激活标志 [枚举: OFF|ON]";
VAL_ 2357304468 电空调激活标志 0 "OFF" 1 "ON";
CM_ SG_ 2357304468 电打气泵激活标志 "电打气泵激活标志 [枚举: OFF|ON]";
VAL_ 2357304468 电打气泵激活标志 0 "OFF" 1 "ON";
CM_ SG_ 2357304468 手刹状态 "手刹状态 [枚举: 手刹放下|手刹拉起]";
VAL_ 2357304468 手刹状态 0 "手刹放下" 1 "手刹拉起";
CM_ SG_ 2357304468 GCU主动放电指令 "GCU主动放电指令 [枚举: 无指令|指令]";
VAL_ 2357304468 GCU主动放电指令 0 "无指令" 1 "指令";
CM_ SG_ 2357304468 整车故障等级 "整车故障等级 [枚举: 无故障|RCU禁止激活|降功率|保留|保留|保留|保留|软件关闭|紧急关闭]";
VAL_ 2357304468 整车故障等级 0 "无故障" 1 "RCU禁止激活" 2 "降功率" 3 "保留" 4 "保留" 5 "保留" 6 "保留" 7 "软件关闭" 8 "紧急关闭";
CM_ SG_ 2357304468 当前档位信息 "当前档位信息 [原始公式: if((BYTE[6])==131) 0; else if((BYTE[6])==168) 1; else if((BYTE[6])==250) 2; else if((BYTE[6])==251) 3; else if((BYTE[6])==252) 4; else if((BYTE[6])==253) 5; else if((BYTE[6])==254) 6; else if((BYTE[6])==255) 7; else 8] [枚举: 预留|R档|D档|P档|预留|预留|预留|预留|预留]";
CM_ SG_ 2357304468 整车需求增程器发电功率 "整车需求增程器发电功率";

BO_ 2357370004 ZT_0C829C94: 8 Vector__XXX
 SG_ 高压电池SOC : 16|8@1+ (1,0) [0|100] "perc" Vector__XXX
 SG_ 高压电池平均温度 : 56|8@1+ (1,-40) [-40|210] "degC" Vector__XXX
 SG_ 高压电池实际电压 : 0|16@1+ (1,0) [0|2000] "V" Vector__XXX
 SG_ 高压电池最大放电电流 : 24|16@1+ (1,-5000) [-5000|1000] "A" Vector__XXX
 SG_ 高压电池最大充电电流 : 40|16@1+ (1,-5000) [-5000|1000] "A" Vector__XXX

BA_ "VFrameFormat" BO_ 2357370004 1;
CM_ BO_ 2357370004 "高压电池SOC / 高压电池实际电压 | 信号数 5";
CM_ SG_ 2357370004 高压电池SOC "高压电池SOC";
CM_ SG_ 2357370004 高压电池平均温度 "高压电池平均温度";
CM_ SG_ 2357370004 高压电池实际电压 "高压电池实际电压";
CM_ SG_ 2357370004 高压电池最大放电电流 "高压电池最大放电电流";
CM_ SG_ 2357370004 高压电池最大充电电流 "高压电池最大充电电流";

BO_ 2357435540 ZT_0C839C94: 8 Vector__XXX
 SG_ 整车车速 : 16|8@1+ (1,0) [0|200] "kph" Vector__XXX
 SG_ 目标充电SOC : 24|8@1+ (1,0) [0|100] "perc" Vector__XXX
 SG_ 整车驱动轮端需求扭矩 : 0|16@1+ (1,-30000) [-30000|30000] "Nm" Vector__XXX
 SG_ 驱动电机实际速度 : 32|16@1+ (1,0) [0|25000] "rpm" Vector__XXX
 SG_ 驱动电机实际功率 : 48|16@1+ (1,-2000) [-2000|2000] "kW" Vector__XXX

BA_ "VFrameFormat" BO_ 2357435540 1;
CM_ BO_ 2357435540 "整车车速 / 整车驱动轮端需求扭矩 | 信号数 5";
CM_ SG_ 2357435540 整车车速 "整车车速";
CM_ SG_ 2357435540 目标充电SOC "目标充电SOC";
CM_ SG_ 2357435540 整车驱动轮端需求扭矩 "整车驱动轮端需求扭矩";
CM_ SG_ 2357435540 驱动电机实际速度 "驱动电机实际速度";
CM_ SG_ 2357435540 驱动电机实际功率 "驱动电机实际功率";

BO_ 2357501076 ZT_0C849C94: 8 Vector__XXX
 SG_ 高压电池峰值放电功率 : 0|16@1+ (1,-2000) [-2000|2000] "kW" Vector__XXX
 SG_ 高压电池持续放电功率 : 16|16@1+ (1,-2000) [-2000|2000] "kW" Vector__XXX
 SG_ 高压电池峰值充电功率 : 32|16@1+ (1,-2000) [-2000|2000] "kW" Vector__XXX
 SG_ 高压电池持续充电功率 : 48|16@1+ (1,-2000) [-2000|2000] "kW" Vector__XXX

BA_ "VFrameFormat" BO_ 2357501076 1;
CM_ BO_ 2357501076 "高压电池峰值充电功率 / 高压电池峰值放电功率 | 信号数 4";
CM_ SG_ 2357501076 高压电池峰值放电功率 "高压电池峰值放电功率";
CM_ SG_ 2357501076 高压电池持续放电功率 "高压电池持续放电功率";
CM_ SG_ 2357501076 高压电池峰值充电功率 "高压电池峰值充电功率";
CM_ SG_ 2357501076 高压电池持续充电功率 "高压电池持续充电功率";

BO_ 2364539904 ZT_0CF00400: 8 Vector__XXX
 SG_ 发动机转速 : 32|16@1+ (0.125,0) [0|65536] "" Vector__XXX

BA_ "VFrameFormat" BO_ 2364539904 1;
CM_ BO_ 2364539904 "发动机转速 | 信号数 1";
CM_ SG_ 2364539904 发动机转速 "发动机转速";

BO_ 2364605095 ZT_0CF102A7: 8 Vector__XXX
 SG_ 电机系统运行使能 : 37|1@1+ (1,0) [0|1] "" Vector__XXX
 SG_ 手刹状态 : 46|1@1+ (1,0) [0|1] "" Vector__XXX
 SG_ 换挡状态 : 52|1@1+ (1,0) [0|1] "" Vector__XXX
 SG_ 主动放电标志 : 53|1@1+ (1,0) [0|1] "" Vector__XXX
 SG_ 蠕动或驻坡使能 : 54|1@1+ (1,0) [0|1] "" Vector__XXX
 SG_ 预充继电器状态 : 57|1@1+ (1,0) [0|1] "" Vector__XXX
 SG_ 主正继电器状态 : 58|1@1+ (1,0) [0|1] "" Vector__XXX
 SG_ 主负继电器状态 : 59|1@1+ (1,0) [0|1] "" Vector__XXX
 SG_ 电池组工作模式 : 38|2@1+ (1,0) [0|3] "" Vector__XXX
 SG_ VCU生命信号 : 48|4@1+ (1,0) [0|15] "" Vector__XXX
 SG_ 电机目标转矩 : 0|16@1+ (0.1,-3000) [-3000|3000] "Nm" Vector__XXX
 SG_ 电机目标转速 : 16|16@1+ (1,-12000) [-12000|12000] "rmp" Vector__XXX

BA_ "VFrameFormat" BO_ 2364605095 1;
CM_ BO_ 2364605095 "VCU生命信号 / 主动放电标志 | 信号数 14";
CM_ SG_ 2364605095 电机系统运行使能 "电机系统运行使能 [枚举: 电机系统运行禁止|电机系统运行使能]";
VAL_ 2364605095 电机系统运行使能 0 "电机系统运行禁止" 1 "电机系统运行使能";
CM_ SG_ 2364605095 手刹状态 "手刹状态 [枚举: 无效|有效]";
VAL_ 2364605095 手刹状态 0 "无效" 1 "有效";
CM_ SG_ 2364605095 换挡状态 "换挡状态 [枚举: 换挡完成或未换挡|进行中]";
VAL_ 2364605095 换挡状态 0 "换挡完成或未换挡" 1 "进行中";
CM_ SG_ 2364605095 主动放电标志 "主动放电标志 [枚举: 不放电|放电]";
VAL_ 2364605095 主动放电标志 0 "不放电" 1 "放电";
CM_ SG_ 2364605095 蠕动或驻坡使能 "蠕动或驻坡使能 [枚举: 无效|有效]";
VAL_ 2364605095 蠕动或驻坡使能 0 "无效" 1 "有效";
CM_ SG_ 2364605095 预充继电器状态 "预充继电器状态 [枚举: 断开|闭合]";
VAL_ 2364605095 预充继电器状态 0 "断开" 1 "闭合";
CM_ SG_ 2364605095 主正继电器状态 "主正继电器状态 [枚举: 断开|闭合]";
VAL_ 2364605095 主正继电器状态 0 "断开" 1 "闭合";
CM_ SG_ 2364605095 主负继电器状态 "主负继电器状态 [枚举: 断开|闭合]";
VAL_ 2364605095 主负继电器状态 0 "断开" 1 "闭合";
CM_ SG_ 2364605095 电池组工作模式 "电池组工作模式 [枚举: 电池组断开|预充电|正常连接]";
VAL_ 2364605095 电池组工作模式 0 "电池组断开" 1 "预充电" 2 "正常连接";
CM_ SG_ 2364605095 VCU生命信号 "VCU生命信号";
CM_ SG_ 2364605095 电机目标转矩 "电机目标转矩";
CM_ SG_ 2364605095 电机目标转速 "电机目标转速";

BO_ 2364605392 ZT_0CF103D0: 8 Vector__XXX
 SG_ MCU(驱动电机控制单元)使能 : 0|1@1+ (1,0) [0|0] "" Vector__XXX
 SG_ 档位信息 : 48|2@1+ (1,0) [0|0] "" Vector__XXX
 SG_ 请求电机工作状态 : 8|3@1+ (1,0) [0|0] "" Vector__XXX
 SG_ 请求电机转速 : 23|16@0+ (1,-6000) [0|0] "rpm" Vector__XXX

BA_ "VFrameFormat" BO_ 2364605392 1;
CM_ BO_ 2364605392 "MCU(驱动电机控制单元)使能 / 手刹 | 信号数 8";
CM_ SG_ 2364605392 MCU(驱动电机控制单元)使能 "MCU(驱动电机控制单元)使能 [枚举: 使能|关闭]";
VAL_ 2364605392 MCU(驱动电机控制单元)使能 0 "关闭" 1 "使能";
CM_ SG_ 2364605392 档位信息 "档位信息 [枚举: 空档|D档|R档|无效数据]";
VAL_ 2364605392 档位信息 0 "空档" 1 "D档" 2 "R档";
CM_ SG_ 2364605392 请求电机工作状态 "请求电机工作状态 [枚举: 睡眠模式|扭矩模式|转速模式|无效数据]";
VAL_ 2364605392 请求电机工作状态 0 "睡眠模式" 1 "扭矩模式" 2 "转速模式";
CM_ SG_ 2364605392 请求电机转速 "请求电机转速";

BO_ 2364605607 ZT_0CF104A7: 8 Vector__XXX
 SG_ 电助力使能标志位 : 0|2@1+ (1,0) [0|0] "" Vector__XXX
 SG_ CAN通信给定转速 : 15|16@0+ (0.125,0) [0|0] "rpm" Vector__XXX

BA_ "VFrameFormat" BO_ 2364605607 1;
CM_ BO_ 2364605607 "CAN通信给定转速 / 电助力使能标志位 | 信号数 4";
CM_ SG_ 2364605607 电助力使能标志位 "电助力使能标志位 [枚举: 无效|使能|无效数据]";
VAL_ 2364605607 电助力使能标志位 0 "无效" 1 "使能";
CM_ SG_ 2364605607 CAN通信给定转速 "CAN通信给定转速";

BO_ 2365521928 ZT_0CFF0008: 8 Vector__XXX
 SG_ 电机允许预充电反馈信号 : 52|1@1+ (1,0) [0|0] "" Vector__XXX
 SG_ 电机主动放电反馈信号 : 53|1@1+ (1,0) [0|0] "" Vector__XXX
 SG_ GBT使能状态反馈信号 : 54|1@1+ (1,0) [0|0] "" Vector__XXX
 SG_ 电机循环计数器-1 : 60|4@1+ (1,0) [0|15] "" Vector__XXX
 SG_ 电机转速 : 0|16@1+ (1,-15000) [-15000|15000] "rpm" Vector__XXX
 SG_ 电机扭矩 : 16|16@1+ (1,-5000) [-5000|8000] "Nm" Vector__XXX
 SG_ 电机交流侧电流 : 32|16@1+ (0.1,0) [0|1000] "A" Vector__XXX

BA_ "VFrameFormat" BO_ 2365521928 1;
CM_ BO_ 2365521928 "GBT使能状态反馈信号 / IGBT使能状态反馈 | 信号数 8";
CM_ SG_ 2365521928 电机允许预充电反馈信号 "电机允许预充电反馈信号 [枚举: 无效|有效]";
VAL_ 2365521928 电机允许预充电反馈信号 0 "无效" 1 "有效";
CM_ SG_ 2365521928 电机主动放电反馈信号 "电机主动放电反馈信号 [枚举: 无效|有效]";
VAL_ 2365521928 电机主动放电反馈信号 0 "无效" 1 "有效";
CM_ SG_ 2365521928 GBT使能状态反馈信号 "GBT使能状态反馈信号 [枚举: 无效|有效]";
VAL_ 2365521928 GBT使能状态反馈信号 0 "无效" 1 "有效";
CM_ SG_ 2365521928 电机循环计数器-1 "电机循环计数器-1";
CM_ SG_ 2365521928 电机转速 "电机转速";
CM_ SG_ 2365521928 电机扭矩 "电机扭矩";
CM_ SG_ 2365521928 电机交流侧电流 "电机交流侧电流";

BO_ 2365522184 ZT_0CFF0108: 8 Vector__XXX
 SG_ 电机故障报警 : 48|4@1+ (1,0) [0|0] "" Vector__XXX
 SG_ 电机生命值 : 60|4@1+ (1,0) [0|15] "" Vector__XXX
 SG_ 电机温度 : 0|8@1+ (1,-40) [-40|215] "deg C" Vector__XXX
 SG_ 电机控制器温度 : 8|8@1+ (1,-40) [-40|215] "deg C" Vector__XXX
 SG_ 电机扭矩上限 : 16|8@1+ (1,0) [0|5000] "Nm" Vector__XXX
 SG_ 电机扭矩下限 : 32|16@1+ (1,-5000) [-5000|0] "Nm" Vector__XXX

BA_ "VFrameFormat" BO_ 2365522184 1;
CM_ BO_ 2365522184 "当前状态值 / 循环计数器-2 | 信号数 6";
CM_ SG_ 2365522184 电机故障报警 "电机故障报警 [枚举: 无故障|警告报警（降功率）|故障（零转矩输出）|比较严重故障（关断电 机）|严重故障（停车处理）]";
VAL_ 2365522184 电机故障报警 0 "无故障" 1 "警告报警（降功率）" 2 "故障（零转矩输出）" 3 "比较严重故障（关断电 机）" 4 "严重故障（停车处理）";
CM_ SG_ 2365522184 电机生命值 "电机生命值";
CM_ SG_ 2365522184 电机温度 "电机温度";
CM_ SG_ 2365522184 电机控制器温度 "电机控制器温度";
CM_ SG_ 2365522184 电机扭矩上限 "电机扭矩上限";
CM_ SG_ 2365522184 电机扭矩下限 "电机扭矩下限";

BO_ 2365522415 ZT_0CFF01EF: 8 Vector__XXX
 SG_ 电机实际输出转矩值 : 7|16@0+ (1,-2000) [0|0] "NM" Vector__XXX
 SG_ 电机转速 : 23|16@0+ (1,-6000) [0|0] "rpm" Vector__XXX
 SG_ 直流端母线电压 : 39|16@0+ (1,0) [0|0] "V" Vector__XXX

BA_ "VFrameFormat" BO_ 2365522415 1;
CM_ BO_ 2365522415 "电机实际输出转矩值 / 电机转速 | 信号数 4";
CM_ SG_ 2365522415 电机实际输出转矩值 "电机实际输出转矩值";
CM_ SG_ 2365522415 电机转速 "电机转速";
CM_ SG_ 2365522415 直流端母线电压 "直流端母线电压";

BO_ 2365522440 ZT_0CFF0208: 8 Vector__XXX
 SG_ 电机过流故障 : 1|1@1+ (1,0) [0|0] "" Vector__XXX
 SG_ 电机超速故障 : 2|1@1+ (1,0) [0|0] "" Vector__XXX
 SG_ 电机温度过高故障 : 3|1@1+ (1,0) [0|0] "" Vector__XXX
 SG_ 电机逆变器温度过高故障 : 4|1@1+ (1,0) [0|0] "" Vector__XXX
 SG_ 电机旋变故障 : 5|1@1+ (1,0) [0|0] "" Vector__XXX
 SG_ 电机绕组温度故障 : 6|1@1+ (1,0) [0|0] "" Vector__XXX
 SG_ 电机CAN通信故障 : 7|1@1+ (1,0) [0|0] "" Vector__XXX
 SG_ 电机IPM 硬件故障 : 8|1@1+ (1,0) [0|0] "" Vector__XXX
 SG_ 电机电压过低故障 : 9|1@1+ (1,0) [0|0] "" Vector__XXX
 SG_ 24V电压过低故障（＜18V） : 10|1@1+ (1,0) [0|0] "" Vector__XXX
 SG_ 电机控制器超温报警（＞85℃） : 11|1@1+ (1,0) [0|0] "" Vector__XXX
 SG_ 电机控制器超温报警（＞160℃） : 12|1@1+ (1,0) [0|0] "" Vector__XXX
 SG_ 电机控制器直流母线欠压 : 13|1@1+ (1,0) [0|0] "" Vector__XXX
 SG_ 电机控制器母线过压 : 14|1@1+ (1,0) [0|0] "" Vector__XXX
 SG_ 电机过压故障 : 0|1@1+ (1,0) [0|65535] "" Vector__XXX
 SG_ 电机控制器循环计数器 : 60|4@1+ (1,0) [0|15] "" Vector__XXX
 SG_ 电机转数循环计数 : 48|8@1+ (1,0) [0|255] "" Vector__XXX
 SG_ 电机控制器直流电流 : 16|16@1+ (0.1,-1000) [-1000|1000] "A" Vector__XXX
 SG_ 电机控制器直流电压 : 32|16@1+ (0.1,0) [0|1000] "V" Vector__XXX

BA_ "VFrameFormat" BO_ 2365522440 1;
CM_ BO_ 2365522440 "24V电压过低故障 / 24V电压过低故障(＜18V) | 信号数 19";
CM_ SG_ 2365522440 电机过流故障 "电机过流故障 [枚举: 无故障|警告报警（降功率）|故障（零转矩输出）|比较严重故障（关断电 机）|严重故障（停车处理）]";
VAL_ 2365522440 电机过流故障 0 "无故障" 1 "警告报警（降功率）" 2 "故障（零转矩输出）" 3 "比较严重故障（关断电 机）" 4 "严重故障（停车处理）";
CM_ SG_ 2365522440 电机超速故障 "电机超速故障 [枚举: 无故障|警告报警（降功率）|故障（零转矩输出）|比较严重故障（关断电 机）|严重故障（停车处理）]";
VAL_ 2365522440 电机超速故障 0 "无故障" 1 "警告报警（降功率）" 2 "故障（零转矩输出）" 3 "比较严重故障（关断电 机）" 4 "严重故障（停车处理）";
CM_ SG_ 2365522440 电机温度过高故障 "电机温度过高故障 [枚举: 无故障|警告报警（降功率）|故障（零转矩输出）|比较严重故障（关断电 机）|严重故障（停车处理）]";
VAL_ 2365522440 电机温度过高故障 0 "无故障" 1 "警告报警（降功率）" 2 "故障（零转矩输出）" 3 "比较严重故障（关断电 机）" 4 "严重故障（停车处理）";
CM_ SG_ 2365522440 电机逆变器温度过高故障 "电机逆变器温度过高故障 [枚举: 无故障|警告报警（降功率）|故障（零转矩输出）|比较严重故障（关断电 机）|严重故障（停车处理）]";
VAL_ 2365522440 电机逆变器温度过高故障 0 "无故障" 1 "警告报警（降功率）" 2 "故障（零转矩输出）" 3 "比较严重故障（关断电 机）" 4 "严重故障（停车处理）";
CM_ SG_ 2365522440 电机旋变故障 "电机旋变故障 [枚举: 无故障|警告报警（降功率）|故障（零转矩输出）|比较严重故障（关断电 机）|严重故障（停车处理）]";
VAL_ 2365522440 电机旋变故障 0 "无故障" 1 "警告报警（降功率）" 2 "故障（零转矩输出）" 3 "比较严重故障（关断电 机）" 4 "严重故障（停车处理）";
CM_ SG_ 2365522440 电机绕组温度故障 "电机绕组温度故障 [枚举: 无故障|警告报警（降功率）|故障（零转矩输出）|比较严重故障（关断电 机）|严重故障（停车处理）]";
VAL_ 2365522440 电机绕组温度故障 0 "无故障" 1 "警告报警（降功率）" 2 "故障（零转矩输出）" 3 "比较严重故障（关断电 机）" 4 "严重故障（停车处理）";
CM_ SG_ 2365522440 电机CAN通信故障 "电机CAN通信故障 [枚举: 无故障|警告报警（降功率）|故障（零转矩输出）|比较严重故障（关断电 机）|严重故障（停车处理）]";
VAL_ 2365522440 电机CAN通信故障 0 "无故障" 1 "警告报警（降功率）" 2 "故障（零转矩输出）" 3 "比较严重故障（关断电 机）" 4 "严重故障（停车处理）";
CM_ SG_ 2365522440 电机IPM 硬件故障 "电机IPM 硬件故障 [枚举: 无故障|警告报警（降功率）|故障（零转矩输出）|比较严重故障（关断电 机）|严重故障（停车处理）]";
VAL_ 2365522440 电机IPM 硬件故障 0 "无故障" 1 "警告报警（降功率）" 2 "故障（零转矩输出）" 3 "比较严重故障（关断电 机）" 4 "严重故障（停车处理）";
CM_ SG_ 2365522440 电机电压过低故障 "电机电压过低故障 [枚举: 无故障|警告报警（降功率）|故障（零转矩输出）|比较严重故障（关断电 机）|严重故障（停车处理）]";
VAL_ 2365522440 电机电压过低故障 0 "无故障" 1 "警告报警（降功率）" 2 "故障（零转矩输出）" 3 "比较严重故障（关断电 机）" 4 "严重故障（停车处理）";
CM_ SG_ 2365522440 24V电压过低故障（＜18V） "24V电压过低故障（＜18V） [枚举: 无故障|警告报警（降功率）|故障（零转矩输出）|比较严重故障（关断电 机）|严重故障（停车处理）]";
VAL_ 2365522440 24V电压过低故障（＜18V） 0 "无故障" 1 "警告报警（降功率）" 2 "故障（零转矩输出）" 3 "比较严重故障（关断电 机）" 4 "严重故障（停车处理）";
CM_ SG_ 2365522440 电机控制器超温报警（＞85℃） "电机控制器超温报警（＞85℃） [枚举: 无故障|警告报警（降功率）|故障（零转矩输出）|比较严重故障（关断电 机）|严重故障（停车处理）]";
VAL_ 2365522440 电机控制器超温报警（＞85℃） 0 "无故障" 1 "警告报警（降功率）" 2 "故障（零转矩输出）" 3 "比较严重故障（关断电 机）" 4 "严重故障（停车处理）";
CM_ SG_ 2365522440 电机控制器超温报警（＞160℃） "电机控制器超温报警（＞160℃） [枚举: 无故障|警告报警（降功率）|故障（零转矩输出）|比较严重故障（关断电 机）|严重故障（停车处理）]";
VAL_ 2365522440 电机控制器超温报警（＞160℃） 0 "无故障" 1 "警告报警（降功率）" 2 "故障（零转矩输出）" 3 "比较严重故障（关断电 机）" 4 "严重故障（停车处理）";
CM_ SG_ 2365522440 电机控制器直流母线欠压 "电机控制器直流母线欠压 [枚举: 无故障|警告报警（降功率）|故障（零转矩输出）|比较严重故障（关断电 机）|严重故障（停车处理）]";
VAL_ 2365522440 电机控制器直流母线欠压 0 "无故障" 1 "警告报警（降功率）" 2 "故障（零转矩输出）" 3 "比较严重故障（关断电 机）" 4 "严重故障（停车处理）";
CM_ SG_ 2365522440 电机控制器母线过压 "电机控制器母线过压 [枚举: 无故障|警告报警（降功率）|故障（零转矩输出）|比较严重故障（关断电 机）|严重故障（停车处理）]";
VAL_ 2365522440 电机控制器母线过压 0 "无故障" 1 "警告报警（降功率）" 2 "故障（零转矩输出）" 3 "比较严重故障（关断电 机）" 4 "严重故障（停车处理）";
CM_ SG_ 2365522440 电机过压故障 "电机过压故障";
CM_ SG_ 2365522440 电机控制器循环计数器 "电机控制器循环计数器";
CM_ SG_ 2365522440 电机转数循环计数 "电机转数循环计数";
CM_ SG_ 2365522440 电机控制器直流电流 "电机控制器直流电流";
CM_ SG_ 2365522440 电机控制器直流电压 "电机控制器直流电压";

BO_ 2365522671 ZT_0CFF02EF: 8 Vector__XXX
 SG_ 电机故障1-母线过流一级故障 : 8|1@1+ (1,0) [0|0] "" Vector__XXX
 SG_ 电机故障1-母线过压一级故障 : 9|1@1+ (1,0) [0|0] "" Vector__XXX
 SG_ 电机故障1-逆变器过温一级故障 : 10|1@1+ (1,0) [0|0] "" Vector__XXX
 SG_ 电机故障1-电机过温一级故障 : 11|1@1+ (1,0) [0|0] "" Vector__XXX
 SG_ 电机故障1-模块故障一级故障 : 12|1@1+ (1,0) [0|0] "" Vector__XXX
 SG_ 电机故障1-CAN通信故障一级故障 : 13|1@1+ (1,0) [0|0] "" Vector__XXX
 SG_ 电机故障1-相电流过流一级故障 : 14|1@1+ (1,0) [0|0] "" Vector__XXX
 SG_ 电机故障1-电机欠压一级故障 : 15|1@1+ (1,0) [0|0] "" Vector__XXX
 SG_ 电机故障2-电机超速一级故障 : 16|1@1+ (1,0) [0|0] "" Vector__XXX
 SG_ 电机故障2-电机温度偏大三级故障 : 17|1@1+ (1,0) [0|0] "" Vector__XXX
 SG_ 电机故障2-母线电压偏小三级故障 : 18|1@1+ (1,0) [0|0] "" Vector__XXX
 SG_ 电机故障2-母线电压偏大三级故障 : 19|1@1+ (1,0) [0|0] "" Vector__XXX
 SG_ 电机故障2-逆变器温度偏大三级故障 : 20|1@1+ (1,0) [0|0] "" Vector__XXX
 SG_ 电机故障2-相电流过载三级故障 : 21|1@1+ (1,0) [0|0] "" Vector__XXX
 SG_ 电机故障2-电机堵转故障一级故障 : 22|1@1+ (1,0) [0|0] "" Vector__XXX
 SG_ 电机故障2-软件检测过流一级故障 : 23|1@1+ (1,0) [0|0] "" Vector__XXX
 SG_ 电机故障3-控制器硬件检测有故障一级故障 : 24|1@1+ (1,0) [0|0] "" Vector__XXX
 SG_ 电机故障3-控制器过温一级故障 : 25|1@1+ (1,0) [0|0] "" Vector__XXX
 SG_ 电机故障3-SDUerror一级故障 : 26|1@1+ (1,0) [0|0] "" Vector__XXX
 SG_ 电机故障3-初始化故障三级故障 : 27|1@1+ (1,0) [0|0] "" Vector__XXX
 SG_ 电机故障3-24V欠压一级故障 : 28|1@1+ (1,0) [0|0] "" Vector__XXX
 SG_ 电机故障3-驱动欠压一级故障 : 29|1@1+ (1,0) [0|0] "" Vector__XXX
 SG_ 电机故障3-逆变器过温二级故障 : 30|1@1+ (1,0) [0|0] "" Vector__XXX
 SG_ 电机故障3-逐波限流一级故障 : 31|1@1+ (1,0) [0|0] "" Vector__XXX
 SG_ 电机故障4-编码器异常一级故障 : 40|1@1+ (1,0) [0|0] "" Vector__XXX
 SG_ 电机故障4-输出缺相一级故障 : 41|1@1+ (1,0) [0|0] "" Vector__XXX
 SG_ 电机故障4-母线欠压一级故障 : 42|1@1+ (1,0) [0|0] "" Vector__XXX
 SG_ 电机故障4-电流检测一级故障 : 43|1@1+ (1,0) [0|0] "" Vector__XXX
 SG_ 电机故障4-速度偏差过大一级故障 : 44|1@1+ (1,0) [0|0] "" Vector__XXX
 SG_ 电机故障4-电机温度传感器掉线三级故障 : 45|1@1+ (1,0) [0|0] "" Vector__XXX
 SG_ 电机故障4-变频器过载三级故障 : 46|1@1+ (1,0) [0|0] "" Vector__XXX
 SG_ 电机故障4-电机过载三级故障 : 47|1@1+ (1,0) [0|0] "" Vector__XXX
 SG_ 电机模式状态 : 0|3@1+ (1,0) [0|0] "" Vector__XXX
 SG_ MCU(驱动电机控制单元)软件版本信息 : 32|8@1+ (0.1,0) [0|0] "" Vector__XXX
 SG_ 逆变器温度 : 48|8@1+ (1,-40) [0|0] "℃" Vector__XXX
 SG_ 电机温度 : 56|8@1+ (1,-40) [0|0] "℃" Vector__XXX

BA_ "VFrameFormat" BO_ 2365522671 1;
CM_ BO_ 2365522671 "MCU(驱动电机控制单元)软件版本信息 / 电机故障1-CAN通信故障一级故障 | 信号数 37";
CM_ SG_ 2365522671 电机故障1-母线过流一级故障 "电机故障1-母线过流一级故障 [枚举: 有|无]";
VAL_ 2365522671 电机故障1-母线过流一级故障 0 "无" 1 "有";
CM_ SG_ 2365522671 电机故障1-母线过压一级故障 "电机故障1-母线过压一级故障 [枚举: 有|无]";
VAL_ 2365522671 电机故障1-母线过压一级故障 0 "无" 1 "有";
CM_ SG_ 2365522671 电机故障1-逆变器过温一级故障 "电机故障1-逆变器过温一级故障 [枚举: 有|无]";
VAL_ 2365522671 电机故障1-逆变器过温一级故障 0 "无" 1 "有";
CM_ SG_ 2365522671 电机故障1-电机过温一级故障 "电机故障1-电机过温一级故障 [枚举: 有|无]";
VAL_ 2365522671 电机故障1-电机过温一级故障 0 "无" 1 "有";
CM_ SG_ 2365522671 电机故障1-模块故障一级故障 "电机故障1-模块故障一级故障 [枚举: 有|无]";
VAL_ 2365522671 电机故障1-模块故障一级故障 0 "无" 1 "有";
CM_ SG_ 2365522671 电机故障1-CAN通信故障一级故障 "电机故障1-CAN通信故障一级故障 [枚举: 有|无]";
VAL_ 2365522671 电机故障1-CAN通信故障一级故障 0 "无" 1 "有";
CM_ SG_ 2365522671 电机故障1-相电流过流一级故障 "电机故障1-相电流过流一级故障 [枚举: 有|无]";
VAL_ 2365522671 电机故障1-相电流过流一级故障 0 "无" 1 "有";
CM_ SG_ 2365522671 电机故障1-电机欠压一级故障 "电机故障1-电机欠压一级故障 [枚举: 有|无]";
VAL_ 2365522671 电机故障1-电机欠压一级故障 0 "无" 1 "有";
CM_ SG_ 2365522671 电机故障2-电机超速一级故障 "电机故障2-电机超速一级故障 [枚举: 有|无]";
VAL_ 2365522671 电机故障2-电机超速一级故障 0 "无" 1 "有";
CM_ SG_ 2365522671 电机故障2-电机温度偏大三级故障 "电机故障2-电机温度偏大三级故障 [枚举: 有|无]";
VAL_ 2365522671 电机故障2-电机温度偏大三级故障 0 "无" 1 "有";
CM_ SG_ 2365522671 电机故障2-母线电压偏小三级故障 "电机故障2-母线电压偏小三级故障 [枚举: 有|无]";
VAL_ 2365522671 电机故障2-母线电压偏小三级故障 0 "无" 1 "有";
CM_ SG_ 2365522671 电机故障2-母线电压偏大三级故障 "电机故障2-母线电压偏大三级故障 [枚举: 有|无]";
VAL_ 2365522671 电机故障2-母线电压偏大三级故障 0 "无" 1 "有";
CM_ SG_ 2365522671 电机故障2-逆变器温度偏大三级故障 "电机故障2-逆变器温度偏大三级故障 [枚举: 有|无]";
VAL_ 2365522671 电机故障2-逆变器温度偏大三级故障 0 "无" 1 "有";
CM_ SG_ 2365522671 电机故障2-相电流过载三级故障 "电机故障2-相电流过载三级故障 [枚举: 有|无]";
VAL_ 2365522671 电机故障2-相电流过载三级故障 0 "无" 1 "有";
CM_ SG_ 2365522671 电机故障2-电机堵转故障一级故障 "电机故障2-电机堵转故障一级故障 [枚举: 有|无]";
VAL_ 2365522671 电机故障2-电机堵转故障一级故障 0 "无" 1 "有";
CM_ SG_ 2365522671 电机故障2-软件检测过流一级故障 "电机故障2-软件检测过流一级故障 [枚举: 有|无]";
VAL_ 2365522671 电机故障2-软件检测过流一级故障 0 "无" 1 "有";
CM_ SG_ 2365522671 电机故障3-控制器硬件检测有故障一级故障 "电机故障3-控制器硬件检测有故障一级故障 [枚举: 有|无]";
VAL_ 2365522671 电机故障3-控制器硬件检测有故障一级故障 0 "无" 1 "有";
CM_ SG_ 2365522671 电机故障3-控制器过温一级故障 "电机故障3-控制器过温一级故障 [枚举: 有|无]";
VAL_ 2365522671 电机故障3-控制器过温一级故障 0 "无" 1 "有";
CM_ SG_ 2365522671 电机故障3-SDUerror一级故障 "电机故障3-SDUerror一级故障 [枚举: 有|无]";
VAL_ 2365522671 电机故障3-SDUerror一级故障 0 "无" 1 "有";
CM_ SG_ 2365522671 电机故障3-初始化故障三级故障 "电机故障3-初始化故障三级故障 [枚举: 有|无]";
VAL_ 2365522671 电机故障3-初始化故障三级故障 0 "无" 1 "有";
CM_ SG_ 2365522671 电机故障3-24V欠压一级故障 "电机故障3-24V欠压一级故障 [枚举: 有|无]";
VAL_ 2365522671 电机故障3-24V欠压一级故障 0 "无" 1 "有";
CM_ SG_ 2365522671 电机故障3-驱动欠压一级故障 "电机故障3-驱动欠压一级故障 [枚举: 有|无]";
VAL_ 2365522671 电机故障3-驱动欠压一级故障 0 "无" 1 "有";
CM_ SG_ 2365522671 电机故障3-逆变器过温二级故障 "电机故障3-逆变器过温二级故障 [枚举: 有|无]";
VAL_ 2365522671 电机故障3-逆变器过温二级故障 0 "无" 1 "有";
CM_ SG_ 2365522671 电机故障3-逐波限流一级故障 "电机故障3-逐波限流一级故障 [枚举: 有|无]";
VAL_ 2365522671 电机故障3-逐波限流一级故障 0 "无" 1 "有";
CM_ SG_ 2365522671 电机故障4-编码器异常一级故障 "电机故障4-编码器异常一级故障 [枚举: 有|无]";
VAL_ 2365522671 电机故障4-编码器异常一级故障 0 "无" 1 "有";
CM_ SG_ 2365522671 电机故障4-输出缺相一级故障 "电机故障4-输出缺相一级故障 [枚举: 有|无]";
VAL_ 2365522671 电机故障4-输出缺相一级故障 0 "无" 1 "有";
CM_ SG_ 2365522671 电机故障4-母线欠压一级故障 "电机故障4-母线欠压一级故障 [枚举: 有|无]";
VAL_ 2365522671 电机故障4-母线欠压一级故障 0 "无" 1 "有";
CM_ SG_ 2365522671 电机故障4-电流检测一级故障 "电机故障4-电流检测一级故障 [枚举: 有|无]";
VAL_ 2365522671 电机故障4-电流检测一级故障 0 "无" 1 "有";
CM_ SG_ 2365522671 电机故障4-速度偏差过大一级故障 "电机故障4-速度偏差过大一级故障 [枚举: 有|无]";
VAL_ 2365522671 电机故障4-速度偏差过大一级故障 0 "无" 1 "有";
CM_ SG_ 2365522671 电机故障4-电机温度传感器掉线三级故障 "电机故障4-电机温度传感器掉线三级故障 [枚举: 有|无]";
VAL_ 2365522671 电机故障4-电机温度传感器掉线三级故障 0 "无" 1 "有";
CM_ SG_ 2365522671 电机故障4-变频器过载三级故障 "电机故障4-变频器过载三级故障 [枚举: 有|无]";
VAL_ 2365522671 电机故障4-变频器过载三级故障 0 "无" 1 "有";
CM_ SG_ 2365522671 电机故障4-电机过载三级故障 "电机故障4-电机过载三级故障 [枚举: 有|无]";
VAL_ 2365522671 电机故障4-电机过载三级故障 0 "无" 1 "有";
CM_ SG_ 2365522671 电机模式状态 "电机模式状态 [枚举: 睡眠模式|扭矩模式|转速模式|无效数据]";
VAL_ 2365522671 电机模式状态 0 "睡眠模式" 1 "扭矩模式" 2 "转速模式";
CM_ SG_ 2365522671 MCU(驱动电机控制单元)软件版本信息 "MCU(驱动电机控制单元)软件版本信息";
CM_ SG_ 2365522671 逆变器温度 "逆变器温度";
CM_ SG_ 2365522671 电机温度 "电机温度";

BO_ 2365522696 ZT_0CFF0308: 8 Vector__XXX
 SG_ 电机循环计数器-2 : 60|4@1+ (1,0) [0|255] "" Vector__XXX
 SG_ 硬件错误代码1位 : 0|8@1+ (1,0) [0|255] "" Vector__XXX
 SG_ 硬件错误代码2位 : 8|8@1+ (1,0) [0|255] "" Vector__XXX
 SG_ 硬件错误代码3位 : 16|8@1+ (1,0) [0|255] "" Vector__XXX
 SG_ 硬件错误代码4位 : 24|8@1+ (1,0) [0|255] "" Vector__XXX
 SG_ 硬件错误代码5位 : 32|8@1+ (1,0) [0|255] "" Vector__XXX
 SG_ 硬件错误代码6位 : 40|8@1+ (1,0) [0|255] "" Vector__XXX

BA_ "VFrameFormat" BO_ 2365522696 1;
CM_ BO_ 2365522696 "循环计数器-3 / 电机循环计数器 | 信号数 7";
CM_ SG_ 2365522696 电机循环计数器-2 "电机循环计数器-2";
CM_ SG_ 2365522696 硬件错误代码1位 "硬件错误代码1位";
CM_ SG_ 2365522696 硬件错误代码2位 "硬件错误代码2位";
CM_ SG_ 2365522696 硬件错误代码3位 "硬件错误代码3位";
CM_ SG_ 2365522696 硬件错误代码4位 "硬件错误代码4位";
CM_ SG_ 2365522696 硬件错误代码5位 "硬件错误代码5位";
CM_ SG_ 2365522696 硬件错误代码6位 "硬件错误代码6位";

BO_ 2365522952 ZT_0CFF0408: 8 Vector__XXX
 SG_ 驻坡指示信号 : 56|1@1+ (1,0) [0|0] "" Vector__XXX
 SG_ 电机额定功率 : 16|8@1+ (1,0) [0|250] "kW" Vector__XXX
 SG_ 电机峰值功率 : 0|16@1+ (1,0) [0|500] "kW" Vector__XXX
 SG_ 电机当前最大可用功率 : 24|16@1+ (1,0) [0|500] "kW" Vector__XXX
 SG_ 电机瞬时功率 : 40|16@1+ (1,-500) [-500|500] "kW" Vector__XXX

BA_ "VFrameFormat" BO_ 2365522952 1;
CM_ BO_ 2365522952 "电机峰值功率 / 电机当前最大可用功率 | 信号数 5";
CM_ SG_ 2365522952 驻坡指示信号 "驻坡指示信号 [枚举: 无效|有效]";
VAL_ 2365522952 驻坡指示信号 0 "无效" 1 "有效";
CM_ SG_ 2365522952 电机额定功率 "电机额定功率";
CM_ SG_ 2365522952 电机峰值功率 "电机峰值功率";
CM_ SG_ 2365522952 电机当前最大可用功率 "电机当前最大可用功率";
CM_ SG_ 2365522952 电机瞬时功率 "电机瞬时功率";

BO_ 2365523208 ZT_0CFF0508: 8 Vector__XXX
 SG_ 放电总能量 : 0|24@1+ (0.1,0) [0|100000000000] "" Vector__XXX
 SG_ 制动能量回收总电量 : 24|24@1+ (0.1,0) [0|1000000000] "" Vector__XXX

BA_ "VFrameFormat" BO_ 2365523208 1;
CM_ BO_ 2365523208 "制动能量回收总电量 / 放电总能量 | 信号数 2";
CM_ SG_ 2365523208 放电总能量 "放电总能量";
CM_ SG_ 2365523208 制动能量回收总电量 "制动能量回收总电量";

BO_ 2365524207 ZT_0CFF08EF: 8 Vector__XXX
 SG_ 电 机 控 制 单 元 使 能 : 0|1@1+ (1,0) [0|1] "" Vector__XXX
 SG_ 故障清除 : 1|1@1+ (1,0) [0|1] "" Vector__XXX
 SG_ 脚刹信号-1 : 6|1@1+ (1,0) [0|1] "" Vector__XXX
 SG_ 手刹信号-1 : 7|1@1+ (1,0) [0|1] "" Vector__XXX
 SG_ 控制模式-1 : 2|2@1+ (1,0) [0|3] "" Vector__XXX
 SG_ 当前档位-1 : 4|2@1+ (1,0) [0|3] "" Vector__XXX
 SG_ 转速正值 : 8|8@1+ (1,0) [0|4095] "Nm" Vector__XXX
 SG_ 扭矩负值 : 16|8@1+ (1,0) [0|16380] "rpm" Vector__XXX
 SG_ 电机需求转速 : 48|8@1+ (1,0) [-15000|15000] "rpm" Vector__XXX
 SG_ 需求转矩 : 32|16@1+ (1,-5000) [-5000|5000] "Nm" Vector__XXX

BA_ "VFrameFormat" BO_ 2365524207 1;
CM_ BO_ 2365524207 "当前档位-1 / 当前档位-2 | 信号数 34";
CM_ SG_ 2365524207 电 机 控 制 单 元 使 能 "电 机 控 制 单 元 使 能 [枚举: 无效|有效]";
VAL_ 2365524207 电 机 控 制 单 元 使 能 0 "无效" 1 "有效";
CM_ SG_ 2365524207 故障清除 "故障清除 [枚举: 无效|有效]";
VAL_ 2365524207 故障清除 0 "无效" 1 "有效";
CM_ SG_ 2365524207 脚刹信号-1 "脚刹信号-1 [枚举: NoFootBrake无脚刹信号|FootBrake 有脚刹信号]";
VAL_ 2365524207 脚刹信号-1 0 "NoFootBrake无脚刹信号" 1 "FootBrake 有脚刹信号";
CM_ SG_ 2365524207 手刹信号-1 "手刹信号-1 [枚举: NoHandBrake无手刹信号|HandBrake 有手刹信号]";
VAL_ 2365524207 手刹信号-1 0 "NoHandBrake无手刹信号" 1 "HandBrake 有手刹信号";
CM_ SG_ 2365524207 控制模式-1 "控制模式-1 [枚举: 重启|Speed Control 车速控制|Torque Control扭矩控制|Active Discharge 主动放电]";
VAL_ 2365524207 控制模式-1 0 "重启" 1 "Speed Control 车速控制" 2 "Torque Control扭矩控制" 3 "Active Discharge 主动放电";
CM_ SG_ 2365524207 当前档位-1 "当前档位-1 [枚举: Neutral 空挡|Drive 前进档|Reverse后退档]";
VAL_ 2365524207 当前档位-1 0 "Neutral 空挡" 1 "Drive 前进档" 2 "Reverse后退档";
CM_ SG_ 2365524207 转速正值 "转速正值 [原始公式: (BYTE[1]+BYTE[2]*256)&4095]";
CM_ SG_ 2365524207 扭矩负值 "扭矩负值 [原始公式: (((BYTE[2]+BYTE[3]*256)>>4)&4095)*4]";
CM_ SG_ 2365524207 电机需求转速 "电机需求转速 [原始公式: if((BYTE[6]+BYTE[7]*256)==65535) @1; else (BYTE[6]+BYTE[7]*256)-15000] [枚举: %d|未启用]";
CM_ SG_ 2365524207 需求转矩 "需求转矩";

BO_ 2365527297 ZT_0CFF1501: 8 Vector__XXX
 SG_ 高压上下电指令 : 4|1@1+ (1,0) [0|1] "" Vector__XXX
 SG_ 手刹状态 : 7|1@1+ (1,0) [0|1] "" Vector__XXX
 SG_ VCU心跳信号 : 0|4@1+ (1,0) [0|15] "" Vector__XXX
 SG_ 电机控制器母线电压-2 : 8|16@1+ (1,0) [0|1000] "V" Vector__XXX
 SG_ 电机控制器母线电流-2 : 24|16@1+ (1,-1000) [-1000|1000] "A" Vector__XXX

BA_ "VFrameFormat" BO_ 2365527297 1;
CM_ BO_ 2365527297 "VCU心跳信号 / 手刹状态 | 信号数 5";
CM_ SG_ 2365527297 高压上下电指令 "高压上下电指令 [枚举: 下电指令|上电指令]";
VAL_ 2365527297 高压上下电指令 0 "下电指令" 1 "上电指令";
CM_ SG_ 2365527297 手刹状态 "手刹状态 [枚举: 手刹未提|手刹提起]";
VAL_ 2365527297 手刹状态 0 "手刹未提" 1 "手刹提起";
CM_ SG_ 2365527297 VCU心跳信号 "VCU心跳信号";
CM_ SG_ 2365527297 电机控制器母线电压-2 "电机控制器母线电压-2";
CM_ SG_ 2365527297 电机控制器母线电流-2 "电机控制器母线电流-2";

BO_ 2365541015 ZT_0CFF4A97: 8 Vector__XXX
 SG_ 钥匙位置 : 8|2@1+ (1,0) [0|3] "" Vector__XXX
 SG_ 节能开关 : 48|2@1+ (1,0) [0|3] "" Vector__XXX
 SG_ 档位位置 : 10|4@1+ (1,0) [0|15] "" Vector__XXX
 SG_ 转向灯信号 : 14|2@1+ (1,0) [0|3] "" Vector__XXX
 SG_ 节能等级旋钮 : 60|4@1+ (1,0) [0|15] "" Vector__XXX
 SG_ VCU生命信号 : 0|8@1+ (1,0) [0|255] "" Vector__XXX
 SG_ 加速踏板开度 : 16|8@1+ (1,0) [0|100] "" Vector__XXX
 SG_ 刹车踏板开度 : 24|8@1+ (1,0) [0|100] "" Vector__XXX
 SG_ 车速值 : 32|16@1+ (0.01,0) [0|655.35] "km/h" Vector__XXX

BA_ "VFrameFormat" BO_ 2365541015 1;
CM_ BO_ 2365541015 "VCU生命信号 / 刹车踏板开度 | 信号数 9";
CM_ SG_ 2365541015 钥匙位置 "钥匙位置 [枚举: OFF|ACC|ON]";
VAL_ 2365541015 钥匙位置 0 "OFF" 1 "ACC" 2 "ON";
CM_ SG_ 2365541015 节能开关 "节能开关 [枚举: 关闭|开启]";
VAL_ 2365541015 节能开关 0 "关闭" 1 "开启";
CM_ SG_ 2365541015 档位位置 "档位位置 [枚举: 空挡|前进挡|倒退档]";
VAL_ 2365541015 档位位置 0 "空挡" 1 "前进挡" 2 "倒退档";
CM_ SG_ 2365541015 转向灯信号 "转向灯信号";
CM_ SG_ 2365541015 节能等级旋钮 "节能等级旋钮";
CM_ SG_ 2365541015 VCU生命信号 "VCU生命信号";
CM_ SG_ 2365541015 加速踏板开度 "加速踏板开度";
CM_ SG_ 2365541015 刹车踏板开度 "刹车踏板开度";
CM_ SG_ 2365541015 车速值 "车速值";

BO_ 2365541271 ZT_0CFF4B97: 8 Vector__XXX
 SG_ 车辆最大驱动转矩 : 0|16@1+ (1,0) [0|65535] "Nm" Vector__XXX
 SG_ 电机最大制动转矩 : 16|16@1+ (1,-5000) [-5000|5000] "Nm" Vector__XXX
 SG_ 电机转矩需求 : 32|16@1+ (1,-5000) [-5000|5000] "Nm" Vector__XXX
 SG_ 电机实际转矩 : 48|16@1+ (1,-5000) [-5000|5000] "Nm" Vector__XXX

BA_ "VFrameFormat" BO_ 2365541271 1;
CM_ BO_ 2365541271 "电机实际转矩 / 电机最大制动转矩 | 信号数 4";
CM_ SG_ 2365541271 车辆最大驱动转矩 "车辆最大驱动转矩";
CM_ SG_ 2365541271 电机最大制动转矩 "电机最大制动转矩";
CM_ SG_ 2365541271 电机转矩需求 "电机转矩需求";
CM_ SG_ 2365541271 电机实际转矩 "电机实际转矩";

BO_ 2365541527 ZT_0CFF4C97: 8 Vector__XXX
 SG_ 动力电池组SOC : 0|16@1+ (0.01,0) [0|655.35] "%" Vector__XXX
 SG_ 动力电池组电压 : 16|16@1+ (0.1,0) [0|6553.5] "V" Vector__XXX
 SG_ 动力电池组电流 : 32|16@1+ (0.1,-1000) [-1000|1000] "A" Vector__XXX

BA_ "VFrameFormat" BO_ 2365541527 1;
CM_ BO_ 2365541527 "动力电池组SOC / 动力电池组电压 | 信号数 3";
CM_ SG_ 2365541527 动力电池组SOC "动力电池组SOC";
CM_ SG_ 2365541527 动力电池组电压 "动力电池组电压";
CM_ SG_ 2365541527 动力电池组电流 "动力电池组电流";

BO_ 2365541930 ZT_0CFF4E2A: 8 Vector__XXX
 SG_ IEC开关信号 : 12|2@1+ (1,0) [0|3] "" Vector__XXX
 SG_ IEC控制模式 : 20|4@1+ (1,0) [0|15] "" Vector__XXX
 SG_ ICU生命信号 : 0|8@1+ (1,0) [0|255] "" Vector__XXX
 SG_ 电机期望转矩 : 24|16@1+ (1,-5000) [-5000|5000] "" Vector__XXX

BA_ "VFrameFormat" BO_ 2365541930 1;
CM_ BO_ 2365541930 "ICU生命信号 / IEC开关信号 | 信号数 4";
CM_ SG_ 2365541930 IEC开关信号 "IEC开关信号 [枚举: 关闭|开启]";
VAL_ 2365541930 IEC开关信号 0 "关闭" 1 "开启";
CM_ SG_ 2365541930 IEC控制模式 "IEC控制模式";
CM_ SG_ 2365541930 ICU生命信号 "ICU生命信号";
CM_ SG_ 2365541930 电机期望转矩 "电机期望转矩";

BO_ 2365553923 ZT_UNKNOWN_0CFF7D03: 8 Vector__XXX
 SG_ 字节0 : 0|8@1+ (1,0) [0|255] "" Vector__XXX
 SG_ 字节1 : 8|8@1+ (1,0) [0|255] "" Vector__XXX
 SG_ 字节2 : 16|8@1+ (1,0) [0|255] "" Vector__XXX
 SG_ 字节3 : 24|8@1+ (1,0) [0|255] "" Vector__XXX
 SG_ 字节4 : 32|8@1+ (1,0) [0|255] "" Vector__XXX
 SG_ 字节5 : 40|8@1+ (1,0) [0|255] "" Vector__XXX
 SG_ 字节6 : 48|8@1+ (1,0) [0|255] "" Vector__XXX
 SG_ 字节7 : 56|8@1+ (1,0) [0|255] "" Vector__XXX

BA_ "VFrameFormat" BO_ 2365553923 1;
CM_ BO_ 2365553923 "BMS 电池管理系统 | 无信号定义, 按原始字节输出";
CM_ SG_ 2365553923 字节0 "字节0（原始值，无信号定义）";
CM_ SG_ 2365553923 字节1 "字节1（原始值，无信号定义）";
CM_ SG_ 2365553923 字节2 "字节2（原始值，无信号定义）";
CM_ SG_ 2365553923 字节3 "字节3（原始值，无信号定义）";
CM_ SG_ 2365553923 字节4 "字节4（原始值，无信号定义）";
CM_ SG_ 2365553923 字节5 "字节5（原始值，无信号定义）";
CM_ SG_ 2365553923 字节6 "字节6（原始值，无信号定义）";
CM_ SG_ 2365553923 字节7 "字节7（原始值，无信号定义）";

BO_ 2365554179 ZT_UNKNOWN_0CFF7E03: 8 Vector__XXX
 SG_ 字节0 : 0|8@1+ (1,0) [0|255] "" Vector__XXX
 SG_ 字节1 : 8|8@1+ (1,0) [0|255] "" Vector__XXX
 SG_ 字节2 : 16|8@1+ (1,0) [0|255] "" Vector__XXX
 SG_ 字节3 : 24|8@1+ (1,0) [0|255] "" Vector__XXX
 SG_ 字节4 : 32|8@1+ (1,0) [0|255] "" Vector__XXX
 SG_ 字节5 : 40|8@1+ (1,0) [0|255] "" Vector__XXX
 SG_ 字节6 : 48|8@1+ (1,0) [0|255] "" Vector__XXX
 SG_ 字节7 : 56|8@1+ (1,0) [0|255] "" Vector__XXX

BA_ "VFrameFormat" BO_ 2365554179 1;
CM_ BO_ 2365554179 "BMS 电池管理系统 | 无信号定义, 按原始字节输出";
CM_ SG_ 2365554179 字节0 "字节0（原始值，无信号定义）";
CM_ SG_ 2365554179 字节1 "字节1（原始值，无信号定义）";
CM_ SG_ 2365554179 字节2 "字节2（原始值，无信号定义）";
CM_ SG_ 2365554179 字节3 "字节3（原始值，无信号定义）";
CM_ SG_ 2365554179 字节4 "字节4（原始值，无信号定义）";
CM_ SG_ 2365554179 字节5 "字节5（原始值，无信号定义）";
CM_ SG_ 2365554179 字节6 "字节6（原始值，无信号定义）";
CM_ SG_ 2365554179 字节7 "字节7（原始值，无信号定义）";

BO_ 2365554435 ZT_UNKNOWN_0CFF7F03: 8 Vector__XXX
 SG_ 字节0 : 0|8@1+ (1,0) [0|255] "" Vector__XXX
 SG_ 字节1 : 8|8@1+ (1,0) [0|255] "" Vector__XXX
 SG_ 字节2 : 16|8@1+ (1,0) [0|255] "" Vector__XXX
 SG_ 字节3 : 24|8@1+ (1,0) [0|255] "" Vector__XXX
 SG_ 字节4 : 32|8@1+ (1,0) [0|255] "" Vector__XXX
 SG_ 字节5 : 40|8@1+ (1,0) [0|255] "" Vector__XXX
 SG_ 字节6 : 48|8@1+ (1,0) [0|255] "" Vector__XXX
 SG_ 字节7 : 56|8@1+ (1,0) [0|255] "" Vector__XXX

BA_ "VFrameFormat" BO_ 2365554435 1;
CM_ BO_ 2365554435 "BMS 电池管理系统 | 无信号定义, 按原始字节输出";
CM_ SG_ 2365554435 字节0 "字节0（原始值，无信号定义）";
CM_ SG_ 2365554435 字节1 "字节1（原始值，无信号定义）";
CM_ SG_ 2365554435 字节2 "字节2（原始值，无信号定义）";
CM_ SG_ 2365554435 字节3 "字节3（原始值，无信号定义）";
CM_ SG_ 2365554435 字节4 "字节4（原始值，无信号定义）";
CM_ SG_ 2365554435 字节5 "字节5（原始值，无信号定义）";
CM_ SG_ 2365554435 字节6 "字节6（原始值，无信号定义）";
CM_ SG_ 2365554435 字节7 "字节7（原始值，无信号定义）";

BO_ 2365554691 ZT_UNKNOWN_0CFF8003: 8 Vector__XXX
 SG_ 字节0 : 0|8@1+ (1,0) [0|255] "" Vector__XXX
 SG_ 字节1 : 8|8@1+ (1,0) [0|255] "" Vector__XXX
 SG_ 字节2 : 16|8@1+ (1,0) [0|255] "" Vector__XXX
 SG_ 字节3 : 24|8@1+ (1,0) [0|255] "" Vector__XXX
 SG_ 字节4 : 32|8@1+ (1,0) [0|255] "" Vector__XXX
 SG_ 字节5 : 40|8@1+ (1,0) [0|255] "" Vector__XXX
 SG_ 字节6 : 48|8@1+ (1,0) [0|255] "" Vector__XXX
 SG_ 字节7 : 56|8@1+ (1,0) [0|255] "" Vector__XXX

BA_ "VFrameFormat" BO_ 2365554691 1;
CM_ BO_ 2365554691 "BMS 电池管理系统 | 无信号定义, 按原始字节输出";
CM_ SG_ 2365554691 字节0 "字节0（原始值，无信号定义）";
CM_ SG_ 2365554691 字节1 "字节1（原始值，无信号定义）";
CM_ SG_ 2365554691 字节2 "字节2（原始值，无信号定义）";
CM_ SG_ 2365554691 字节3 "字节3（原始值，无信号定义）";
CM_ SG_ 2365554691 字节4 "字节4（原始值，无信号定义）";
CM_ SG_ 2365554691 字节5 "字节5（原始值，无信号定义）";
CM_ SG_ 2365554691 字节6 "字节6（原始值，无信号定义）";
CM_ SG_ 2365554691 字节7 "字节7（原始值，无信号定义）";

BO_ 2365554947 ZT_UNKNOWN_0CFF8103: 8 Vector__XXX
 SG_ 字节0 : 0|8@1+ (1,0) [0|255] "" Vector__XXX
 SG_ 字节1 : 8|8@1+ (1,0) [0|255] "" Vector__XXX
 SG_ 字节2 : 16|8@1+ (1,0) [0|255] "" Vector__XXX
 SG_ 字节3 : 24|8@1+ (1,0) [0|255] "" Vector__XXX
 SG_ 字节4 : 32|8@1+ (1,0) [0|255] "" Vector__XXX
 SG_ 字节5 : 40|8@1+ (1,0) [0|255] "" Vector__XXX
 SG_ 字节6 : 48|8@1+ (1,0) [0|255] "" Vector__XXX
 SG_ 字节7 : 56|8@1+ (1,0) [0|255] "" Vector__XXX

BA_ "VFrameFormat" BO_ 2365554947 1;
CM_ BO_ 2365554947 "BMS 电池管理系统 | 无信号定义, 按原始字节输出";
CM_ SG_ 2365554947 字节0 "字节0（原始值，无信号定义）";
CM_ SG_ 2365554947 字节1 "字节1（原始值，无信号定义）";
CM_ SG_ 2365554947 字节2 "字节2（原始值，无信号定义）";
CM_ SG_ 2365554947 字节3 "字节3（原始值，无信号定义）";
CM_ SG_ 2365554947 字节4 "字节4（原始值，无信号定义）";
CM_ SG_ 2365554947 字节5 "字节5（原始值，无信号定义）";
CM_ SG_ 2365554947 字节6 "字节6（原始值，无信号定义）";
CM_ SG_ 2365554947 字节7 "字节7（原始值，无信号定义）";

BO_ 2365555203 ZT_UNKNOWN_0CFF8203: 8 Vector__XXX
 SG_ 字节0 : 0|8@1+ (1,0) [0|255] "" Vector__XXX
 SG_ 字节1 : 8|8@1+ (1,0) [0|255] "" Vector__XXX
 SG_ 字节2 : 16|8@1+ (1,0) [0|255] "" Vector__XXX
 SG_ 字节3 : 24|8@1+ (1,0) [0|255] "" Vector__XXX
 SG_ 字节4 : 32|8@1+ (1,0) [0|255] "" Vector__XXX
 SG_ 字节5 : 40|8@1+ (1,0) [0|255] "" Vector__XXX
 SG_ 字节6 : 48|8@1+ (1,0) [0|255] "" Vector__XXX
 SG_ 字节7 : 56|8@1+ (1,0) [0|255] "" Vector__XXX

BA_ "VFrameFormat" BO_ 2365555203 1;
CM_ BO_ 2365555203 "BMS 电池管理系统 | 无信号定义, 按原始字节输出";
CM_ SG_ 2365555203 字节0 "字节0（原始值，无信号定义）";
CM_ SG_ 2365555203 字节1 "字节1（原始值，无信号定义）";
CM_ SG_ 2365555203 字节2 "字节2（原始值，无信号定义）";
CM_ SG_ 2365555203 字节3 "字节3（原始值，无信号定义）";
CM_ SG_ 2365555203 字节4 "字节4（原始值，无信号定义）";
CM_ SG_ 2365555203 字节5 "字节5（原始值，无信号定义）";
CM_ SG_ 2365555203 字节6 "字节6（原始值，无信号定义）";
CM_ SG_ 2365555203 字节7 "字节7（原始值，无信号定义）";

BO_ 2432177566 ZT_10F8159E: 8 Vector__XXX
 SG_ 高压继电器状态 : 56|4@1+ (1,0) [0|0] "" Vector__XXX
 SG_ BMS(电池管理系统)基本状态 : 0|8@1+ (1,0) [0|0] "" Vector__XXX
 SG_ 电池组平均温度 : 8|8@1+ (1,-40) [0|0] "℃" Vector__XXX
 SG_ 电池组SOC(电池可用容量) : 16|8@1+ (1,0) [0|0] "%" Vector__XXX
 SG_ 电池组充放电电流 : 24|16@1+ (0.1,-3200) [0|0] "A" Vector__XXX
 SG_ 电池组总电压 : 40|16@1+ (0.1,0) [0|0] "V" Vector__XXX

BA_ "VFrameFormat" BO_ 2432177566 1;
CM_ BO_ 2432177566 "BMS(电池管理系统)基本状态 / 电池组SOC(电池可用容量) | 信号数 7";
CM_ SG_ 2432177566 高压继电器状态 "高压继电器状态 [枚举: 高压继电器正常|高压继电器粘连|高压继电器不能吸合|无效数据]";
VAL_ 2432177566 高压继电器状态 0 "高压继电器正常" 1 "高压继电器粘连" 2 "高压继电器不能吸合";
CM_ SG_ 2432177566 BMS(电池管理系统)基本状态 "BMS(电池管理系统)基本状态 [原始公式: if(x1>=0x00&&x1<=0x3F)0;else if(x1>=0x40&&x1<=0x7F)1;else 2;] [枚举: BMS(电池管理系统)可以正常工作状态|BMS(电池管理系统)有故障，无法正常工作|无效数据]";
CM_ SG_ 2432177566 电池组平均温度 "电池组平均温度";
CM_ SG_ 2432177566 电池组SOC(电池可用容量) "电池组SOC(电池可用容量)";
CM_ SG_ 2432177566 电池组充放电电流 "电池组充放电电流";
CM_ SG_ 2432177566 电池组总电压 "电池组总电压";

BO_ 2432177822 ZT_10F8169E: 8 Vector__XXX
 SG_ 电池组允许最高温度 : 0|8@1+ (1,-40) [0|0] "℃" Vector__XXX
 SG_ 电池组允许最低温度 : 8|8@1+ (1,-40) [0|0] "℃" Vector__XXX
 SG_ 电池组允许最低使用SOC(电池可用容量) : 16|8@1+ (1,0) [0|0] "%" Vector__XXX
 SG_ 电池组允许漏电流 : 56|8@1+ (1,0) [0|0] "mA" Vector__XXX
 SG_ 电池组当前最大允许放电电流 : 24|16@1+ (0.1,-3200) [0|0] "A" Vector__XXX
 SG_ 电池组当前最大允许回馈电流 : 40|16@1+ (0.1,0) [0|0] "A" Vector__XXX

BA_ "VFrameFormat" BO_ 2432177822 1;
CM_ BO_ 2432177822 "电池组允许最低使用SOC(电池可用容量) / 电池组允许最低温度 | 信号数 6";
CM_ SG_ 2432177822 电池组允许最高温度 "电池组允许最高温度";
CM_ SG_ 2432177822 电池组允许最低温度 "电池组允许最低温度";
CM_ SG_ 2432177822 电池组允许最低使用SOC(电池可用容量) "电池组允许最低使用SOC(电池可用容量)";
CM_ SG_ 2432177822 电池组允许漏电流 "电池组允许漏电流";
CM_ SG_ 2432177822 电池组当前最大允许放电电流 "电池组当前最大允许放电电流";
CM_ SG_ 2432177822 电池组当前最大允许回馈电流 "电池组当前最大允许回馈电流";

BO_ 2432179614 ZT_10F81D9E: 8 Vector__XXX
 SG_ 电池组系统故障 : 0|8@1+ (1,0) [0|0] "" Vector__XXX
 SG_ 整车充电控制(巡航) : 8|8@1+ (1,0) [0|0] "" Vector__XXX
 SG_ 整车充电控制(刹车)混合动力使用 : 16|8@1+ (1,0) [0|0] "" Vector__XXX
 SG_ 整车充电控制(辅助电机,混合动力使用) : 24|8@1+ (1,0) [0|0] "" Vector__XXX
 SG_ BMS(电池管理系统)高速放电请求指令 : 32|8@1+ (1,0) [0|0] "" Vector__XXX
 SG_ BMS(电池管理系统)生命信号 : 40|8@1+ (1,0) [0|0] "" Vector__XXX
 SG_ BMS(电池管理系统)软件版本号 : 48|16@1+ (1,0) [0|0] "" Vector__XXX

BA_ "VFrameFormat" BO_ 2432179614 1;
CM_ BO_ 2432179614 "BMS(电池管理系统)生命信号 / BMS(电池管理系统)软件版本号 | 信号数 7";
CM_ SG_ 2432179614 电池组系统故障 "电池组系统故障 [枚举: 无故障|一级故障-电池温度过高|一级故障-电池绝缘故障|一级故障-单体电压过高|一级故障-单体电压过低|一级故障-总压过高|一级故障-总压过低|一级故障-充电电流过大|一级故障-放电电流过大|一级故障-回馈电流过大|一级故障-SOC(电池可用容量) 过低|一级故障-高压连接器故障|二级故障-电池温度过高|二级故障-绝缘故障|二级故障-单体电压过高|二级故障-单体电压过低|二级故障-总电压过高|二级故障-总电压过低|二级故障-充电电流过大|二级故障-放电电流过大|二级故障-回馈电流过大|二级故障-SOC(电池可用容量) 过低|二级故障-高压连接器故障|二级故障-绝缘模块故障|二级故障-采集模块故障|三级故障-电池温度过高|三级故障-绝缘故障|三级故障-单体电压过高|三级故障-单体电压过低|三级故障-总电压过高|三级故障-总电压过低|三级故障-充电电流过大|三级故障-放电电流过大|三级故障-回馈电流过大|三级故障-SOC(电池可用容量) 过低|三级故障-高压连接器过温故障|无效数据]";
VAL_ 2432179614 电池组系统故障 0 "无故障" 1 "一级故障-电池温度过高" 2 "一级故障-电池绝缘故障" 3 "一级故障-单体电压过高" 4 "一级故障-单体电压过低" 5 "一级故障-总压过高" 6 "一级故障-总压过低" 7 "一级故障-充电电流过大" 8 "一级故障-放电电流过大" 9 "一级故障-回馈电流过大" 10 "一级故障-SOC(电池可用容量) 过低" 11 "一级故障-高压连接器故障" 51 "二级故障-电池温度过高" 52 "二级故障-绝缘故障" 53 "二级故障-单体电压过高" 54 "二级故障-单体电压过低" 55 "二级故障-总电压过高" 56 "二级故障-总电压过低" 57 "二级故障-充电电流过大" 58 "二级故障-放电电流过大" 59 "二级故障-回馈电流过大" 60 "二级故障-SOC(电池可用容量) 过低" 61 "二级故障-高压连接器故障" 62 "二级故障-绝缘模块故障" 63 "二级故障-采集模块故障" 101 "三级故障-电池温度过高" 102 "三级故障-绝缘故障" 103 "三级故障-单体电压过高" 104 "三级故障-单体电压过低" 105 "三级故障-总电压过高" 106 "三级故障-总电压过低" 107 "三级故障-充电电流过大" 108 "三级故障-放电电流过大" 109 "三级故障-回馈电流过大" 110 "三级故障-SOC(电池可用容量) 过低" 111 "三级故障-高压连接器过温故障";
CM_ SG_ 2432179614 整车充电控制(巡航) "整车充电控制(巡航) [枚举: 巡航关闭|巡航开启|无效数据]";
VAL_ 2432179614 整车充电控制(巡航) 1 "巡航关闭" 2 "巡航开启";
CM_ SG_ 2432179614 整车充电控制(刹车)混合动力使用 "整车充电控制(刹车)混合动力使用 [枚举: 刹车充电百分之30|刹车充电百分之60|刹车充电百分之80|刹车充电百分之100|无效数据]";
VAL_ 2432179614 整车充电控制(刹车)混合动力使用 1 "刹车充电百分之30" 2 "刹车充电百分之60" 3 "刹车充电百分之80" 4 "刹车充电百分之100";
CM_ SG_ 2432179614 整车充电控制(辅助电机,混合动力使用) "整车充电控制(辅助电机,混合动力使用) [枚举: 辅助电机充电关闭|辅助电机充电开启|无效数据]";
VAL_ 2432179614 整车充电控制(辅助电机,混合动力使用) 1 "辅助电机充电关闭" 2 "辅助电机充电开启";
CM_ SG_ 2432179614 BMS(电池管理系统)高速放电请求指令 "BMS(电池管理系统)高速放电请求指令 [枚举: 无请求|高速放电请求|无效数据]";
VAL_ 2432179614 BMS(电池管理系统)高速放电请求指令 1 "无请求" 2 "高速放电请求";
CM_ SG_ 2432179614 BMS(电池管理系统)生命信号 "BMS(电池管理系统)生命信号";
CM_ SG_ 2432179614 BMS(电池管理系统)软件版本号 "BMS(电池管理系统)软件版本号";

BO_ 2432180126 ZT_10F81F9E: 8 Vector__XXX
 SG_ 总压上限 : 0|16@1+ (0.1,0) [0|0] "V" Vector__XXX
 SG_ 总压下限 : 16|16@1+ (0.1,0) [0|0] "V" Vector__XXX
 SG_ 单体电压上限 : 32|16@1+ (0.001,0) [0|0] "V" Vector__XXX
 SG_ 单体电压下限 : 48|16@1+ (0.001,0) [0|0] "V" Vector__XXX

BA_ "VFrameFormat" BO_ 2432180126 1;
CM_ BO_ 2432180126 "单体电压上限 / 单体电压下限 | 信号数 4";
CM_ SG_ 2432180126 总压上限 "总压上限";
CM_ SG_ 2432180126 总压下限 "总压下限";
CM_ SG_ 2432180126 单体电压上限 "单体电压上限";
CM_ SG_ 2432180126 单体电压下限 "单体电压下限";

BO_ 2483328156 ZT_1404949C: 8 Vector__XXX
 SG_ 冷却液温度 : 16|8@1+ (1,-40) [-40|210] "degC" Vector__XXX
 SG_ 尿素温度 : 24|8@1+ (1,-40) [-40|210] "degC" Vector__XXX
 SG_ 尿素液位 : 32|8@1+ (0.4,0) [0|100] "perc" Vector__XXX
 SG_ 机油压力 : 40|8@1+ (4,0) [0|1000] "kpa" Vector__XXX
 SG_ 尿素浓度 : 48|8@1+ (0.25,0) [0|62.5] "perc" Vector__XXX
 SG_ 预留-1 : 56|8@1+ (1,0) [0|255] "" Vector__XXX
 SG_ 发动机实际转速反馈值 : 0|16@1+ (0.125,0) [0|8032] "rpm" Vector__XXX

BA_ "VFrameFormat" BO_ 2483328156 1;
CM_ BO_ 2483328156 "冷却液温度 / 发动机实际转速反馈值 | 信号数 8";
CM_ SG_ 2483328156 冷却液温度 "冷却液温度";
CM_ SG_ 2483328156 尿素温度 "尿素温度";
CM_ SG_ 2483328156 尿素液位 "尿素液位";
CM_ SG_ 2483328156 机油压力 "机油压力";
CM_ SG_ 2483328156 尿素浓度 "尿素浓度";
CM_ SG_ 2483328156 预留-1 "预留-1";
CM_ SG_ 2483328156 发动机实际转速反馈值 "发动机实际转速反馈值";

BO_ 2483393692 ZT_1405949C: 8 Vector__XXX
 SG_ 进气预热指示灯 : 0|2@1+ (1,0) [0|3] "" Vector__XXX
 SG_ 油中有水报警灯 : 2|2@1+ (1,0) [0|3] "" Vector__XXX
 SG_ 机油压力低 : 4|2@1+ (1,0) [0|3] "" Vector__XXX
 SG_ 水温过高报警灯 : 6|2@1+ (1,0) [0|3] "" Vector__XXX
 SG_ 发动机制动灯-缸内制动 : 16|2@1+ (1,0) [0|3] "" Vector__XXX
 SG_ 发动机制动灯-排气制动 : 18|2@1+ (1,0) [0|3] "" Vector__XXX
 SG_ 巡航工作指示灯 : 13|3@1+ (1,0) [0|7] "" Vector__XXX
 SG_ 高排气温度指示灯   DPF灯 : 20|3@1+ (1,0) [0|7] "" Vector__XXX
 SG_ 预留-2 : 23|1@1+ (1,0) [0|1] "" Vector__XXX

BA_ "VFrameFormat" BO_ 2483393692 1;
CM_ BO_ 2483393692 "PTO工作指示灯 / 发动机制动灯-排气制动 | 信号数 11";
CM_ SG_ 2483393692 进气预热指示灯 "进气预热指示灯 [枚举: 正常|故障]";
VAL_ 2483393692 进气预热指示灯 0 "正常" 1 "故障";
CM_ SG_ 2483393692 油中有水报警灯 "油中有水报警灯 [枚举: 正常|故障]";
VAL_ 2483393692 油中有水报警灯 0 "正常" 1 "故障";
CM_ SG_ 2483393692 机油压力低 "机油压力低 [枚举: 正常|故障]";
VAL_ 2483393692 机油压力低 0 "正常" 1 "故障";
CM_ SG_ 2483393692 水温过高报警灯 "水温过高报警灯 [枚举: 正常|故障]";
VAL_ 2483393692 水温过高报警灯 0 "正常" 1 "故障";
CM_ SG_ 2483393692 发动机制动灯-缸内制动 "发动机制动灯-缸内制动 [枚举: 正常|故障]";
VAL_ 2483393692 发动机制动灯-缸内制动 0 "正常" 1 "故障";
CM_ SG_ 2483393692 发动机制动灯-排气制动 "发动机制动灯-排气制动 [枚举: 正常|故障]";
VAL_ 2483393692 发动机制动灯-排气制动 0 "正常" 1 "故障";
CM_ SG_ 2483393692 巡航工作指示灯 "巡航工作指示灯 [枚举: 灯灭|灯亮|灯亮|灯亮|灯亮|灯亮|灯亮|灯灭]";
VAL_ 2483393692 巡航工作指示灯 0 "灯灭" 1 "灯亮" 2 "灯亮" 3 "灯亮" 4 "灯亮" 5 "灯亮" 6 "灯亮" 7 "灯灭";
CM_ SG_ 2483393692 高排气温度指示灯   DPF灯 "高排气温度指示灯   DPF灯 [枚举: 正常|故障]";
VAL_ 2483393692 高排气温度指示灯   DPF灯 0 "正常" 1 "故障";
CM_ SG_ 2483393692 预留-2 "预留-2";

BO_ 2485776789 ZT_1429F195: 8 Vector__XXX
 SG_ PT100(热电阻)故障 : 8|2@1+ (1,0) [0|0] "" Vector__XXX
 SG_ 电助力电机温度 : 0|8@1+ (1,-40) [0|0] "℃" Vector__XXX

BA_ "VFrameFormat" BO_ 2485776789 1;
CM_ BO_ 2485776789 "PT100(热电阻)故障 / 电助力电机温度 | 信号数 2";
CM_ SG_ 2485776789 PT100(热电阻)故障 "PT100(热电阻)故障 [枚举: 无故障|PT100开路|PT100短路|保留]";
VAL_ 2485776789 PT100(热电阻)故障 0 "无故障" 1 "PT100开路" 2 "PT100短路";
CM_ SG_ 2485776789 电助力电机温度 "电助力电机温度";

BO_ 2485976981 ZT_142CFF95: 8 Vector__XXX
 SG_ 控制器预充电状态反馈 : 63|1@1+ (1,0) [0|0] "" Vector__XXX
 SG_ 故障内容 : 56|4@1+ (1,0) [0|0] "" Vector__XXX

BA_ "VFrameFormat" BO_ 2485976981 1;
CM_ BO_ 2485976981 "控制器预充电状态反馈 / 故障内容 | 信号数 3";
CM_ SG_ 2485976981 控制器预充电状态反馈 "控制器预充电状态反馈 [枚举: 完成|未完成]";
VAL_ 2485976981 控制器预充电状态反馈 0 "未完成" 1 "完成";
CM_ SG_ 2485976981 故障内容 "故障内容 [枚举: 输入过流|输入过压|输入欠压|过载保护|输入、输出断线|输入、输出短路|输出缺相|控制器过温|无效数据]";
VAL_ 2485976981 故障内容 1 "输入过流" 2 "输入过压" 3 "输入欠压" 4 "过载保护" 5 "输入、输出断线" 6 "输入、输出短路" 7 "输出缺相" 8 "控制器过温";

BO_ 2485976984 ZT_142CFF98: 8 Vector__XXX
 SG_ 输入电流 : 16|8@1+ (1,0) [0|0] "A" Vector__XXX
 SG_ 输出电流 : 24|8@1+ (1,0) [0|0] "A" Vector__XXX
 SG_ 控制器温度 : 32|8@1+ (1,-40) [0|0] "℃" Vector__XXX
 SG_ DCDC(直流转直流)输出辅助低压 : 40|8@1+ (1,0) [0|0] "V" Vector__XXX
 SG_ DCDC(直流转直流)控制器通信状态值 : 48|8@1+ (1,0) [0|0] "" Vector__XXX

BA_ "VFrameFormat" BO_ 2485976984 1;
CM_ BO_ 2485976984 "DCDC(直流转直流)控制器通信状态值 / DCDC(直流转直流)输出辅助低压 | 信号数 6";
CM_ SG_ 2485976984 输入电流 "输入电流";
CM_ SG_ 2485976984 输出电流 "输出电流";
CM_ SG_ 2485976984 控制器温度 "控制器温度";
CM_ SG_ 2485976984 DCDC(直流转直流)输出辅助低压 "DCDC(直流转直流)输出辅助低压";
CM_ SG_ 2485976984 DCDC(直流转直流)控制器通信状态值 "DCDC(直流转直流)控制器通信状态值";

BO_ 2486173589 ZT_142FFF95: 8 Vector__XXX
 SG_ 控制器当前受控状态反馈 : 62|1@1+ (1,0) [0|0] "" Vector__XXX
 SG_ 故障内容 : 56|4@1+ (1,0) [0|0] "" Vector__XXX
 SG_ 控制器电流 : 32|8@1+ (1,0) [0|0] "A" Vector__XXX
 SG_ 控制器温度 : 40|8@1+ (1,-40) [0|0] "℃" Vector__XXX
 SG_ 电助力控制器通信状态值 : 48|8@1+ (1,0) [0|0] "" Vector__XXX
 SG_ 总里程 : 7|16@0+ (0.125,0) [0|0] "Km" Vector__XXX

BA_ "VFrameFormat" BO_ 2486173589 1;
CM_ BO_ 2486173589 "总里程 / 控制器当前受控状态反馈 | 信号数 8";
CM_ SG_ 2486173589 控制器当前受控状态反馈 "控制器当前受控状态反馈 [枚举: 外部控制|内部控制]";
VAL_ 2486173589 控制器当前受控状态反馈 0 "内部控制" 1 "外部控制";
CM_ SG_ 2486173589 故障内容 "故障内容 [枚举: 输入过流|输入过压|输入欠压|过载保护|输入、输出断线|输入、输出短路|输出缺相|控制器过温|电机超速|电机过温|无效数据]";
VAL_ 2486173589 故障内容 1 "输入过流" 2 "输入过压" 3 "输入欠压" 4 "过载保护" 5 "输入、输出断线" 6 "输入、输出短路" 7 "输出缺相" 8 "控制器过温" 9 "电机超速" 10 "电机过温";
CM_ SG_ 2486173589 控制器电流 "控制器电流";
CM_ SG_ 2486173589 控制器温度 "控制器温度";
CM_ SG_ 2486173589 电助力控制器通信状态值 "电助力控制器通信状态值";
CM_ SG_ 2486173589 总里程 "总里程";

BO_ 2550193155 ZT_UNKNOWN_1800DC03: 8 Vector__XXX
 SG_ 字节0 : 0|8@1+ (1,0) [0|255] "" Vector__XXX
 SG_ 字节1 : 8|8@1+ (1,0) [0|255] "" Vector__XXX
 SG_ 字节2 : 16|8@1+ (1,0) [0|255] "" Vector__XXX
 SG_ 字节3 : 24|8@1+ (1,0) [0|255] "" Vector__XXX
 SG_ 字节4 : 32|8@1+ (1,0) [0|255] "" Vector__XXX
 SG_ 字节5 : 40|8@1+ (1,0) [0|255] "" Vector__XXX
 SG_ 字节6 : 48|8@1+ (1,0) [0|255] "" Vector__XXX
 SG_ 字节7 : 56|8@1+ (1,0) [0|255] "" Vector__XXX

BA_ "VFrameFormat" BO_ 2550193155 1;
CM_ BO_ 2550193155 "BMS 电池管理系统 | 无信号定义, 按原始字节输出";
CM_ SG_ 2550193155 字节0 "字节0（原始值，无信号定义）";
CM_ SG_ 2550193155 字节1 "字节1（原始值，无信号定义）";
CM_ SG_ 2550193155 字节2 "字节2（原始值，无信号定义）";
CM_ SG_ 2550193155 字节3 "字节3（原始值，无信号定义）";
CM_ SG_ 2550193155 字节4 "字节4（原始值，无信号定义）";
CM_ SG_ 2550193155 字节5 "字节5（原始值，无信号定义）";
CM_ SG_ 2550193155 字节6 "字节6（原始值，无信号定义）";
CM_ SG_ 2550193155 字节7 "字节7（原始值，无信号定义）";

BO_ 2550193411 ZT_UNKNOWN_1800DD03: 8 Vector__XXX
 SG_ 字节0 : 0|8@1+ (1,0) [0|255] "" Vector__XXX
 SG_ 字节1 : 8|8@1+ (1,0) [0|255] "" Vector__XXX
 SG_ 字节2 : 16|8@1+ (1,0) [0|255] "" Vector__XXX
 SG_ 字节3 : 24|8@1+ (1,0) [0|255] "" Vector__XXX
 SG_ 字节4 : 32|8@1+ (1,0) [0|255] "" Vector__XXX
 SG_ 字节5 : 40|8@1+ (1,0) [0|255] "" Vector__XXX
 SG_ 字节6 : 48|8@1+ (1,0) [0|255] "" Vector__XXX
 SG_ 字节7 : 56|8@1+ (1,0) [0|255] "" Vector__XXX

BA_ "VFrameFormat" BO_ 2550193411 1;
CM_ BO_ 2550193411 "BMS 电池管理系统 | 无信号定义, 按原始字节输出";
CM_ SG_ 2550193411 字节0 "字节0（原始值，无信号定义）";
CM_ SG_ 2550193411 字节1 "字节1（原始值，无信号定义）";
CM_ SG_ 2550193411 字节2 "字节2（原始值，无信号定义）";
CM_ SG_ 2550193411 字节3 "字节3（原始值，无信号定义）";
CM_ SG_ 2550193411 字节4 "字节4（原始值，无信号定义）";
CM_ SG_ 2550193411 字节5 "字节5（原始值，无信号定义）";
CM_ SG_ 2550193411 字节6 "字节6（原始值，无信号定义）";
CM_ SG_ 2550193411 字节7 "字节7（原始值，无信号定义）";

BO_ 2550245274 ZT_1801A79A: 8 Vector__XXX
 SG_ DCDC输入欠压 : 48|1@1+ (1,0) [0|0] "" Vector__XXX
 SG_ DCDC输入过压 : 49|1@1+ (1,0) [0|0] "" Vector__XXX
 SG_ DCDC输出状态 : 50|1@1+ (1,0) [0|0] "" Vector__XXX
 SG_ DCDC温度过高 : 52|1@1+ (1,0) [0|0] "" Vector__XXX
 SG_ DCDC短路 : 53|1@1+ (1,0) [0|0] "" Vector__XXX
 SG_ DC/DC输出电压 : 16|8@1+ (0.2,0) [0|50] "V" Vector__XXX
 SG_ DC/DC散热器温度 : 40|8@1+ (1,-40) [-40|210] "deg C" Vector__XXX
 SG_ DC/DC输入电压 : 0|16@1+ (1,0) [0|1000] "V" Vector__XXX
 SG_ DC/DC输出电流 : 24|16@1+ (0.01,0) [0|200] "A" Vector__XXX

BA_ "VFrameFormat" BO_ 2550245274 1;
CM_ BO_ 2550245274 "DC/DC散热器温度 / DC/DC输入电压 | 信号数 13";
CM_ SG_ 2550245274 DCDC输入欠压 "DCDC输入欠压 [枚举: 正常|故障]";
VAL_ 2550245274 DCDC输入欠压 0 "正常" 1 "故障";
CM_ SG_ 2550245274 DCDC输入过压 "DCDC输入过压 [枚举: 正常|故障]";
VAL_ 2550245274 DCDC输入过压 0 "正常" 1 "故障";
CM_ SG_ 2550245274 DCDC输出状态 "DCDC输出状态 [枚举: 正常|故障]";
VAL_ 2550245274 DCDC输出状态 0 "正常" 1 "故障";
CM_ SG_ 2550245274 DCDC温度过高 "DCDC温度过高 [枚举: 正常|故障]";
VAL_ 2550245274 DCDC温度过高 0 "正常" 1 "故障";
CM_ SG_ 2550245274 DCDC短路 "DCDC短路 [枚举: 正常|故障]";
VAL_ 2550245274 DCDC短路 0 "正常" 1 "故障";
CM_ SG_ 2550245274 DC/DC输出电压 "DC/DC输出电压";
CM_ SG_ 2550245274 DC/DC散热器温度 "DC/DC散热器温度";
CM_ SG_ 2550245274 DC/DC输入电压 "DC/DC输入电压";
CM_ SG_ 2550245274 DC/DC输出电流 "DC/DC输出电流";

BO_ 2550245275 ZT_1801A79B: 8 Vector__XXX
 SG_ 油泵输入欠压 : 56|1@1+ (1,0) [0|0] "" Vector__XXX
 SG_ 油泵输入过压 : 57|1@1+ (1,0) [0|0] "" Vector__XXX
 SG_ 油泵低压电源 : 58|1@1+ (1,0) [0|0] "" Vector__XXX
 SG_ 油泵温度过高 : 60|1@1+ (1,0) [0|0] "" Vector__XXX
 SG_ 油泵输出短路 : 61|1@1+ (1,0) [0|0] "" Vector__XXX
 SG_ 油泵输出过载 : 62|1@1+ (1,0) [0|0] "" Vector__XXX
 SG_ 油泵输出缺相 : 63|1@1+ (1,0) [0|0] "" Vector__XXX
 SG_ 油泵DC/AC 散热器温度 : 48|8@1+ (1,-40) [-40|210] "deg C" Vector__XXX
 SG_ 油泵DC/AC 输入电压 : 0|16@1+ (1,0) [0|1000] "V" Vector__XXX
 SG_ 油泵DC/AC 输出电压 : 16|16@1+ (1,0) [0|1000] "V" Vector__XXX
 SG_ 油泵DC/AC 输出电流 : 32|16@1+ (0.1,0) [0|100] "A" Vector__XXX

BA_ "VFrameFormat" BO_ 2550245275 1;
CM_ BO_ 2550245275 "DC/DC温度过高 / DC/DC输入欠压 | 信号数 22";
CM_ SG_ 2550245275 油泵输入欠压 "油泵输入欠压 [枚举: 正常|故障]";
VAL_ 2550245275 油泵输入欠压 0 "正常" 1 "故障";
CM_ SG_ 2550245275 油泵输入过压 "油泵输入过压 [枚举: 正常|故障]";
VAL_ 2550245275 油泵输入过压 0 "正常" 1 "故障";
CM_ SG_ 2550245275 油泵低压电源 "油泵低压电源 [枚举: 正常|故障]";
VAL_ 2550245275 油泵低压电源 0 "正常" 1 "故障";
CM_ SG_ 2550245275 油泵温度过高 "油泵温度过高 [枚举: 正常|故障]";
VAL_ 2550245275 油泵温度过高 0 "正常" 1 "故障";
CM_ SG_ 2550245275 油泵输出短路 "油泵输出短路 [枚举: 正常|故障]";
VAL_ 2550245275 油泵输出短路 0 "正常" 1 "故障";
CM_ SG_ 2550245275 油泵输出过载 "油泵输出过载 [枚举: 正常|故障]";
VAL_ 2550245275 油泵输出过载 0 "正常" 1 "故障";
CM_ SG_ 2550245275 油泵输出缺相 "油泵输出缺相 [枚举: 正常|故障]";
VAL_ 2550245275 油泵输出缺相 0 "正常" 1 "故障";
CM_ SG_ 2550245275 油泵DC/AC 散热器温度 "油泵DC/AC 散热器温度";
CM_ SG_ 2550245275 油泵DC/AC 输入电压 "油泵DC/AC 输入电压";
CM_ SG_ 2550245275 油泵DC/AC 输出电压 "油泵DC/AC 输出电压";
CM_ SG_ 2550245275 油泵DC/AC 输出电流 "油泵DC/AC 输出电流";

BO_ 2550245276 ZT_1801A79C: 8 Vector__XXX
 SG_ DCDC输入欠压 : 48|1@1+ (1,0) [0|1] "" Vector__XXX
 SG_ DCDC输入过压 : 49|1@1+ (1,0) [0|1] "" Vector__XXX
 SG_ DCDC输出状态 : 50|1@1+ (1,0) [0|1] "" Vector__XXX
 SG_ DCDC温度过高 : 52|1@1+ (1,0) [0|1] "" Vector__XXX
 SG_ DCDC短路 : 53|1@1+ (1,0) [0|1] "" Vector__XXX
 SG_ 输出电压 : 16|8@1+ (1,0) [0|50] "V" Vector__XXX
 SG_ 散热器温度 : 40|8@1+ (1,-40) [-40|210] "℃" Vector__XXX
 SG_ 输入电压 : 0|16@1+ (1,0) [0|1000] "V" Vector__XXX
 SG_ 输出电流 : 24|16@1+ (1,0) [0|200] "A" Vector__XXX

BA_ "VFrameFormat" BO_ 2550245276 1;
CM_ BO_ 2550245276 "DCDC温度过高 / DCDC短路 | 信号数 9";
CM_ SG_ 2550245276 DCDC输入欠压 "DCDC输入欠压 [枚举: 正常|故障]";
VAL_ 2550245276 DCDC输入欠压 0 "正常" 1 "故障";
CM_ SG_ 2550245276 DCDC输入过压 "DCDC输入过压 [枚举: 正常|故障]";
VAL_ 2550245276 DCDC输入过压 0 "正常" 1 "故障";
CM_ SG_ 2550245276 DCDC输出状态 "DCDC输出状态 [枚举: 正常|故障]";
VAL_ 2550245276 DCDC输出状态 0 "正常" 1 "故障";
CM_ SG_ 2550245276 DCDC温度过高 "DCDC温度过高 [枚举: 正常|故障]";
VAL_ 2550245276 DCDC温度过高 0 "正常" 1 "故障";
CM_ SG_ 2550245276 DCDC短路 "DCDC短路 [枚举: 正常|故障]";
VAL_ 2550245276 DCDC短路 0 "正常" 1 "故障";
CM_ SG_ 2550245276 输出电压 "输出电压";
CM_ SG_ 2550245276 散热器温度 "散热器温度";
CM_ SG_ 2550245276 输入电压 "输入电压";
CM_ SG_ 2550245276 输出电流 "输出电流";

BO_ 2550245277 ZT_1801A79D: 8 Vector__XXX
 SG_ 气泵输入欠压 : 56|1@1+ (1,0) [0|0] "" Vector__XXX
 SG_ 气泵输入过压 : 57|1@1+ (1,0) [0|0] "" Vector__XXX
 SG_ 气泵低压电源 : 58|1@1+ (1,0) [0|0] "" Vector__XXX
 SG_ 气泵温度过高 : 60|1@1+ (1,0) [0|0] "" Vector__XXX
 SG_ 气泵输出短路 : 61|1@1+ (1,0) [0|0] "" Vector__XXX
 SG_ 气泵输出过载 : 62|1@1+ (1,0) [0|0] "" Vector__XXX
 SG_ 气泵输出缺相 : 63|1@1+ (1,0) [0|0] "" Vector__XXX
 SG_ 气泵 DC/AC 散热器温度 : 48|8@1+ (1,-40) [-40|200] "deg C" Vector__XXX
 SG_ 气泵 DC/AC 输入电压 : 0|16@1+ (1,0) [0|1000] "V" Vector__XXX
 SG_ 气泵 DC/AC 输出电压 : 16|16@1+ (1,0) [0|1000] "V" Vector__XXX
 SG_ 气泵 DC/AC 输出电流 : 32|16@1+ (0.1,0) [0|100] "A" Vector__XXX

BA_ "VFrameFormat" BO_ 2550245277 1;
CM_ BO_ 2550245277 "保留-1 / 打气泵低压电源 | 信号数 12";
CM_ SG_ 2550245277 气泵输入欠压 "气泵输入欠压 [枚举: 正常|故障]";
VAL_ 2550245277 气泵输入欠压 0 "正常" 1 "故障";
CM_ SG_ 2550245277 气泵输入过压 "气泵输入过压 [枚举: 正常|故障]";
VAL_ 2550245277 气泵输入过压 0 "正常" 1 "故障";
CM_ SG_ 2550245277 气泵低压电源 "气泵低压电源 [枚举: 正常|故障]";
VAL_ 2550245277 气泵低压电源 0 "正常" 1 "故障";
CM_ SG_ 2550245277 气泵温度过高 "气泵温度过高 [枚举: 正常|故障]";
VAL_ 2550245277 气泵温度过高 0 "正常" 1 "故障";
CM_ SG_ 2550245277 气泵输出短路 "气泵输出短路 [枚举: 正常|故障]";
VAL_ 2550245277 气泵输出短路 0 "正常" 1 "故障";
CM_ SG_ 2550245277 气泵输出过载 "气泵输出过载 [枚举: 正常|故障]";
VAL_ 2550245277 气泵输出过载 0 "正常" 1 "故障";
CM_ SG_ 2550245277 气泵输出缺相 "气泵输出缺相 [枚举: 正常|故障]";
VAL_ 2550245277 气泵输出缺相 0 "正常" 1 "故障";
CM_ SG_ 2550245277 气泵 DC/AC 散热器温度 "气泵 DC/AC 散热器温度";
CM_ SG_ 2550245277 气泵 DC/AC 输入电压 "气泵 DC/AC 输入电压";
CM_ SG_ 2550245277 气泵 DC/AC 输出电压 "气泵 DC/AC 输出电压";
CM_ SG_ 2550245277 气泵 DC/AC 输出电流 "气泵 DC/AC 输出电流";

BO_ 2550245279 ZT_1801A79F: 8 Vector__XXX
 SG_ DCDC接触器状态-1 : 6|2@1+ (1,0) [0|3] "" Vector__XXX
 SG_ DCDC接触器状态 : 40|2@1+ (1,0) [0|5] "" Vector__XXX
 SG_ 发电机接触器状态 : 60|2@1+ (1,0) [0|5] "" Vector__XXX
 SG_ 发电机预充接触器状态 : 62|2@1+ (1,0) [0|5] "" Vector__XXX
 SG_ 充电正接触器状态 : 48|4@1+ (1,0) [0|5] "" Vector__XXX
 SG_ 充电负接触器状态 : 52|4@1+ (1,0) [0|5] "" Vector__XXX
 SG_ 主负接触器状态 : 56|4@1+ (1,0) [0|5] "" Vector__XXX
 SG_ 故障码汇总 : 32|8@1+ (1,0) [0|16] "" Vector__XXX
 SG_ 空调接触器状态 : 0|2@1+ (1,0) [0|3] "" Vector__XXX
 SG_ 除霜接触器状态 : 2|2@1+ (1,0) [0|3] "" Vector__XXX
 SG_ 电暖风接触器状态 : 4|2@1+ (1,0) [0|3] "" Vector__XXX
 SG_ 主正接触器状态(BMS只控主负时用) : 10|2@1+ (1,0) [0|3] "" Vector__XXX
 SG_ (18米车双空调时用) : 12|2@1+ (1,0) [0|3] "" Vector__XXX
 SG_ 交流充电 : 44|4@1+ (1,0) [0|0] "" Vector__XXX
 SG_ 主正前端电压 : 16|16@1+ (0.1,0) [0|100] "" Vector__XXX

BA_ "VFrameFormat" BO_ 2550245279 1;
CM_ BO_ 2550245279 "(18米车双空调时用) / DCDC接触器状态 | 信号数 16";
CM_ SG_ 2550245279 DCDC接触器状态-1 "DCDC接触器状态-1 [枚举: 断开|闭合|状态监测中|异常（含1、继电器指令吸合给定后,但继 电器未吸合；2、继电器弹跳；3、黏连）]";
VAL_ 2550245279 DCDC接触器状态-1 0 "断开" 1 "闭合" 2 "状态监测中" 3 "异常（含1、继电器指令吸合给定后,但继 电器未吸合；2、继电器弹跳；3、黏连）";
CM_ SG_ 2550245279 DCDC接触器状态 "DCDC接触器状态 [枚举: 断开|闭合|检测中|粘连|弹跳|未执行吸合指令]";
VAL_ 2550245279 DCDC接触器状态 0 "断开" 1 "闭合" 2 "检测中" 3 "粘连" 4 "弹跳" 5 "未执行吸合指令";
CM_ SG_ 2550245279 发电机接触器状态 "发电机接触器状态 [枚举: 断开|闭合|检测中|粘连|弹跳|未执行吸合指令]";
VAL_ 2550245279 发电机接触器状态 0 "断开" 1 "闭合" 2 "检测中" 3 "粘连" 4 "弹跳" 5 "未执行吸合指令";
CM_ SG_ 2550245279 发电机预充接触器状态 "发电机预充接触器状态 [枚举: 断开|闭合|检测中|粘连|弹跳|未执行吸合指令]";
VAL_ 2550245279 发电机预充接触器状态 0 "断开" 1 "闭合" 2 "检测中" 3 "粘连" 4 "弹跳" 5 "未执行吸合指令";
CM_ SG_ 2550245279 充电正接触器状态 "充电正接触器状态 [枚举: 断开|闭合|检测中|粘连|弹跳|未执行吸合指令]";
VAL_ 2550245279 充电正接触器状态 0 "断开" 1 "闭合" 2 "检测中" 3 "粘连" 4 "弹跳" 5 "未执行吸合指令";
CM_ SG_ 2550245279 充电负接触器状态 "充电负接触器状态 [枚举: 断开|闭合|检测中|粘连|弹跳|未执行吸合指令]";
VAL_ 2550245279 充电负接触器状态 0 "断开" 1 "闭合" 2 "检测中" 3 "粘连" 4 "弹跳" 5 "未执行吸合指令";
CM_ SG_ 2550245279 主负接触器状态 "主负接触器状态 [枚举: 断开|闭合|检测中|粘连|弹跳|未执行吸合指令]";
VAL_ 2550245279 主负接触器状态 0 "断开" 1 "闭合" 2 "检测中" 3 "粘连" 4 "弹跳" 5 "未执行吸合指令";
CM_ SG_ 2550245279 故障码汇总 "故障码汇总 [枚举: 无故障|主正接触器预充失败|辅驱接触器预充失败|VCU报文丢失|BMS报文丢失|VCU报文校验错误|Can通信故障|自检故障|异常下电|24V低于15V]";
VAL_ 2550245279 故障码汇总 0 "无故障" 1 "主正接触器预充失败" 2 "辅驱接触器预充失败" 3 "VCU报文丢失" 4 "BMS报文丢失" 5 "VCU报文校验错误" 6 "Can通信故障" 7 "自检故障" 8 "异常下电" 9 "24V低于15V";
CM_ SG_ 2550245279 空调接触器状态 "空调接触器状态";
CM_ SG_ 2550245279 除霜接触器状态 "除霜接触器状态";
CM_ SG_ 2550245279 电暖风接触器状态 "电暖风接触器状态";
CM_ SG_ 2550245279 主正接触器状态(BMS只控主负时用) "主正接触器状态(BMS只控主负时用)";
CM_ SG_ 2550245279 (18米车双空调时用) "(18米车双空调时用)";
CM_ SG_ 2550245279 交流充电 "交流充电";
CM_ SG_ 2550245279 主正前端电压 "主正前端电压";

BO_ 2550245530 ZT_1801A89A: 8 Vector__XXX
 SG_ DC/DC 状态 1 : 24|2@1+ (1,0) [0|0] "" Vector__XXX
 SG_ DC/DC 输出切断 : 26|2@1+ (1,0) [0|0] "" Vector__XXX
 SG_ DC/DC 输入切断 : 28|2@1+ (1,0) [0|0] "" Vector__XXX
 SG_ DC/DC 故障等级 : 40|3@1+ (1,0) [0|0] "" Vector__XXX
 SG_ DC/DC 状态 2 : 48|8@1+ (1,0) [0|0] "" Vector__XXX

BA_ "VFrameFormat" BO_ 2550245530 1;
CM_ BO_ 2550245530 "DC/DC 故障等级 / DC/DC 状态 1 | 信号数 11";
CM_ SG_ 2550245530 DC/DC 状态 1 "DC/DC 状态 1 [枚举: 停机|预充电中|预充电完成|运行]";
VAL_ 2550245530 DC/DC 状态 1 0 "停机" 1 "预充电中" 2 "预充电完成" 3 "运行";
CM_ SG_ 2550245530 DC/DC 输出切断 "DC/DC 输出切断 [枚举: 无效|有效|错误|未定义]";
VAL_ 2550245530 DC/DC 输出切断 0 "无效" 1 "有效" 2 "错误" 3 "未定义";
CM_ SG_ 2550245530 DC/DC 输入切断 "DC/DC 输入切断 [枚举: 无效|有效|错误|未定义]";
VAL_ 2550245530 DC/DC 输入切断 0 "无效" 1 "有效" 2 "错误" 3 "未定义";
CM_ SG_ 2550245530 DC/DC 故障等级 "DC/DC 故障等级 [枚举: 无故障|一级故障|二级故障|三级故障|四级故障]";
VAL_ 2550245530 DC/DC 故障等级 0 "无故障" 1 "一级故障" 2 "二级故障" 3 "三级故障" 4 "四级故障";
CM_ SG_ 2550245530 DC/DC 状态 2 "DC/DC 状态 2 [原始公式: if((BYTE[6])==1) 0; else if((BYTE[6])==2) 1; else if((BYTE[6])==254) 2; else if((BYTE[6])==255) 3; else 4] [枚举: 工作|断开|异常|无效|预留]";

BO_ 2550245532 ZT_1801A89C: 8 Vector__XXX
 SG_ DC/DC 状态 1 : 24|2@1+ (1,0) [0|3] "" Vector__XXX
 SG_ 输出切断 : 26|2@1+ (1,0) [0|3] "" Vector__XXX
 SG_ 输入切断 : 28|2@1+ (1,0) [0|3] "" Vector__XXX
 SG_ 故障等级 : 40|3@1+ (1,0) [0|7] "" Vector__XXX
 SG_ DC/DC 状态 2 : 48|8@1+ (1,0) [0|255] "" Vector__XXX
 SG_ 保留-2 : 0|24@1+ (1,0) [0|16777215] "" Vector__XXX

BA_ "VFrameFormat" BO_ 2550245532 1;
CM_ BO_ 2550245532 "DC/DC 状态 1 / DC/DC 状态 2 | 信号数 7";
CM_ SG_ 2550245532 DC/DC 状态 1 "DC/DC 状态 1 [枚举: 停机|预充电中|预充电完成|运行]";
VAL_ 2550245532 DC/DC 状态 1 0 "停机" 1 "预充电中" 2 "预充电完成" 3 "运行";
CM_ SG_ 2550245532 输出切断 "输出切断 [枚举: 无效|有效|错误|未定义]";
VAL_ 2550245532 输出切断 0 "无效" 1 "有效" 2 "错误" 3 "未定义";
CM_ SG_ 2550245532 输入切断 "输入切断 [枚举: 无效|有效|错误|未定义]";
VAL_ 2550245532 输入切断 0 "无效" 1 "有效" 2 "错误" 3 "未定义";
CM_ SG_ 2550245532 故障等级 "故障等级 [枚举: 无故障|一级故障|二级故障|三级故障|四级故障]";
VAL_ 2550245532 故障等级 0 "无故障" 1 "一级故障" 2 "二级故障" 3 "三级故障" 4 "四级故障";
CM_ SG_ 2550245532 DC/DC 状态 2 "DC/DC 状态 2 [原始公式: if((BYTE[6])==1) 0; else if((BYTE[6])==2) 1; else if((BYTE[6])==254) 2; else if((BYTE[6])==255) 3; else 4] [枚举: 工作|断开|异常|无效|预留]";
CM_ SG_ 2550245532 保留-2 "保留-2";

BO_ 2550255831 ZT_1801D0D7: 8 Vector__XXX
 SG_ 绝缘模块故障状态 : 48|8@1+ (1,0) [0|0] "" Vector__XXX
 SG_ 绝缘检测Life值 : 40|8@1+ (1,0) [0|0] "" Vector__XXX
 SG_ 正端对地绝缘电阻 : 0|16@1+ (1,0) [0|0] "KΩ" Vector__XXX
 SG_ 负端对地绝缘电阻 : 16|16@1+ (1,0) [0|0] "KΩ" Vector__XXX

BA_ "VFrameFormat" BO_ 2550255831 1;
CM_ BO_ 2550255831 "正端对地绝缘电阻 / 绝缘检测Life值 | 信号数 4";
CM_ SG_ 2550255831 绝缘模块故障状态 "绝缘模块故障状态 [枚举: 故障|正常|无效数据]";
VAL_ 2550255831 绝缘模块故障状态 85 "故障" 170 "正常";
CM_ SG_ 2550255831 绝缘检测Life值 "绝缘检测Life值";
CM_ SG_ 2550255831 正端对地绝缘电阻 "正端对地绝缘电阻";
CM_ SG_ 2550255831 负端对地绝缘电阻 "负端对地绝缘电阻";

BO_ 2550256115 ZT_1801D1F3: 8 Vector__XXX
 SG_ 电压1 : 0|8@1+ (1,0) [0|0] "V" Vector__XXX
 SG_ 电压2 : 16|8@1+ (1,0) [0|0] "V" Vector__XXX
 SG_ 电压3 : 32|8@1+ (1,0) [0|0] "V" Vector__XXX
 SG_ 电压4 : 48|8@1+ (1,0) [0|0] "V" Vector__XXX

BA_ "VFrameFormat" BO_ 2550256115 1;
CM_ BO_ 2550256115 "电压1 / 电压2 | 信号数 4";
CM_ SG_ 2550256115 电压1 "电压1 [原始公式: (x1+x2%16*256)/1000.000]";
CM_ SG_ 2550256115 电压2 "电压2 [原始公式: (x1+x2%16*256)/1000.000]";
CM_ SG_ 2550256115 电压3 "电压3 [原始公式: (x1+x2%16*256)/1000.000]";
CM_ SG_ 2550256115 电压4 "电压4 [原始公式: (x1+x2%16*256)/1000.000]";

BO_ 2550258691 ZT_1801DC03: 8 Vector__XXX
 SG_ 单体电池电压11 : 16|8@1+ (0.02,0) [0|5] "V" Vector__XXX
 SG_ 单体电池电压12 : 24|8@1+ (0.02,0) [0|5] "V" Vector__XXX
 SG_ 单体电池电压13 : 32|8@1+ (0.02,0) [0|5] "V" Vector__XXX
 SG_ 单体电池电压14 : 40|8@1+ (0.02,0) [0|5] "V" Vector__XXX
 SG_ 单体电池电压15 : 48|8@1+ (0.02,0) [0|5] "V" Vector__XXX
 SG_ 单体电池电压16 : 56|8@1+ (0.02,0) [0|5] "V" Vector__XXX

BA_ "VFrameFormat" BO_ 2550258691 1;
CM_ BO_ 2550258691 "单体电池电压11 / 单体电池电压12 | 信号数 6";
CM_ SG_ 2550258691 单体电池电压11 "单体电池电压11";
CM_ SG_ 2550258691 单体电池电压12 "单体电池电压12";
CM_ SG_ 2550258691 单体电池电压13 "单体电池电压13";
CM_ SG_ 2550258691 单体电池电压14 "单体电池电压14";
CM_ SG_ 2550258691 单体电池电压15 "单体电池电压15";
CM_ SG_ 2550258691 单体电池电压16 "单体电池电压16";

BO_ 2550258947 ZT_1801DD03: 8 Vector__XXX
 SG_ 单体电池温度9 : 0|8@1+ (1,-40) [-40|215] "℃" Vector__XXX
 SG_ 单体电池温度10 : 8|8@1+ (1,-40) [-40|215] "℃" Vector__XXX
 SG_ 单体电池温度11 : 16|8@1+ (1,-40) [-40|215] "℃" Vector__XXX
 SG_ 单体电池温度12 : 24|8@1+ (1,-40) [-40|215] "℃" Vector__XXX
 SG_ 单体电池温度13 : 32|8@1+ (1,-40) [-40|215] "℃" Vector__XXX
 SG_ 单体电池温度14 : 40|8@1+ (1,-40) [-40|215] "℃" Vector__XXX
 SG_ 单体电池温度15 : 48|8@1+ (1,-40) [-40|215] "℃" Vector__XXX
 SG_ 单体电池温度16 : 56|8@1+ (1,-40) [-40|215] "℃" Vector__XXX

BA_ "VFrameFormat" BO_ 2550258947 1;
CM_ BO_ 2550258947 "单体电池温度10 / 单体电池温度11 | 信号数 8";
CM_ SG_ 2550258947 单体电池温度9 "单体电池温度9";
CM_ SG_ 2550258947 单体电池温度10 "单体电池温度10";
CM_ SG_ 2550258947 单体电池温度11 "单体电池温度11";
CM_ SG_ 2550258947 单体电池温度12 "单体电池温度12";
CM_ SG_ 2550258947 单体电池温度13 "单体电池温度13";
CM_ SG_ 2550258947 单体电池温度14 "单体电池温度14";
CM_ SG_ 2550258947 单体电池温度15 "单体电池温度15";
CM_ SG_ 2550258947 单体电池温度16 "单体电池温度16";

BO_ 2550321651 ZT_1802D1F3: 8 Vector__XXX
 SG_ 电压5 : 0|8@1+ (1,0) [0|0] "V" Vector__XXX
 SG_ 电压6 : 16|8@1+ (1,0) [0|0] "V" Vector__XXX
 SG_ 电压7 : 32|8@1+ (1,0) [0|0] "V" Vector__XXX
 SG_ 电压8 : 48|8@1+ (1,0) [0|0] "V" Vector__XXX

BA_ "VFrameFormat" BO_ 2550321651 1;
CM_ BO_ 2550321651 "电压5 / 电压6 | 信号数 4";
CM_ SG_ 2550321651 电压5 "电压5 [原始公式: (x1+x2%16*256)/1000.000]";
CM_ SG_ 2550321651 电压6 "电压6 [原始公式: (x1+x2%16*256)/1000.000]";
CM_ SG_ 2550321651 电压7 "电压7 [原始公式: (x1+x2%16*256)/1000.000]";
CM_ SG_ 2550321651 电压8 "电压8 [原始公式: (x1+x2%16*256)/1000.000]";

BO_ 2550324227 ZT_1802DC03: 8 Vector__XXX
 SG_ 单体电池电压17 : 0|8@1+ (0.02,0) [0|5] "V" Vector__XXX
 SG_ 单体电池电压18 : 8|8@1+ (0.02,0) [0|5] "V" Vector__XXX
 SG_ 单体电池电压19 : 16|8@1+ (0.02,0) [0|5] "V" Vector__XXX
 SG_ 单体电池电压20 : 24|8@1+ (0.02,0) [0|5] "V" Vector__XXX
 SG_ 单体电池电压21 : 32|8@1+ (0.02,0) [0|5] "V" Vector__XXX
 SG_ 单体电池电压22 : 40|8@1+ (0.02,0) [0|5] "V" Vector__XXX
 SG_ 单体电池电压23 : 48|8@1+ (0.02,0) [0|5] "V" Vector__XXX
 SG_ 单体电池电压24 : 56|8@1+ (0.02,0) [0|5] "V" Vector__XXX

BA_ "VFrameFormat" BO_ 2550324227 1;
CM_ BO_ 2550324227 "单体电池电压17 / 单体电池电压18 | 信号数 8";
CM_ SG_ 2550324227 单体电池电压17 "单体电池电压17";
CM_ SG_ 2550324227 单体电池电压18 "单体电池电压18";
CM_ SG_ 2550324227 单体电池电压19 "单体电池电压19";
CM_ SG_ 2550324227 单体电池电压20 "单体电池电压20";
CM_ SG_ 2550324227 单体电池电压21 "单体电池电压21";
CM_ SG_ 2550324227 单体电池电压22 "单体电池电压22";
CM_ SG_ 2550324227 单体电池电压23 "单体电池电压23";
CM_ SG_ 2550324227 单体电池电压24 "单体电池电压24";

BO_ 2550324483 ZT_1802DD03: 8 Vector__XXX
 SG_ 单体电池温度17 : 0|8@1+ (1,-40) [-40|215] "℃" Vector__XXX
 SG_ 单体电池温度18 : 8|8@1+ (1,-40) [-40|215] "℃" Vector__XXX
 SG_ 单体电池温度19 : 16|8@1+ (1,-40) [-40|215] "℃" Vector__XXX
 SG_ 单体电池温度20 : 24|8@1+ (1,-40) [-40|215] "℃" Vector__XXX
 SG_ 单体电池温度21 : 32|8@1+ (1,-40) [-40|215] "℃" Vector__XXX
 SG_ 单体电池温度22 : 40|8@1+ (1,-40) [-40|215] "℃" Vector__XXX
 SG_ 单体电池温度23 : 48|8@1+ (1,-40) [-40|215] "℃" Vector__XXX
 SG_ 单体电池温度24 : 56|8@1+ (1,-40) [-40|215] "℃" Vector__XXX

BA_ "VFrameFormat" BO_ 2550324483 1;
CM_ BO_ 2550324483 "单体电池温度17 / 单体电池温度18 | 信号数 8";
CM_ SG_ 2550324483 单体电池温度17 "单体电池温度17";
CM_ SG_ 2550324483 单体电池温度18 "单体电池温度18";
CM_ SG_ 2550324483 单体电池温度19 "单体电池温度19";
CM_ SG_ 2550324483 单体电池温度20 "单体电池温度20";
CM_ SG_ 2550324483 单体电池温度21 "单体电池温度21";
CM_ SG_ 2550324483 单体电池温度22 "单体电池温度22";
CM_ SG_ 2550324483 单体电池温度23 "单体电池温度23";
CM_ SG_ 2550324483 单体电池温度24 "单体电池温度24";

BO_ 2550387187 ZT_1803D1F3: 8 Vector__XXX
 SG_ 电压9 : 0|8@1+ (1,0) [0|0] "V" Vector__XXX
 SG_ 电压10 : 16|8@1+ (1,0) [0|0] "V" Vector__XXX
 SG_ 电压11 : 32|8@1+ (1,0) [0|0] "V" Vector__XXX
 SG_ 电压12 : 48|8@1+ (1,0) [0|0] "V" Vector__XXX

BA_ "VFrameFormat" BO_ 2550387187 1;
CM_ BO_ 2550387187 "电压10 / 电压11 | 信号数 4";
CM_ SG_ 2550387187 电压9 "电压9 [原始公式: (x1+x2%16*256)/1000.000]";
CM_ SG_ 2550387187 电压10 "电压10 [原始公式: (x1+x2%16*256)/1000.000]";
CM_ SG_ 2550387187 电压11 "电压11 [原始公式: (x1+x2%16*256)/1000.000]";
CM_ SG_ 2550387187 电压12 "电压12 [原始公式: (x1+x2%16*256)/1000.000]";

BO_ 2550389763 ZT_1803DC03: 8 Vector__XXX
 SG_ 单体电池电压25 : 0|8@1+ (0.02,0) [0|5] "V" Vector__XXX
 SG_ 单体电池电压26 : 8|8@1+ (0.02,0) [0|5] "V" Vector__XXX
 SG_ 单体电池电压27 : 16|8@1+ (0.02,0) [0|5] "V" Vector__XXX
 SG_ 单体电池电压28 : 24|8@1+ (0.02,0) [0|5] "V" Vector__XXX
 SG_ 单体电池电压29 : 32|8@1+ (0.02,0) [0|5] "V" Vector__XXX
 SG_ 单体电池电压30 : 40|8@1+ (0.02,0) [0|5] "V" Vector__XXX
 SG_ 单体电池电压31 : 48|8@1+ (0.02,0) [0|5] "V" Vector__XXX
 SG_ 单体电池电压32 : 56|8@1+ (0.02,0) [0|5] "V" Vector__XXX

BA_ "VFrameFormat" BO_ 2550389763 1;
CM_ BO_ 2550389763 "单体电池电压25 / 单体电池电压26 | 信号数 8";
CM_ SG_ 2550389763 单体电池电压25 "单体电池电压25";
CM_ SG_ 2550389763 单体电池电压26 "单体电池电压26";
CM_ SG_ 2550389763 单体电池电压27 "单体电池电压27";
CM_ SG_ 2550389763 单体电池电压28 "单体电池电压28";
CM_ SG_ 2550389763 单体电池电压29 "单体电池电压29";
CM_ SG_ 2550389763 单体电池电压30 "单体电池电压30";
CM_ SG_ 2550389763 单体电池电压31 "单体电池电压31";
CM_ SG_ 2550389763 单体电池电压32 "单体电池电压32";

BO_ 2550390019 ZT_1803DD03: 8 Vector__XXX
 SG_ 单体电池温度25 : 0|8@1+ (1,-40) [-40|215] "℃" Vector__XXX
 SG_ 单体电池温度26 : 8|8@1+ (1,-40) [-40|215] "℃" Vector__XXX
 SG_ 单体电池温度27 : 16|8@1+ (1,-40) [-40|215] "℃" Vector__XXX
 SG_ 单体电池温度28 : 24|8@1+ (1,-40) [-40|215] "℃" Vector__XXX
 SG_ 单体电池温度29 : 32|8@1+ (1,-40) [-40|215] "℃" Vector__XXX
 SG_ 单体电池温度30 : 40|8@1+ (1,-40) [-40|215] "℃" Vector__XXX
 SG_ 单体电池温度31 : 48|8@1+ (1,-40) [-40|215] "℃" Vector__XXX
 SG_ 单体电池温度32 : 56|8@1+ (1,-40) [-40|215] "℃" Vector__XXX

BA_ "VFrameFormat" BO_ 2550390019 1;
CM_ BO_ 2550390019 "单体电池温度25 / 单体电池温度26 | 信号数 8";
CM_ SG_ 2550390019 单体电池温度25 "单体电池温度25";
CM_ SG_ 2550390019 单体电池温度26 "单体电池温度26";
CM_ SG_ 2550390019 单体电池温度27 "单体电池温度27";
CM_ SG_ 2550390019 单体电池温度28 "单体电池温度28";
CM_ SG_ 2550390019 单体电池温度29 "单体电池温度29";
CM_ SG_ 2550390019 单体电池温度30 "单体电池温度30";
CM_ SG_ 2550390019 单体电池温度31 "单体电池温度31";
CM_ SG_ 2550390019 单体电池温度32 "单体电池温度32";

BO_ 2550452723 ZT_1804D1F3: 8 Vector__XXX
 SG_ 电压13 : 0|8@1+ (1,0) [0|0] "V" Vector__XXX
 SG_ 电压14 : 16|8@1+ (1,0) [0|0] "V" Vector__XXX
 SG_ 电压15 : 32|8@1+ (1,0) [0|0] "V" Vector__XXX
 SG_ 电压16 : 48|8@1+ (1,0) [0|0] "V" Vector__XXX

BA_ "VFrameFormat" BO_ 2550452723 1;
CM_ BO_ 2550452723 "电压13 / 电压14 | 信号数 4";
CM_ SG_ 2550452723 电压13 "电压13 [原始公式: (x1+x2%16*256)/1000.000]";
CM_ SG_ 2550452723 电压14 "电压14 [原始公式: (x1+x2%16*256)/1000.000]";
CM_ SG_ 2550452723 电压15 "电压15 [原始公式: (x1+x2%16*256)/1000.000]";
CM_ SG_ 2550452723 电压16 "电压16 [原始公式: (x1+x2%16*256)/1000.000]";

BO_ 2550455299 ZT_1804DC03: 8 Vector__XXX
 SG_ 单体电池电压33 : 0|8@1+ (0.02,0) [0|5] "V" Vector__XXX
 SG_ 单体电池电压34 : 8|8@1+ (0.02,0) [0|5] "V" Vector__XXX
 SG_ 单体电池电压35 : 16|8@1+ (0.02,0) [0|5] "V" Vector__XXX
 SG_ 单体电池电压36 : 24|8@1+ (0.02,0) [0|5] "V" Vector__XXX
 SG_ 单体电池电压37 : 32|8@1+ (0.02,0) [0|5] "V" Vector__XXX
 SG_ 单体电池电压38 : 40|8@1+ (0.02,0) [0|5] "V" Vector__XXX
 SG_ 单体电池电压39 : 48|8@1+ (0.02,0) [0|5] "V" Vector__XXX
 SG_ 单体电池电压40 : 56|8@1+ (0.02,0) [0|5] "V" Vector__XXX

BA_ "VFrameFormat" BO_ 2550455299 1;
CM_ BO_ 2550455299 "单体电池电压33 / 单体电池电压34 | 信号数 8";
CM_ SG_ 2550455299 单体电池电压33 "单体电池电压33";
CM_ SG_ 2550455299 单体电池电压34 "单体电池电压34";
CM_ SG_ 2550455299 单体电池电压35 "单体电池电压35";
CM_ SG_ 2550455299 单体电池电压36 "单体电池电压36";
CM_ SG_ 2550455299 单体电池电压37 "单体电池电压37";
CM_ SG_ 2550455299 单体电池电压38 "单体电池电压38";
CM_ SG_ 2550455299 单体电池电压39 "单体电池电压39";
CM_ SG_ 2550455299 单体电池电压40 "单体电池电压40";

BO_ 2550455555 ZT_1804DD03: 8 Vector__XXX
 SG_ 单体电池温度33 : 0|8@1+ (1,-40) [-40|215] "℃" Vector__XXX
 SG_ 单体电池温度34 : 8|8@1+ (1,-40) [-40|215] "℃" Vector__XXX
 SG_ 单体电池温度35 : 16|8@1+ (1,-40) [-40|215] "℃" Vector__XXX
 SG_ 单体电池温度36 : 24|8@1+ (1,-40) [-40|215] "℃" Vector__XXX
 SG_ 单体电池温度37 : 32|8@1+ (1,-40) [-40|215] "℃" Vector__XXX
 SG_ 单体电池温度38 : 40|8@1+ (1,-40) [-40|215] "℃" Vector__XXX
 SG_ 单体电池温度39 : 48|8@1+ (1,-40) [-40|215] "℃" Vector__XXX
 SG_ 单体电池温度40 : 56|8@1+ (1,-40) [-40|215] "℃" Vector__XXX

BA_ "VFrameFormat" BO_ 2550455555 1;
CM_ BO_ 2550455555 "单体电池温度33 / 单体电池温度34 | 信号数 8";
CM_ SG_ 2550455555 单体电池温度33 "单体电池温度33";
CM_ SG_ 2550455555 单体电池温度34 "单体电池温度34";
CM_ SG_ 2550455555 单体电池温度35 "单体电池温度35";
CM_ SG_ 2550455555 单体电池温度36 "单体电池温度36";
CM_ SG_ 2550455555 单体电池温度37 "单体电池温度37";
CM_ SG_ 2550455555 单体电池温度38 "单体电池温度38";
CM_ SG_ 2550455555 单体电池温度39 "单体电池温度39";
CM_ SG_ 2550455555 单体电池温度40 "单体电池温度40";

BO_ 2550518259 ZT_1805D1F3: 8 Vector__XXX
 SG_ 电压17 : 0|8@1+ (1,0) [0|0] "V" Vector__XXX
 SG_ 电压18 : 16|8@1+ (1,0) [0|0] "V" Vector__XXX
 SG_ 电压19 : 32|8@1+ (1,0) [0|0] "V" Vector__XXX
 SG_ 电压20 : 48|8@1+ (1,0) [0|0] "V" Vector__XXX

BA_ "VFrameFormat" BO_ 2550518259 1;
CM_ BO_ 2550518259 "电压17 / 电压18 | 信号数 4";
CM_ SG_ 2550518259 电压17 "电压17 [原始公式: (x1+x2%16*256)/1000.000]";
CM_ SG_ 2550518259 电压18 "电压18 [原始公式: (x1+x2%16*256)/1000.000]";
CM_ SG_ 2550518259 电压19 "电压19 [原始公式: (x1+x2%16*256)/1000.000]";
CM_ SG_ 2550518259 电压20 "电压20 [原始公式: (x1+x2%16*256)/1000.000]";

BO_ 2550520835 ZT_1805DC03: 8 Vector__XXX
 SG_ 单体电池电压41 : 0|8@1+ (0.02,0) [0|5] "V" Vector__XXX
 SG_ 单体电池电压42 : 8|8@1+ (0.02,0) [0|5] "V" Vector__XXX
 SG_ 单体电池电压43 : 16|8@1+ (0.02,0) [0|5] "V" Vector__XXX
 SG_ 单体电池电压44 : 24|8@1+ (0.02,0) [0|5] "V" Vector__XXX
 SG_ 单体电池电压45 : 32|8@1+ (0.02,0) [0|5] "V" Vector__XXX
 SG_ 单体电池电压46 : 40|8@1+ (0.02,0) [0|5] "V" Vector__XXX
 SG_ 单体电池电压47 : 48|8@1+ (0.02,0) [0|5] "V" Vector__XXX
 SG_ 单体电池电压48 : 56|8@1+ (0.02,0) [0|5] "V" Vector__XXX

BA_ "VFrameFormat" BO_ 2550520835 1;
CM_ BO_ 2550520835 "单体电池电压41 / 单体电池电压42 | 信号数 8";
CM_ SG_ 2550520835 单体电池电压41 "单体电池电压41";
CM_ SG_ 2550520835 单体电池电压42 "单体电池电压42";
CM_ SG_ 2550520835 单体电池电压43 "单体电池电压43";
CM_ SG_ 2550520835 单体电池电压44 "单体电池电压44";
CM_ SG_ 2550520835 单体电池电压45 "单体电池电压45";
CM_ SG_ 2550520835 单体电池电压46 "单体电池电压46";
CM_ SG_ 2550520835 单体电池电压47 "单体电池电压47";
CM_ SG_ 2550520835 单体电池电压48 "单体电池电压48";

BO_ 2550521091 ZT_1805DD03: 8 Vector__XXX
 SG_ 单体电池温度41 : 0|8@1+ (1,-40) [-40|215] "℃" Vector__XXX
 SG_ 单体电池温度42 : 8|8@1+ (1,-40) [-40|215] "℃" Vector__XXX
 SG_ 单体电池温度43 : 16|8@1+ (1,-40) [-40|215] "℃" Vector__XXX
 SG_ 单体电池温度44 : 24|8@1+ (1,-40) [-40|215] "℃" Vector__XXX
 SG_ 单体电池温度45 : 32|8@1+ (1,-40) [-40|215] "℃" Vector__XXX
 SG_ 单体电池温度46 : 40|8@1+ (1,-40) [-40|215] "℃" Vector__XXX
 SG_ 单体电池温度47 : 48|8@1+ (1,-40) [-40|215] "℃" Vector__XXX
 SG_ 单体电池温度48 : 56|8@1+ (1,-40) [-40|215] "℃" Vector__XXX

BA_ "VFrameFormat" BO_ 2550521091 1;
CM_ BO_ 2550521091 "单体电池温度41 / 单体电池温度42 | 信号数 8";
CM_ SG_ 2550521091 单体电池温度41 "单体电池温度41";
CM_ SG_ 2550521091 单体电池温度42 "单体电池温度42";
CM_ SG_ 2550521091 单体电池温度43 "单体电池温度43";
CM_ SG_ 2550521091 单体电池温度44 "单体电池温度44";
CM_ SG_ 2550521091 单体电池温度45 "单体电池温度45";
CM_ SG_ 2550521091 单体电池温度46 "单体电池温度46";
CM_ SG_ 2550521091 单体电池温度47 "单体电池温度47";
CM_ SG_ 2550521091 单体电池温度48 "单体电池温度48";

BO_ 2550583795 ZT_1806D1F3: 8 Vector__XXX
 SG_ 电压21 : 0|8@1+ (1,0) [0|0] "V" Vector__XXX
 SG_ 电压22 : 16|8@1+ (1,0) [0|0] "V" Vector__XXX
 SG_ 电压23 : 32|8@1+ (1,0) [0|0] "V" Vector__XXX
 SG_ 电压24 : 48|8@1+ (1,0) [0|0] "V" Vector__XXX

BA_ "VFrameFormat" BO_ 2550583795 1;
CM_ BO_ 2550583795 "电压21 / 电压22 | 信号数 4";
CM_ SG_ 2550583795 电压21 "电压21 [原始公式: (x1+x2%16*256)/1000.000]";
CM_ SG_ 2550583795 电压22 "电压22 [原始公式: (x1+x2%16*256)/1000.000]";
CM_ SG_ 2550583795 电压23 "电压23 [原始公式: (x1+x2%16*256)/1000.000]";
CM_ SG_ 2550583795 电压24 "电压24 [原始公式: (x1+x2%16*256)/1000.000]";

BO_ 2550586371 ZT_1806DC03: 8 Vector__XXX
 SG_ 单体电池电压49 : 0|8@1+ (0.02,0) [0|5] "V" Vector__XXX
 SG_ 单体电池电压50 : 8|8@1+ (0.02,0) [0|5] "V" Vector__XXX
 SG_ 单体电池电压51 : 16|8@1+ (0.02,0) [0|5] "V" Vector__XXX
 SG_ 单体电池电压52 : 24|8@1+ (0.02,0) [0|5] "V" Vector__XXX
 SG_ 单体电池电压53 : 32|8@1+ (0.02,0) [0|5] "V" Vector__XXX
 SG_ 单体电池电压54 : 40|8@1+ (0.02,0) [0|5] "V" Vector__XXX
 SG_ 单体电池电压55 : 48|8@1+ (0.02,0) [0|5] "V" Vector__XXX
 SG_ 单体电池电压56 : 56|8@1+ (0.02,0) [0|5] "V" Vector__XXX

BA_ "VFrameFormat" BO_ 2550586371 1;
CM_ BO_ 2550586371 "单体电池电压49 / 单体电池电压50 | 信号数 8";
CM_ SG_ 2550586371 单体电池电压49 "单体电池电压49";
CM_ SG_ 2550586371 单体电池电压50 "单体电池电压50";
CM_ SG_ 2550586371 单体电池电压51 "单体电池电压51";
CM_ SG_ 2550586371 单体电池电压52 "单体电池电压52";
CM_ SG_ 2550586371 单体电池电压53 "单体电池电压53";
CM_ SG_ 2550586371 单体电池电压54 "单体电池电压54";
CM_ SG_ 2550586371 单体电池电压55 "单体电池电压55";
CM_ SG_ 2550586371 单体电池电压56 "单体电池电压56";

BO_ 2550649331 ZT_1807D1F3: 8 Vector__XXX
 SG_ 电压25 : 0|8@1+ (1,0) [0|0] "V" Vector__XXX
 SG_ 电压26 : 16|8@1+ (1,0) [0|0] "V" Vector__XXX
 SG_ 电压27 : 32|8@1+ (1,0) [0|0] "V" Vector__XXX
 SG_ 电压28 : 48|8@1+ (1,0) [0|0] "V" Vector__XXX

BA_ "VFrameFormat" BO_ 2550649331 1;
CM_ BO_ 2550649331 "电压25 / 电压26 | 信号数 4";
CM_ SG_ 2550649331 电压25 "电压25 [原始公式: (x1+x2%16*256)/1000.000]";
CM_ SG_ 2550649331 电压26 "电压26 [原始公式: (x1+x2%16*256)/1000.000]";
CM_ SG_ 2550649331 电压27 "电压27 [原始公式: (x1+x2%16*256)/1000.000]";
CM_ SG_ 2550649331 电压28 "电压28 [原始公式: (x1+x2%16*256)/1000.000]";

BO_ 2550651907 ZT_1807DC03: 8 Vector__XXX
 SG_ 单体电池电压57 : 0|8@1+ (0.02,0) [0|5] "V" Vector__XXX
 SG_ 单体电池电压58 : 8|8@1+ (0.02,0) [0|5] "V" Vector__XXX
 SG_ 单体电池电压59 : 16|8@1+ (0.02,0) [0|5] "V" Vector__XXX
 SG_ 单体电池电压60 : 24|8@1+ (0.02,0) [0|5] "V" Vector__XXX
 SG_ 单体电池电压61 : 32|8@1+ (0.02,0) [0|5] "V" Vector__XXX
 SG_ 单体电池电压62 : 40|8@1+ (0.02,0) [0|5] "V" Vector__XXX
 SG_ 单体电池电压63 : 48|8@1+ (0.02,0) [0|5] "V" Vector__XXX
 SG_ 单体电池电压64 : 56|8@1+ (0.02,0) [0|5] "V" Vector__XXX

BA_ "VFrameFormat" BO_ 2550651907 1;
CM_ BO_ 2550651907 "单体电池电压57 / 单体电池电压58 | 信号数 8";
CM_ SG_ 2550651907 单体电池电压57 "单体电池电压57";
CM_ SG_ 2550651907 单体电池电压58 "单体电池电压58";
CM_ SG_ 2550651907 单体电池电压59 "单体电池电压59";
CM_ SG_ 2550651907 单体电池电压60 "单体电池电压60";
CM_ SG_ 2550651907 单体电池电压61 "单体电池电压61";
CM_ SG_ 2550651907 单体电池电压62 "单体电池电压62";
CM_ SG_ 2550651907 单体电池电压63 "单体电池电压63";
CM_ SG_ 2550651907 单体电池电压64 "单体电池电压64";

BO_ 2550714867 ZT_1808D1F3: 8 Vector__XXX
 SG_ 电压29 : 0|8@1+ (1,0) [0|0] "V" Vector__XXX
 SG_ 电压30 : 16|8@1+ (1,0) [0|0] "V" Vector__XXX
 SG_ 电压31 : 32|8@1+ (1,0) [0|0] "V" Vector__XXX
 SG_ 电压32 : 48|8@1+ (1,0) [0|0] "V" Vector__XXX

BA_ "VFrameFormat" BO_ 2550714867 1;
CM_ BO_ 2550714867 "电压29 / 电压30 | 信号数 4";
CM_ SG_ 2550714867 电压29 "电压29 [原始公式: (x1+x2%16*256)/1000.000]";
CM_ SG_ 2550714867 电压30 "电压30 [原始公式: (x1+x2%16*256)/1000.000]";
CM_ SG_ 2550714867 电压31 "电压31 [原始公式: (x1+x2%16*256)/1000.000]";
CM_ SG_ 2550714867 电压32 "电压32 [原始公式: (x1+x2%16*256)/1000.000]";

BO_ 2550717443 ZT_1808DC03: 8 Vector__XXX
 SG_ 单体电池电压65 : 0|8@1+ (0.02,0) [0|5] "V" Vector__XXX
 SG_ 单体电池电压66 : 8|8@1+ (0.02,0) [0|5] "V" Vector__XXX
 SG_ 单体电池电压67 : 16|8@1+ (0.02,0) [0|5] "V" Vector__XXX
 SG_ 单体电池电压68 : 24|8@1+ (0.02,0) [0|5] "V" Vector__XXX
 SG_ 单体电池电压69 : 32|8@1+ (0.02,0) [0|5] "V" Vector__XXX
 SG_ 单体电池电压70 : 40|8@1+ (0.02,0) [0|5] "V" Vector__XXX
 SG_ 单体电池电压71 : 48|8@1+ (0.02,0) [0|5] "V" Vector__XXX
 SG_ 单体电池电压72 : 56|8@1+ (0.02,0) [0|5] "V" Vector__XXX

BA_ "VFrameFormat" BO_ 2550717443 1;
CM_ BO_ 2550717443 "单体电池电压65 / 单体电池电压66 | 信号数 8";
CM_ SG_ 2550717443 单体电池电压65 "单体电池电压65";
CM_ SG_ 2550717443 单体电池电压66 "单体电池电压66";
CM_ SG_ 2550717443 单体电池电压67 "单体电池电压67";
CM_ SG_ 2550717443 单体电池电压68 "单体电池电压68";
CM_ SG_ 2550717443 单体电池电压69 "单体电池电压69";
CM_ SG_ 2550717443 单体电池电压70 "单体电池电压70";
CM_ SG_ 2550717443 单体电池电压71 "单体电池电压71";
CM_ SG_ 2550717443 单体电池电压72 "单体电池电压72";

BO_ 2550780403 ZT_1809D1F3: 8 Vector__XXX
 SG_ 电压33 : 0|8@1+ (1,0) [0|0] "V" Vector__XXX
 SG_ 电压34 : 16|8@1+ (1,0) [0|0] "V" Vector__XXX
 SG_ 电压35 : 32|8@1+ (1,0) [0|0] "V" Vector__XXX
 SG_ 电压36 : 48|8@1+ (1,0) [0|0] "V" Vector__XXX

BA_ "VFrameFormat" BO_ 2550780403 1;
CM_ BO_ 2550780403 "电压33 / 电压34 | 信号数 4";
CM_ SG_ 2550780403 电压33 "电压33 [原始公式: (x1+x2%16*256)/1000.000]";
CM_ SG_ 2550780403 电压34 "电压34 [原始公式: (x1+x2%16*256)/1000.000]";
CM_ SG_ 2550780403 电压35 "电压35 [原始公式: (x1+x2%16*256)/1000.000]";
CM_ SG_ 2550780403 电压36 "电压36 [原始公式: (x1+x2%16*256)/1000.000]";

BO_ 2550782979 ZT_1809DC03: 8 Vector__XXX
 SG_ 单体电池电压73 : 0|8@1+ (0.02,0) [0|5] "V" Vector__XXX
 SG_ 单体电池电压74 : 8|8@1+ (0.02,0) [0|5] "V" Vector__XXX
 SG_ 单体电池电压75 : 16|8@1+ (0.02,0) [0|5] "V" Vector__XXX
 SG_ 单体电池电压76 : 24|8@1+ (0.02,0) [0|5] "V" Vector__XXX
 SG_ 单体电池电压77 : 32|8@1+ (0.02,0) [0|5] "V" Vector__XXX
 SG_ 单体电池电压78 : 40|8@1+ (0.02,0) [0|5] "V" Vector__XXX
 SG_ 单体电池电压79 : 48|8@1+ (0.02,0) [0|5] "V" Vector__XXX
 SG_ 单体电池电压80 : 56|8@1+ (0.02,0) [0|5] "V" Vector__XXX

BA_ "VFrameFormat" BO_ 2550782979 1;
CM_ BO_ 2550782979 "单体电池电压73 / 单体电池电压74 | 信号数 8";
CM_ SG_ 2550782979 单体电池电压73 "单体电池电压73";
CM_ SG_ 2550782979 单体电池电压74 "单体电池电压74";
CM_ SG_ 2550782979 单体电池电压75 "单体电池电压75";
CM_ SG_ 2550782979 单体电池电压76 "单体电池电压76";
CM_ SG_ 2550782979 单体电池电压77 "单体电池电压77";
CM_ SG_ 2550782979 单体电池电压78 "单体电池电压78";
CM_ SG_ 2550782979 单体电池电压79 "单体电池电压79";
CM_ SG_ 2550782979 单体电池电压80 "单体电池电压80";

BO_ 2550845939 ZT_180AD1F3: 8 Vector__XXX
 SG_ 电压37 : 0|8@1+ (1,0) [0|0] "V" Vector__XXX
 SG_ 电压38 : 16|8@1+ (1,0) [0|0] "V" Vector__XXX
 SG_ 电压39 : 32|8@1+ (1,0) [0|0] "V" Vector__XXX
 SG_ 电压40 : 48|8@1+ (1,0) [0|0] "V" Vector__XXX

BA_ "VFrameFormat" BO_ 2550845939 1;
CM_ BO_ 2550845939 "电压37 / 电压38 | 信号数 4";
CM_ SG_ 2550845939 电压37 "电压37 [原始公式: (x1+x2%16*256)/1000.000]";
CM_ SG_ 2550845939 电压38 "电压38 [原始公式: (x1+x2%16*256)/1000.000]";
CM_ SG_ 2550845939 电压39 "电压39 [原始公式: (x1+x2%16*256)/1000.000]";
CM_ SG_ 2550845939 电压40 "电压40 [原始公式: (x1+x2%16*256)/1000.000]";

BO_ 2550848515 ZT_180ADC03: 8 Vector__XXX
 SG_ 单体电池电压81 : 0|8@1+ (0.02,0) [0|5] "V" Vector__XXX
 SG_ 单体电池电压82 : 8|8@1+ (0.02,0) [0|5] "V" Vector__XXX
 SG_ 单体电池电压83 : 16|8@1+ (0.02,0) [0|5] "V" Vector__XXX
 SG_ 单体电池电压84 : 24|8@1+ (0.02,0) [0|5] "V" Vector__XXX
 SG_ 单体电池电压85 : 32|8@1+ (0.02,0) [0|5] "V" Vector__XXX
 SG_ 单体电池电压86 : 40|8@1+ (0.02,0) [0|5] "V" Vector__XXX
 SG_ 单体电池电压87 : 48|8@1+ (0.02,0) [0|5] "V" Vector__XXX
 SG_ 单体电池电压88 : 56|8@1+ (0.02,0) [0|5] "V" Vector__XXX

BA_ "VFrameFormat" BO_ 2550848515 1;
CM_ BO_ 2550848515 "单体电池电压81 / 单体电池电压82 | 信号数 8";
CM_ SG_ 2550848515 单体电池电压81 "单体电池电压81";
CM_ SG_ 2550848515 单体电池电压82 "单体电池电压82";
CM_ SG_ 2550848515 单体电池电压83 "单体电池电压83";
CM_ SG_ 2550848515 单体电池电压84 "单体电池电压84";
CM_ SG_ 2550848515 单体电池电压85 "单体电池电压85";
CM_ SG_ 2550848515 单体电池电压86 "单体电池电压86";
CM_ SG_ 2550848515 单体电池电压87 "单体电池电压87";
CM_ SG_ 2550848515 单体电池电压88 "单体电池电压88";

BO_ 2550911475 ZT_180BD1F3: 8 Vector__XXX
 SG_ 电压41 : 0|8@1+ (1,0) [0|0] "V" Vector__XXX
 SG_ 电压42 : 16|8@1+ (1,0) [0|0] "V" Vector__XXX
 SG_ 电压43 : 32|8@1+ (1,0) [0|0] "V" Vector__XXX
 SG_ 电压44 : 48|8@1+ (1,0) [0|0] "V" Vector__XXX

BA_ "VFrameFormat" BO_ 2550911475 1;
CM_ BO_ 2550911475 "电压41 / 电压42 | 信号数 4";
CM_ SG_ 2550911475 电压41 "电压41 [原始公式: (x1+x2%16*256)/1000.000]";
CM_ SG_ 2550911475 电压42 "电压42 [原始公式: (x1+x2%16*256)/1000.000]";
CM_ SG_ 2550911475 电压43 "电压43 [原始公式: (x1+x2%16*256)/1000.000]";
CM_ SG_ 2550911475 电压44 "电压44 [原始公式: (x1+x2%16*256)/1000.000]";

BO_ 2550914051 ZT_180BDC03: 8 Vector__XXX
 SG_ 单体电池电压89 : 0|8@1+ (0.02,0) [0|5] "V" Vector__XXX
 SG_ 单体电池电压90 : 8|8@1+ (0.02,0) [0|5] "V" Vector__XXX
 SG_ 单体电池电压91 : 16|8@1+ (0.02,0) [0|5] "V" Vector__XXX
 SG_ 单体电池电压92 : 24|8@1+ (0.02,0) [0|5] "V" Vector__XXX
 SG_ 单体电池电压93 : 32|8@1+ (0.02,0) [0|5] "V" Vector__XXX
 SG_ 单体电池电压94 : 40|8@1+ (0.02,0) [0|5] "V" Vector__XXX
 SG_ 单体电池电压95 : 48|8@1+ (0.02,0) [0|5] "V" Vector__XXX
 SG_ 单体电池电压96 : 56|8@1+ (0.02,0) [0|5] "V" Vector__XXX

BA_ "VFrameFormat" BO_ 2550914051 1;
CM_ BO_ 2550914051 "单体电池电压89 / 单体电池电压90 | 信号数 8";
CM_ SG_ 2550914051 单体电池电压89 "单体电池电压89";
CM_ SG_ 2550914051 单体电池电压90 "单体电池电压90";
CM_ SG_ 2550914051 单体电池电压91 "单体电池电压91";
CM_ SG_ 2550914051 单体电池电压92 "单体电池电压92";
CM_ SG_ 2550914051 单体电池电压93 "单体电池电压93";
CM_ SG_ 2550914051 单体电池电压94 "单体电池电压94";
CM_ SG_ 2550914051 单体电池电压95 "单体电池电压95";
CM_ SG_ 2550914051 单体电池电压96 "单体电池电压96";

BO_ 2550977011 ZT_180CD1F3: 8 Vector__XXX
 SG_ 电压45 : 0|8@1+ (1,0) [0|0] "V" Vector__XXX
 SG_ 电压46 : 16|8@1+ (1,0) [0|0] "V" Vector__XXX
 SG_ 电压47 : 32|8@1+ (1,0) [0|0] "V" Vector__XXX
 SG_ 电压48 : 48|8@1+ (1,0) [0|0] "V" Vector__XXX

BA_ "VFrameFormat" BO_ 2550977011 1;
CM_ BO_ 2550977011 "电压45 / 电压46 | 信号数 4";
CM_ SG_ 2550977011 电压45 "电压45 [原始公式: (x1+x2%16*256)/1000.000]";
CM_ SG_ 2550977011 电压46 "电压46 [原始公式: (x1+x2%16*256)/1000.000]";
CM_ SG_ 2550977011 电压47 "电压47 [原始公式: (x1+x2%16*256)/1000.000]";
CM_ SG_ 2550977011 电压48 "电压48 [原始公式: (x1+x2%16*256)/1000.000]";

BO_ 2550979587 ZT_180CDC03: 8 Vector__XXX
 SG_ 单体电池电压97 : 0|8@1+ (0.02,0) [0|5] "V" Vector__XXX
 SG_ 单体电池电压98 : 8|8@1+ (0.02,0) [0|5] "V" Vector__XXX
 SG_ 单体电池电压99 : 16|8@1+ (0.02,0) [0|5] "V" Vector__XXX
 SG_ 单体电池电压100 : 24|8@1+ (0.02,0) [0|5] "V" Vector__XXX
 SG_ 单体电池电压101 : 32|8@1+ (0.02,0) [0|5] "V" Vector__XXX
 SG_ 单体电池电压102 : 40|8@1+ (0.02,0) [0|5] "V" Vector__XXX
 SG_ 单体电池电压103 : 48|8@1+ (0.02,0) [0|5] "V" Vector__XXX
 SG_ 单体电池电压104 : 56|8@1+ (0.02,0) [0|5] "V" Vector__XXX

BA_ "VFrameFormat" BO_ 2550979587 1;
CM_ BO_ 2550979587 "单体电池电压100 / 单体电池电压101 | 信号数 8";
CM_ SG_ 2550979587 单体电池电压97 "单体电池电压97";
CM_ SG_ 2550979587 单体电池电压98 "单体电池电压98";
CM_ SG_ 2550979587 单体电池电压99 "单体电池电压99";
CM_ SG_ 2550979587 单体电池电压100 "单体电池电压100";
CM_ SG_ 2550979587 单体电池电压101 "单体电池电压101";
CM_ SG_ 2550979587 单体电池电压102 "单体电池电压102";
CM_ SG_ 2550979587 单体电池电压103 "单体电池电压103";
CM_ SG_ 2550979587 单体电池电压104 "单体电池电压104";

BO_ 2551042547 ZT_180DD1F3: 8 Vector__XXX
 SG_ 电压49 : 0|8@1+ (1,0) [0|0] "V" Vector__XXX
 SG_ 电压50 : 16|8@1+ (1,0) [0|0] "V" Vector__XXX
 SG_ 电压51 : 32|8@1+ (1,0) [0|0] "V" Vector__XXX
 SG_ 电压52 : 48|8@1+ (1,0) [0|0] "V" Vector__XXX

BA_ "VFrameFormat" BO_ 2551042547 1;
CM_ BO_ 2551042547 "电压49 / 电压50 | 信号数 4";
CM_ SG_ 2551042547 电压49 "电压49 [原始公式: (x1+x2%16*256)/1000.000]";
CM_ SG_ 2551042547 电压50 "电压50 [原始公式: (x1+x2%16*256)/1000.000]";
CM_ SG_ 2551042547 电压51 "电压51 [原始公式: (x1+x2%16*256)/1000.000]";
CM_ SG_ 2551042547 电压52 "电压52 [原始公式: (x1+x2%16*256)/1000.000]";

BO_ 2551045123 ZT_180DDC03: 8 Vector__XXX
 SG_ 单体电池电压105 : 0|8@1+ (0.02,0) [0|5] "V" Vector__XXX
 SG_ 单体电池电压106 : 8|8@1+ (0.02,0) [0|5] "V" Vector__XXX
 SG_ 单体电池电压107 : 16|8@1+ (0.02,0) [0|5] "V" Vector__XXX
 SG_ 单体电池电压108 : 24|8@1+ (0.02,0) [0|5] "V" Vector__XXX
 SG_ 单体电池电压109 : 32|8@1+ (0.02,0) [0|5] "V" Vector__XXX
 SG_ 单体电池电压110 : 40|8@1+ (0.02,0) [0|5] "V" Vector__XXX
 SG_ 单体电池电压111 : 48|8@1+ (0.02,0) [0|5] "V" Vector__XXX
 SG_ 单体电池电压112 : 56|8@1+ (0.02,0) [0|5] "V" Vector__XXX

BA_ "VFrameFormat" BO_ 2551045123 1;
CM_ BO_ 2551045123 "单体电池电压105 / 单体电池电压106 | 信号数 8";
CM_ SG_ 2551045123 单体电池电压105 "单体电池电压105";
CM_ SG_ 2551045123 单体电池电压106 "单体电池电压106";
CM_ SG_ 2551045123 单体电池电压107 "单体电池电压107";
CM_ SG_ 2551045123 单体电池电压108 "单体电池电压108";
CM_ SG_ 2551045123 单体电池电压109 "单体电池电压109";
CM_ SG_ 2551045123 单体电池电压110 "单体电池电压110";
CM_ SG_ 2551045123 单体电池电压111 "单体电池电压111";
CM_ SG_ 2551045123 单体电池电压112 "单体电池电压112";

BO_ 2551108083 ZT_180ED1F3: 8 Vector__XXX
 SG_ 电压53 : 0|8@1+ (1,0) [0|0] "V" Vector__XXX
 SG_ 电压54 : 16|8@1+ (1,0) [0|0] "V" Vector__XXX
 SG_ 电压55 : 32|8@1+ (1,0) [0|0] "V" Vector__XXX
 SG_ 电压56 : 48|8@1+ (1,0) [0|0] "V" Vector__XXX

BA_ "VFrameFormat" BO_ 2551108083 1;
CM_ BO_ 2551108083 "电压53 / 电压54 | 信号数 4";
CM_ SG_ 2551108083 电压53 "电压53 [原始公式: (x1+x2%16*256)/1000.000]";
CM_ SG_ 2551108083 电压54 "电压54 [原始公式: (x1+x2%16*256)/1000.000]";
CM_ SG_ 2551108083 电压55 "电压55 [原始公式: (x1+x2%16*256)/1000.000]";
CM_ SG_ 2551108083 电压56 "电压56 [原始公式: (x1+x2%16*256)/1000.000]";

BO_ 2551110659 ZT_180EDC03: 8 Vector__XXX
 SG_ 单体电池电压113 : 0|8@1+ (0.02,0) [0|5] "V" Vector__XXX
 SG_ 单体电池电压114 : 8|8@1+ (0.02,0) [0|5] "V" Vector__XXX
 SG_ 单体电池电压115 : 16|8@1+ (0.02,0) [0|5] "V" Vector__XXX
 SG_ 单体电池电压116 : 24|8@1+ (0.02,0) [0|5] "V" Vector__XXX
 SG_ 单体电池电压117 : 32|8@1+ (0.02,0) [0|5] "V" Vector__XXX
 SG_ 单体电池电压118 : 40|8@1+ (0.02,0) [0|5] "V" Vector__XXX
 SG_ 单体电池电压119 : 48|8@1+ (0.02,0) [0|5] "V" Vector__XXX
 SG_ 单体电池电压120 : 56|8@1+ (0.02,0) [0|5] "V" Vector__XXX

BA_ "VFrameFormat" BO_ 2551110659 1;
CM_ BO_ 2551110659 "单体电池电压113 / 单体电池电压114 | 信号数 8";
CM_ SG_ 2551110659 单体电池电压113 "单体电池电压113";
CM_ SG_ 2551110659 单体电池电压114 "单体电池电压114";
CM_ SG_ 2551110659 单体电池电压115 "单体电池电压115";
CM_ SG_ 2551110659 单体电池电压116 "单体电池电压116";
CM_ SG_ 2551110659 单体电池电压117 "单体电池电压117";
CM_ SG_ 2551110659 单体电池电压118 "单体电池电压118";
CM_ SG_ 2551110659 单体电池电压119 "单体电池电压119";
CM_ SG_ 2551110659 单体电池电压120 "单体电池电压120";

BO_ 2551173619 ZT_180FD1F3: 8 Vector__XXX
 SG_ 电压57 : 0|8@1+ (1,0) [0|0] "V" Vector__XXX
 SG_ 电压58 : 16|8@1+ (1,0) [0|0] "V" Vector__XXX
 SG_ 电压59 : 32|8@1+ (1,0) [0|0] "V" Vector__XXX
 SG_ 电压60 : 48|8@1+ (1,0) [0|0] "V" Vector__XXX

BA_ "VFrameFormat" BO_ 2551173619 1;
CM_ BO_ 2551173619 "电压57 / 电压58 | 信号数 4";
CM_ SG_ 2551173619 电压57 "电压57 [原始公式: (x1+x2%16*256)/1000.000]";
CM_ SG_ 2551173619 电压58 "电压58 [原始公式: (x1+x2%16*256)/1000.000]";
CM_ SG_ 2551173619 电压59 "电压59 [原始公式: (x1+x2%16*256)/1000.000]";
CM_ SG_ 2551173619 电压60 "电压60 [原始公式: (x1+x2%16*256)/1000.000]";

BO_ 2551176195 ZT_180FDC03: 8 Vector__XXX
 SG_ 单体电池电压121 : 0|8@1+ (0.02,0) [0|5] "V" Vector__XXX
 SG_ 单体电池电压122 : 8|8@1+ (0.02,0) [0|5] "V" Vector__XXX
 SG_ 单体电池电压123 : 16|8@1+ (0.02,0) [0|5] "V" Vector__XXX
 SG_ 单体电池电压124 : 24|8@1+ (0.02,0) [0|5] "V" Vector__XXX
 SG_ 单体电池电压125 : 32|8@1+ (0.02,0) [0|5] "V" Vector__XXX
 SG_ 单体电池电压126 : 40|8@1+ (0.02,0) [0|5] "V" Vector__XXX
 SG_ 单体电池电压127 : 48|8@1+ (0.02,0) [0|5] "V" Vector__XXX
 SG_ 单体电池电压128 : 56|8@1+ (0.02,0) [0|5] "V" Vector__XXX

BA_ "VFrameFormat" BO_ 2551176195 1;
CM_ BO_ 2551176195 "单体电池电压121 / 单体电池电压122 | 信号数 8";
CM_ SG_ 2551176195 单体电池电压121 "单体电池电压121";
CM_ SG_ 2551176195 单体电池电压122 "单体电池电压122";
CM_ SG_ 2551176195 单体电池电压123 "单体电池电压123";
CM_ SG_ 2551176195 单体电池电压124 "单体电池电压124";
CM_ SG_ 2551176195 单体电池电压125 "单体电池电压125";
CM_ SG_ 2551176195 单体电池电压126 "单体电池电压126";
CM_ SG_ 2551176195 单体电池电压127 "单体电池电压127";
CM_ SG_ 2551176195 单体电池电压128 "单体电池电压128";

BO_ 2551185647 ZT_181000EF: 8 Vector__XXX
 SG_ 驱动电机状态 : 8|8@1+ (1,0) [0|255] "" Vector__XXX
 SG_ 驱动电机数量-1 : 0|4@1+ (1,0) [1|15] "" Vector__XXX
 SG_ 驱动电机序号-1 : 4|4@1+ (1,0) [1|15] "" Vector__XXX
 SG_ 驱动电机控制温度 : 16|8@1+ (1,-40) [-40|210] "deg C" Vector__XXX
 SG_ 电机控制器输入电压 : 32|16@1+ (0.1,0.1) [0|1500] "V" Vector__XXX
 SG_ 电机控制器直流电流 : 48|16@1+ (0.1,-1000) [-1000|10000] "A" Vector__XXX

BA_ "VFrameFormat" BO_ 2551185647 1;
CM_ BO_ 2551185647 "电机控制器直流母线电流 / 电机控制器直流电流 | 信号数 18";
CM_ SG_ 2551185647 驱动电机状态 "驱动电机状态 [枚举: 异常|磷酸铁锂|锰酸锂|钴酸锂|三元材料|聚合物锂离|超级电容|钛酸锂|燃料电池|其他车载储能装置]";
VAL_ 2551185647 驱动电机状态 0 "异常" 1 "磷酸铁锂" 2 "锰酸锂" 3 "钴酸锂" 4 "三元材料" 5 "聚合物锂离" 6 "超级电容" 7 "钛酸锂" 8 "燃料电池" 9 "其他车载储能装置";
CM_ SG_ 2551185647 驱动电机数量-1 "驱动电机数量-1";
CM_ SG_ 2551185647 驱动电机序号-1 "驱动电机序号-1";
CM_ SG_ 2551185647 驱动电机控制温度 "驱动电机控制温度";
CM_ SG_ 2551185647 电机控制器输入电压 "电机控制器输入电压";
CM_ SG_ 2551185647 电机控制器直流电流 "电机控制器直流电流";

BO_ 2551239155 ZT_1810D1F3: 8 Vector__XXX
 SG_ 电压61 : 0|8@1+ (1,0) [0|0] "V" Vector__XXX
 SG_ 电压62 : 16|8@1+ (1,0) [0|0] "V" Vector__XXX
 SG_ 电压63 : 32|8@1+ (1,0) [0|0] "V" Vector__XXX
 SG_ 电压64 : 48|8@1+ (1,0) [0|0] "V" Vector__XXX

BA_ "VFrameFormat" BO_ 2551239155 1;
CM_ BO_ 2551239155 "电压61 / 电压62 | 信号数 4";
CM_ SG_ 2551239155 电压61 "电压61 [原始公式: (x1+x2%16*256)/1000.000]";
CM_ SG_ 2551239155 电压62 "电压62 [原始公式: (x1+x2%16*256)/1000.000]";
CM_ SG_ 2551239155 电压63 "电压63 [原始公式: (x1+x2%16*256)/1000.000]";
CM_ SG_ 2551239155 电压64 "电压64 [原始公式: (x1+x2%16*256)/1000.000]";

BO_ 2551241731 ZT_1810DC03: 8 Vector__XXX
 SG_ 单体电池电压129 : 0|8@1+ (0.02,0) [0|5] "V" Vector__XXX
 SG_ 单体电池电压130 : 8|8@1+ (0.02,0) [0|5] "V" Vector__XXX
 SG_ 单体电池电压131 : 16|8@1+ (0.02,0) [0|5] "V" Vector__XXX
 SG_ 单体电池电压132 : 24|8@1+ (0.02,0) [0|5] "V" Vector__XXX
 SG_ 单体电池电压133 : 32|8@1+ (0.02,0) [0|5] "V" Vector__XXX
 SG_ 单体电池电压134 : 40|8@1+ (0.02,0) [0|5] "V" Vector__XXX
 SG_ 单体电池电压135 : 48|8@1+ (0.02,0) [0|5] "V" Vector__XXX
 SG_ 单体电池电压136 : 56|8@1+ (0.02,0) [0|5] "V" Vector__XXX

BA_ "VFrameFormat" BO_ 2551241731 1;
CM_ BO_ 2551241731 "单体电池电压129 / 单体电池电压130 | 信号数 8";
CM_ SG_ 2551241731 单体电池电压129 "单体电池电压129";
CM_ SG_ 2551241731 单体电池电压130 "单体电池电压130";
CM_ SG_ 2551241731 单体电池电压131 "单体电池电压131";
CM_ SG_ 2551241731 单体电池电压132 "单体电池电压132";
CM_ SG_ 2551241731 单体电池电压133 "单体电池电压133";
CM_ SG_ 2551241731 单体电池电压134 "单体电池电压134";
CM_ SG_ 2551241731 单体电池电压135 "单体电池电压135";
CM_ SG_ 2551241731 单体电池电压136 "单体电池电压136";

BO_ 2551251183 ZT_181100EF: 8 Vector__XXX
 SG_ 驱动电机数量-2 : 0|4@1+ (1,0) [0|15] "" Vector__XXX
 SG_ 驱动电机序号-2 : 4|4@1+ (1,0) [0|15] "" Vector__XXX
 SG_ 驱动电机温度状态 : 16|8@1+ (1,0) [-40|210] "deg C" Vector__XXX
 SG_ 驱动电机转速状态 : 32|8@1+ (1,0) [-20000|45531] "rpm" Vector__XXX
 SG_ 驱动电机转矩状态 : 48|8@1+ (1,0) [-2000|2000] "Nm" Vector__XXX

BA_ "VFrameFormat" BO_ 2551251183 1;
CM_ BO_ 2551251183 "驱动电机个数范围 / 驱动电机序号 （1~15） | 信号数 15";
CM_ SG_ 2551251183 驱动电机数量-2 "驱动电机数量-2";
CM_ SG_ 2551251183 驱动电机序号-2 "驱动电机序号-2";
CM_ SG_ 2551251183 驱动电机温度状态 "驱动电机温度状态 [原始公式: if((BYTE[2])==254) @1; else if((BYTE[2])==255) @2; else BYTE[2]-40] [枚举: %d|异常|无效]";
CM_ SG_ 2551251183 驱动电机转速状态 "驱动电机转速状态 [原始公式: if((BYTE[4]+BYTE[5]*256)==65534) @1; else if((BYTE[4]+BYTE[5]*256)==65535) @2; else (BYTE[4]+BYTE[5]*256)-20000] [枚举: %d|异常|无效]";
CM_ SG_ 2551251183 驱动电机转矩状态 "驱动电机转矩状态 [原始公式: if((BYTE[6]+BYTE[7]*256)==65534) @1; else if((BYTE[6]+BYTE[7]*256)==65535) @2; else (BYTE[6]+BYTE[7]*256)*0.1-2000] [枚举: %.1f|异常|无效]";

BO_ 2551293851 ZT_1811A79B: 8 Vector__XXX
 SG_ 油泵DC/AC 状态 : 32|2@1+ (1,0) [0|0] "" Vector__XXX
 SG_ 油泵DC/AC 输出切断 : 34|2@1+ (1,0) [0|0] "" Vector__XXX
 SG_ 油泵DC/AC 输入切断 : 36|2@1+ (1,0) [0|0] "" Vector__XXX
 SG_ 油泵故障等级 : 48|3@1+ (1,0) [0|0] "" Vector__XXX
 SG_ 油泵逆变器输出 U 相电压 : 0|16@1+ (1,0) [0|1000] "V" Vector__XXX
 SG_ 油泵逆变器输出U相电流 : 16|16@1+ (0.1,0) [0|100] "A" Vector__XXX

BA_ "VFrameFormat" BO_ 2551293851 1;
CM_ BO_ 2551293851 "DC/AC 油泵状态 / DC/AC 输入切断 | 信号数 19";
CM_ SG_ 2551293851 油泵DC/AC 状态 "油泵DC/AC 状态 [枚举: 停机|预充电中|预充电完成|运行]";
VAL_ 2551293851 油泵DC/AC 状态 0 "停机" 1 "预充电中" 2 "预充电完成" 3 "运行";
CM_ SG_ 2551293851 油泵DC/AC 输出切断 "油泵DC/AC 输出切断 [枚举: 无效|有效|错误|未定义]";
VAL_ 2551293851 油泵DC/AC 输出切断 0 "无效" 1 "有效" 2 "错误" 3 "未定义";
CM_ SG_ 2551293851 油泵DC/AC 输入切断 "油泵DC/AC 输入切断 [枚举: 无效|有效|错误|未定义]";
VAL_ 2551293851 油泵DC/AC 输入切断 0 "无效" 1 "有效" 2 "错误" 3 "未定义";
CM_ SG_ 2551293851 油泵故障等级 "油泵故障等级 [枚举: 无故障|一级故障|二级故障|三级故障|四级故障]";
VAL_ 2551293851 油泵故障等级 0 "无故障" 1 "一级故障" 2 "二级故障" 3 "三级故障" 4 "四级故障";
CM_ SG_ 2551293851 油泵逆变器输出 U 相电压 "油泵逆变器输出 U 相电压";
CM_ SG_ 2551293851 油泵逆变器输出U相电流 "油泵逆变器输出U相电流";

BO_ 2551293853 ZT_1811A79D: 8 Vector__XXX
 SG_ 气泵DC/AC状态 : 32|2@1+ (1,0) [0|0] "" Vector__XXX
 SG_ 气泵DC/AC 输出切断 : 34|2@1+ (1,0) [0|0] "" Vector__XXX
 SG_ 气泵DC/AC 输入切断 : 36|2@1+ (1,0) [0|0] "" Vector__XXX
 SG_ 气泵故障等级 : 48|3@1+ (1,0) [0|0] "" Vector__XXX
 SG_ 气泵逆变器输出 U 相电压 : 0|16@1+ (1,0) [0|1000] "V" Vector__XXX
 SG_ 气泵逆变器输出U相电流 : 16|16@1+ (0.1,0) [0|100] "A" Vector__XXX

BA_ "VFrameFormat" BO_ 2551293853 1;
CM_ BO_ 2551293853 "DC/AC 油泵状态 / DC/AC 输入切断 | 信号数 8";
CM_ SG_ 2551293853 气泵DC/AC状态 "气泵DC/AC状态 [枚举: 停机|预充电中|预充电完成|运行]";
VAL_ 2551293853 气泵DC/AC状态 0 "停机" 1 "预充电中" 2 "预充电完成" 3 "运行";
CM_ SG_ 2551293853 气泵DC/AC 输出切断 "气泵DC/AC 输出切断 [枚举: 无效|有效|错误|未定义]";
VAL_ 2551293853 气泵DC/AC 输出切断 0 "无效" 1 "有效" 2 "错误" 3 "未定义";
CM_ SG_ 2551293853 气泵DC/AC 输入切断 "气泵DC/AC 输入切断 [枚举: 无效|有效|错误|未定义]";
VAL_ 2551293853 气泵DC/AC 输入切断 0 "无效" 1 "有效" 2 "错误" 3 "未定义";
CM_ SG_ 2551293853 气泵故障等级 "气泵故障等级 [枚举: 无故障|一级故障|二级故障|三级故障|四级故障]";
VAL_ 2551293853 气泵故障等级 0 "无故障" 1 "一级故障" 2 "二级故障" 3 "三级故障" 4 "四级故障";
CM_ SG_ 2551293853 气泵逆变器输出 U 相电压 "气泵逆变器输出 U 相电压";
CM_ SG_ 2551293853 气泵逆变器输出U相电流 "气泵逆变器输出U相电流";

BO_ 2551304691 ZT_1811D1F3: 8 Vector__XXX
 SG_ 电压65 : 0|8@1+ (1,0) [0|0] "V" Vector__XXX
 SG_ 电压66 : 16|8@1+ (1,0) [0|0] "V" Vector__XXX
 SG_ 电压67 : 32|8@1+ (1,0) [0|0] "V" Vector__XXX
 SG_ 电压68 : 48|8@1+ (1,0) [0|0] "V" Vector__XXX

BA_ "VFrameFormat" BO_ 2551304691 1;
CM_ BO_ 2551304691 "电压65 / 电压66 | 信号数 4";
CM_ SG_ 2551304691 电压65 "电压65 [原始公式: (x1+x2%16*256)/1000.000]";
CM_ SG_ 2551304691 电压66 "电压66 [原始公式: (x1+x2%16*256)/1000.000]";
CM_ SG_ 2551304691 电压67 "电压67 [原始公式: (x1+x2%16*256)/1000.000]";
CM_ SG_ 2551304691 电压68 "电压68 [原始公式: (x1+x2%16*256)/1000.000]";

BO_ 2551307267 ZT_1811DC03: 8 Vector__XXX
 SG_ 单体电池电压137 : 0|8@1+ (0.02,0) [0|5] "V" Vector__XXX
 SG_ 单体电池电压138 : 8|8@1+ (0.02,0) [0|5] "V" Vector__XXX
 SG_ 单体电池电压139 : 16|8@1+ (0.02,0) [0|5] "V" Vector__XXX
 SG_ 单体电池电压140 : 24|8@1+ (0.02,0) [0|5] "V" Vector__XXX
 SG_ 单体电池电压141 : 32|8@1+ (0.02,0) [0|5] "V" Vector__XXX
 SG_ 单体电池电压142 : 40|8@1+ (0.02,0) [0|5] "V" Vector__XXX
 SG_ 单体电池电压143 : 48|8@1+ (0.02,0) [0|5] "V" Vector__XXX
 SG_ 单体电池电压144 : 56|8@1+ (0.02,0) [0|5] "V" Vector__XXX

BA_ "VFrameFormat" BO_ 2551307267 1;
CM_ BO_ 2551307267 "单体电池电压137 / 单体电池电压138 | 信号数 8";
CM_ SG_ 2551307267 单体电池电压137 "单体电池电压137";
CM_ SG_ 2551307267 单体电池电压138 "单体电池电压138";
CM_ SG_ 2551307267 单体电池电压139 "单体电池电压139";
CM_ SG_ 2551307267 单体电池电压140 "单体电池电压140";
CM_ SG_ 2551307267 单体电池电压141 "单体电池电压141";
CM_ SG_ 2551307267 单体电池电压142 "单体电池电压142";
CM_ SG_ 2551307267 单体电池电压143 "单体电池电压143";
CM_ SG_ 2551307267 单体电池电压144 "单体电池电压144";

BO_ 2551370227 ZT_1812D1F3: 8 Vector__XXX
 SG_ 电压69 : 0|8@1+ (1,0) [0|0] "V" Vector__XXX
 SG_ 电压70 : 16|8@1+ (1,0) [0|0] "V" Vector__XXX
 SG_ 电压71 : 32|8@1+ (1,0) [0|0] "V" Vector__XXX
 SG_ 电压72 : 48|8@1+ (1,0) [0|0] "V" Vector__XXX

BA_ "VFrameFormat" BO_ 2551370227 1;
CM_ BO_ 2551370227 "电压69 / 电压70 | 信号数 4";
CM_ SG_ 2551370227 电压69 "电压69 [原始公式: (x1+x2%16*256)/1000.000]";
CM_ SG_ 2551370227 电压70 "电压70 [原始公式: (x1+x2%16*256)/1000.000]";
CM_ SG_ 2551370227 电压71 "电压71 [原始公式: (x1+x2%16*256)/1000.000]";
CM_ SG_ 2551370227 电压72 "电压72 [原始公式: (x1+x2%16*256)/1000.000]";

BO_ 2551372803 ZT_1812DC03: 8 Vector__XXX
 SG_ 单体电池电压145 : 0|8@1+ (0.02,0) [0|5] "V" Vector__XXX
 SG_ 单体电池电压146 : 8|8@1+ (0.02,0) [0|5] "V" Vector__XXX
 SG_ 单体电池电压147 : 16|8@1+ (0.02,0) [0|5] "V" Vector__XXX
 SG_ 单体电池电压148 : 24|8@1+ (0.02,0) [0|5] "V" Vector__XXX
 SG_ 单体电池电压149 : 32|8@1+ (0.02,0) [0|5] "V" Vector__XXX
 SG_ 单体电池电压150 : 40|8@1+ (0.02,0) [0|5] "V" Vector__XXX
 SG_ 单体电池电压151 : 48|8@1+ (0.02,0) [0|5] "V" Vector__XXX
 SG_ 单体电池电压152 : 56|8@1+ (0.02,0) [0|5] "V" Vector__XXX

BA_ "VFrameFormat" BO_ 2551372803 1;
CM_ BO_ 2551372803 "单体电池电压145 / 单体电池电压146 | 信号数 8";
CM_ SG_ 2551372803 单体电池电压145 "单体电池电压145";
CM_ SG_ 2551372803 单体电池电压146 "单体电池电压146";
CM_ SG_ 2551372803 单体电池电压147 "单体电池电压147";
CM_ SG_ 2551372803 单体电池电压148 "单体电池电压148";
CM_ SG_ 2551372803 单体电池电压149 "单体电池电压149";
CM_ SG_ 2551372803 单体电池电压150 "单体电池电压150";
CM_ SG_ 2551372803 单体电池电压151 "单体电池电压151";
CM_ SG_ 2551372803 单体电池电压152 "单体电池电压152";

BO_ 2551382255 ZT_181300EF: 8 Vector__XXX
 SG_ 驻坡指示 : 56|1@1+ (1,0) [0|0] "" Vector__XXX
 SG_ 电机额定功率 : 16|8@1+ (1,0) [0|250] "kW" Vector__XXX
 SG_ 电机峰值功率 : 0|16@1+ (1,0) [0|500] "kW" Vector__XXX
 SG_ 电机最大可用功率 : 24|16@1+ (1,0) [0|500] "kW" Vector__XXX
 SG_ 电机瞬时功率 : 40|16@1+ (1,-500) [0|500] "" Vector__XXX

BA_ "VFrameFormat" BO_ 2551382255 1;
CM_ BO_ 2551382255 "电机峰值功率 / 电机当前最大可用功率 | 信号数 13";
CM_ SG_ 2551382255 驻坡指示 "驻坡指示 [枚举: 驻坡功能未开启|驻坡功能已开启]";
VAL_ 2551382255 驻坡指示 0 "驻坡功能未开启" 1 "驻坡功能已开启";
CM_ SG_ 2551382255 电机额定功率 "电机额定功率";
CM_ SG_ 2551382255 电机峰值功率 "电机峰值功率";
CM_ SG_ 2551382255 电机最大可用功率 "电机最大可用功率";
CM_ SG_ 2551382255 电机瞬时功率 "电机瞬时功率";

BO_ 2551435763 ZT_1813D1F3: 8 Vector__XXX
 SG_ 电压73 : 0|8@1+ (1,0) [0|0] "V" Vector__XXX
 SG_ 电压74 : 16|8@1+ (1,0) [0|0] "V" Vector__XXX
 SG_ 电压75 : 32|8@1+ (1,0) [0|0] "V" Vector__XXX
 SG_ 电压76 : 48|8@1+ (1,0) [0|0] "V" Vector__XXX

BA_ "VFrameFormat" BO_ 2551435763 1;
CM_ BO_ 2551435763 "电压73 / 电压74 | 信号数 4";
CM_ SG_ 2551435763 电压73 "电压73 [原始公式: (x1+x2%16*256)/1000.000]";
CM_ SG_ 2551435763 电压74 "电压74 [原始公式: (x1+x2%16*256)/1000.000]";
CM_ SG_ 2551435763 电压75 "电压75 [原始公式: (x1+x2%16*256)/1000.000]";
CM_ SG_ 2551435763 电压76 "电压76 [原始公式: (x1+x2%16*256)/1000.000]";

BO_ 2551438339 ZT_1813DC03: 8 Vector__XXX
 SG_ 单体电池电压153 : 0|8@1+ (0.02,0) [0|5] "V" Vector__XXX
 SG_ 单体电池电压154 : 8|8@1+ (0.02,0) [0|5] "V" Vector__XXX
 SG_ 单体电池电压155 : 16|8@1+ (0.02,0) [0|5] "V" Vector__XXX
 SG_ 单体电池电压156 : 24|8@1+ (0.02,0) [0|5] "V" Vector__XXX
 SG_ 单体电池电压157 : 32|8@1+ (0.02,0) [0|5] "V" Vector__XXX
 SG_ 单体电池电压158 : 40|8@1+ (0.02,0) [0|5] "V" Vector__XXX
 SG_ 单体电池电压159 : 48|8@1+ (0.02,0) [0|5] "V" Vector__XXX
 SG_ 单体电池电压160 : 56|8@1+ (0.02,0) [0|5] "V" Vector__XXX

BA_ "VFrameFormat" BO_ 2551438339 1;
CM_ BO_ 2551438339 "单体电池电压153 / 单体电池电压154 | 信号数 8";
CM_ SG_ 2551438339 单体电池电压153 "单体电池电压153";
CM_ SG_ 2551438339 单体电池电压154 "单体电池电压154";
CM_ SG_ 2551438339 单体电池电压155 "单体电池电压155";
CM_ SG_ 2551438339 单体电池电压156 "单体电池电压156";
CM_ SG_ 2551438339 单体电池电压157 "单体电池电压157";
CM_ SG_ 2551438339 单体电池电压158 "单体电池电压158";
CM_ SG_ 2551438339 单体电池电压159 "单体电池电压159";
CM_ SG_ 2551438339 单体电池电压160 "单体电池电压160";

BO_ 2551501299 ZT_1814D1F3: 8 Vector__XXX
 SG_ 电压77 : 0|8@1+ (1,0) [0|0] "V" Vector__XXX
 SG_ 电压78 : 16|8@1+ (1,0) [0|0] "V" Vector__XXX
 SG_ 电压79 : 32|8@1+ (1,0) [0|0] "V" Vector__XXX
 SG_ 电压80 : 48|8@1+ (1,0) [0|0] "V" Vector__XXX

BA_ "VFrameFormat" BO_ 2551501299 1;
CM_ BO_ 2551501299 "电压77 / 电压78 | 信号数 4";
CM_ SG_ 2551501299 电压77 "电压77 [原始公式: (x1+x2%16*256)/1000.000]";
CM_ SG_ 2551501299 电压78 "电压78 [原始公式: (x1+x2%16*256)/1000.000]";
CM_ SG_ 2551501299 电压79 "电压79 [原始公式: (x1+x2%16*256)/1000.000]";
CM_ SG_ 2551501299 电压80 "电压80 [原始公式: (x1+x2%16*256)/1000.000]";

BO_ 2551503875 ZT_1814DC03: 8 Vector__XXX
 SG_ 单体电池电压161 : 0|8@1+ (0.02,0) [0|5] "V" Vector__XXX
 SG_ 单体电池电压162 : 8|8@1+ (0.02,0) [0|5] "V" Vector__XXX

BA_ "VFrameFormat" BO_ 2551503875 1;
CM_ BO_ 2551503875 "单体电池电压161 / 单体电池电压162 | 信号数 2";
CM_ SG_ 2551503875 单体电池电压161 "单体电池电压161";
CM_ SG_ 2551503875 单体电池电压162 "单体电池电压162";

BO_ 2551566835 ZT_1815D1F3: 8 Vector__XXX
 SG_ 电压81 : 0|8@1+ (1,0) [0|0] "V" Vector__XXX
 SG_ 电压82 : 16|8@1+ (1,0) [0|0] "V" Vector__XXX
 SG_ 电压83 : 32|8@1+ (1,0) [0|0] "V" Vector__XXX
 SG_ 电压84 : 48|8@1+ (1,0) [0|0] "V" Vector__XXX

BA_ "VFrameFormat" BO_ 2551566835 1;
CM_ BO_ 2551566835 "电压81 / 电压82 | 信号数 4";
CM_ SG_ 2551566835 电压81 "电压81 [原始公式: (x1+x2%16*256)/1000.000]";
CM_ SG_ 2551566835 电压82 "电压82 [原始公式: (x1+x2%16*256)/1000.000]";
CM_ SG_ 2551566835 电压83 "电压83 [原始公式: (x1+x2%16*256)/1000.000]";
CM_ SG_ 2551566835 电压84 "电压84 [原始公式: (x1+x2%16*256)/1000.000]";

BO_ 2551632371 ZT_1816D1F3: 8 Vector__XXX
 SG_ 电压85 : 0|8@1+ (1,0) [0|0] "V" Vector__XXX
 SG_ 电压86 : 16|8@1+ (1,0) [0|0] "V" Vector__XXX
 SG_ 电压87 : 32|8@1+ (1,0) [0|0] "V" Vector__XXX
 SG_ 电压88 : 48|8@1+ (1,0) [0|0] "V" Vector__XXX

BA_ "VFrameFormat" BO_ 2551632371 1;
CM_ BO_ 2551632371 "电压85 / 电压86 | 信号数 4";
CM_ SG_ 2551632371 电压85 "电压85 [原始公式: (x1+x2%16*256)/1000.000]";
CM_ SG_ 2551632371 电压86 "电压86 [原始公式: (x1+x2%16*256)/1000.000]";
CM_ SG_ 2551632371 电压87 "电压87 [原始公式: (x1+x2%16*256)/1000.000]";
CM_ SG_ 2551632371 电压88 "电压88 [原始公式: (x1+x2%16*256)/1000.000]";

BO_ 2551697907 ZT_1817D1F3: 8 Vector__XXX
 SG_ 电压89 : 0|8@1+ (1,0) [0|0] "V" Vector__XXX
 SG_ 电压90 : 16|8@1+ (1,0) [0|0] "V" Vector__XXX
 SG_ 电压91 : 32|8@1+ (1,0) [0|0] "V" Vector__XXX
 SG_ 电压92 : 48|8@1+ (1,0) [0|0] "V" Vector__XXX

BA_ "VFrameFormat" BO_ 2551697907 1;
CM_ BO_ 2551697907 "电压89 / 电压90 | 信号数 4";
CM_ SG_ 2551697907 电压89 "电压89 [原始公式: (x1+x2%16*256)/1000.000]";
CM_ SG_ 2551697907 电压90 "电压90 [原始公式: (x1+x2%16*256)/1000.000]";
CM_ SG_ 2551697907 电压91 "电压91 [原始公式: (x1+x2%16*256)/1000.000]";
CM_ SG_ 2551697907 电压92 "电压92 [原始公式: (x1+x2%16*256)/1000.000]";

BO_ 2551763443 ZT_1818D1F3: 8 Vector__XXX
 SG_ 电压93 : 0|8@1+ (1,0) [0|0] "V" Vector__XXX
 SG_ 电压94 : 16|8@1+ (1,0) [0|0] "V" Vector__XXX
 SG_ 电压95 : 32|8@1+ (1,0) [0|0] "V" Vector__XXX
 SG_ 电压96 : 48|8@1+ (1,0) [0|0] "V" Vector__XXX

BA_ "VFrameFormat" BO_ 2551763443 1;
CM_ BO_ 2551763443 "电压93 / 电压94 | 信号数 4";
CM_ SG_ 2551763443 电压93 "电压93 [原始公式: (x1+x2%16*256)/1000.000]";
CM_ SG_ 2551763443 电压94 "电压94 [原始公式: (x1+x2%16*256)/1000.000]";
CM_ SG_ 2551763443 电压95 "电压95 [原始公式: (x1+x2%16*256)/1000.000]";
CM_ SG_ 2551763443 电压96 "电压96 [原始公式: (x1+x2%16*256)/1000.000]";

BO_ 2551816612 ZT_1819A1A4: 8 Vector__XXX
 SG_ 绝缘故障等级 : 32|8@1+ (1,0) [0|0] "" Vector__XXX
 SG_ 整车漏电报警 : 48|8@1+ (1,0) [0|0] "" Vector__XXX
 SG_ 绝缘检查周期 : 56|8@1+ (1,0) [0|255] "" Vector__XXX
 SG_ 对地绝缘电阻 : 0|16@1+ (1,0) [0|65535] "kOhm" Vector__XXX

BA_ "VFrameFormat" BO_ 2551816612 1;
CM_ BO_ 2551816612 "对地绝缘电阻 / 整车漏电报警 | 信号数 5";
CM_ SG_ 2551816612 绝缘故障等级 "绝缘故障等级 [枚举: 无故障|一级故障|二级故障]";
VAL_ 2551816612 绝缘故障等级 0 "无故障" 1 "一级故障" 2 "二级故障";
CM_ SG_ 2551816612 整车漏电报警 "整车漏电报警 [原始公式: if((BYTE[6])==85) 0; else if((BYTE[6])==170) 1; else if((BYTE[6])==255) 2; else 3] [枚举: 漏电|不漏电|不漏电-电池自带|预留]";
CM_ SG_ 2551816612 绝缘检查周期 "绝缘检查周期";
CM_ SG_ 2551816612 对地绝缘电阻 "对地绝缘电阻";

BO_ 2551828979 ZT_1819D1F3: 8 Vector__XXX
 SG_ 电压97 : 0|8@1+ (1,0) [0|0] "V" Vector__XXX
 SG_ 电压98 : 16|8@1+ (1,0) [0|0] "V" Vector__XXX
 SG_ 电压99 : 32|8@1+ (1,0) [0|0] "V" Vector__XXX
 SG_ 电压100 : 48|8@1+ (1,0) [0|0] "V" Vector__XXX

BA_ "VFrameFormat" BO_ 2551828979 1;
CM_ BO_ 2551828979 "电压100 / 电压97 | 信号数 4";
CM_ SG_ 2551828979 电压97 "电压97 [原始公式: (x1+x2%16*256)/1000.000]";
CM_ SG_ 2551828979 电压98 "电压98 [原始公式: (x1+x2%16*256)/1000.000]";
CM_ SG_ 2551828979 电压99 "电压99 [原始公式: (x1+x2%16*256)/1000.000]";
CM_ SG_ 2551828979 电压100 "电压100 [原始公式: (x1+x2%16*256)/1000.000]";

BO_ 2551894515 ZT_181AD1F3: 8 Vector__XXX
 SG_ 电压101 : 0|8@1+ (1,0) [0|0] "V" Vector__XXX
 SG_ 电压102 : 16|8@1+ (1,0) [0|0] "V" Vector__XXX
 SG_ 电压103 : 32|8@1+ (1,0) [0|0] "V" Vector__XXX
 SG_ 电压104 : 48|8@1+ (1,0) [0|0] "V" Vector__XXX

BA_ "VFrameFormat" BO_ 2551894515 1;
CM_ BO_ 2551894515 "电压101 / 电压102 | 信号数 4";
CM_ SG_ 2551894515 电压101 "电压101 [原始公式: (x1+x2%16*256)/1000.000]";
CM_ SG_ 2551894515 电压102 "电压102 [原始公式: (x1+x2%16*256)/1000.000]";
CM_ SG_ 2551894515 电压103 "电压103 [原始公式: (x1+x2%16*256)/1000.000]";
CM_ SG_ 2551894515 电压104 "电压104 [原始公式: (x1+x2%16*256)/1000.000]";

BO_ 2551960051 ZT_181BD1F3: 8 Vector__XXX
 SG_ 电压105 : 0|8@1+ (1,0) [0|0] "V" Vector__XXX
 SG_ 电压106 : 16|8@1+ (1,0) [0|0] "V" Vector__XXX
 SG_ 电压107 : 32|8@1+ (1,0) [0|0] "V" Vector__XXX
 SG_ 电压108 : 48|8@1+ (1,0) [0|0] "V" Vector__XXX

BA_ "VFrameFormat" BO_ 2551960051 1;
CM_ BO_ 2551960051 "电压105 / 电压106 | 信号数 4";
CM_ SG_ 2551960051 电压105 "电压105 [原始公式: (x1+x2%16*256)/1000.000]";
CM_ SG_ 2551960051 电压106 "电压106 [原始公式: (x1+x2%16*256)/1000.000]";
CM_ SG_ 2551960051 电压107 "电压107 [原始公式: (x1+x2%16*256)/1000.000]";
CM_ SG_ 2551960051 电压108 "电压108 [原始公式: (x1+x2%16*256)/1000.000]";

BO_ 2552025587 ZT_181CD1F3: 8 Vector__XXX
 SG_ 电压109 : 0|8@1+ (1,0) [0|0] "V" Vector__XXX
 SG_ 电压110 : 16|8@1+ (1,0) [0|0] "V" Vector__XXX
 SG_ 电压111 : 32|8@1+ (1,0) [0|0] "V" Vector__XXX
 SG_ 电压112 : 48|8@1+ (1,0) [0|0] "V" Vector__XXX

BA_ "VFrameFormat" BO_ 2552025587 1;
CM_ BO_ 2552025587 "电压109 / 电压110 | 信号数 4";
CM_ SG_ 2552025587 电压109 "电压109 [原始公式: (x1+x2%16*256)/1000.000]";
CM_ SG_ 2552025587 电压110 "电压110 [原始公式: (x1+x2%16*256)/1000.000]";
CM_ SG_ 2552025587 电压111 "电压111 [原始公式: (x1+x2%16*256)/1000.000]";
CM_ SG_ 2552025587 电压112 "电压112 [原始公式: (x1+x2%16*256)/1000.000]";

BO_ 2552091123 ZT_181DD1F3: 8 Vector__XXX
 SG_ 电压113 : 0|8@1+ (1,0) [0|0] "V" Vector__XXX
 SG_ 电压114 : 16|8@1+ (1,0) [0|0] "V" Vector__XXX
 SG_ 电压115 : 32|8@1+ (1,0) [0|0] "V" Vector__XXX
 SG_ 电压116 : 48|8@1+ (1,0) [0|0] "V" Vector__XXX

BA_ "VFrameFormat" BO_ 2552091123 1;
CM_ BO_ 2552091123 "电压113 / 电压114 | 信号数 4";
CM_ SG_ 2552091123 电压113 "电压113 [原始公式: (x1+x2%16*256)/1000.000]";
CM_ SG_ 2552091123 电压114 "电压114 [原始公式: (x1+x2%16*256)/1000.000]";
CM_ SG_ 2552091123 电压115 "电压115 [原始公式: (x1+x2%16*256)/1000.000]";
CM_ SG_ 2552091123 电压116 "电压116 [原始公式: (x1+x2%16*256)/1000.000]";

BO_ 2552156659 ZT_181ED1F3: 8 Vector__XXX
 SG_ 电压117 : 0|8@1+ (1,0) [0|0] "V" Vector__XXX
 SG_ 电压118 : 16|8@1+ (1,0) [0|0] "V" Vector__XXX
 SG_ 电压119 : 32|8@1+ (1,0) [0|0] "V" Vector__XXX
 SG_ 电压120 : 48|8@1+ (1,0) [0|0] "V" Vector__XXX

BA_ "VFrameFormat" BO_ 2552156659 1;
CM_ BO_ 2552156659 "电压117 / 电压118 | 信号数 4";
CM_ SG_ 2552156659 电压117 "电压117 [原始公式: (x1+x2%16*256)/1000.000]";
CM_ SG_ 2552156659 电压118 "电压118 [原始公式: (x1+x2%16*256)/1000.000]";
CM_ SG_ 2552156659 电压119 "电压119 [原始公式: (x1+x2%16*256)/1000.000]";
CM_ SG_ 2552156659 电压120 "电压120 [原始公式: (x1+x2%16*256)/1000.000]";

BO_ 2552222195 ZT_181FD1F3: 8 Vector__XXX
 SG_ 电压121 : 0|8@1+ (1,0) [0|0] "V" Vector__XXX
 SG_ 电压122 : 16|8@1+ (1,0) [0|0] "V" Vector__XXX
 SG_ 电压123 : 32|8@1+ (1,0) [0|0] "V" Vector__XXX
 SG_ 电压124 : 48|8@1+ (1,0) [0|0] "V" Vector__XXX

BA_ "VFrameFormat" BO_ 2552222195 1;
CM_ BO_ 2552222195 "电压121 / 电压122 | 信号数 4";
CM_ SG_ 2552222195 电压121 "电压121 [原始公式: (x1+x2%16*256)/1000.000]";
CM_ SG_ 2552222195 电压122 "电压122 [原始公式: (x1+x2%16*256)/1000.000]";
CM_ SG_ 2552222195 电压123 "电压123 [原始公式: (x1+x2%16*256)/1000.000]";
CM_ SG_ 2552222195 电压124 "电压124 [原始公式: (x1+x2%16*256)/1000.000]";

BO_ 2552287731 ZT_1820D1F3: 8 Vector__XXX
 SG_ 电压125 : 0|8@1+ (1,0) [0|0] "V" Vector__XXX
 SG_ 电压126 : 16|8@1+ (1,0) [0|0] "V" Vector__XXX
 SG_ 电压127 : 32|8@1+ (1,0) [0|0] "V" Vector__XXX
 SG_ 电压128 : 48|8@1+ (1,0) [0|0] "V" Vector__XXX

BA_ "VFrameFormat" BO_ 2552287731 1;
CM_ BO_ 2552287731 "电压125 / 电压126 | 信号数 4";
CM_ SG_ 2552287731 电压125 "电压125 [原始公式: (x1+x2%16*256)/1000.000]";
CM_ SG_ 2552287731 电压126 "电压126 [原始公式: (x1+x2%16*256)/1000.000]";
CM_ SG_ 2552287731 电压127 "电压127 [原始公式: (x1+x2%16*256)/1000.000]";
CM_ SG_ 2552287731 电压128 "电压128 [原始公式: (x1+x2%16*256)/1000.000]";

BO_ 2552315154 ZT_18213D12: 8 Vector__XXX
 SG_ DCDC当前工作状态 : 0|2@1+ (1,0) [0|3] "" Vector__XXX
 SG_ DCDC故障等级 : 2|6@1+ (1,0) [0|63] "" Vector__XXX
 SG_ DCDC心跳信号1 : 56|8@1+ (1,0) [0|255] "" Vector__XXX
 SG_ DCDC输出电压 : 8|16@1+ (0.1,0) [0|1000] "A" Vector__XXX
 SG_ DCDC输出电流 : 24|16@1+ (0.1,0) [0|1000] "A" Vector__XXX
 SG_ DCDC输出功率限值 : 40|16@1+ (0.1,0) [0|1000] "KW" Vector__XXX

BA_ "VFrameFormat" BO_ 2552315154 1;
CM_ BO_ 2552315154 "DCDC当前工作状态 / DCDC心跳信号1 | 信号数 6";
CM_ SG_ 2552315154 DCDC当前工作状态 "DCDC当前工作状态 [枚举: 待机|准备|预充|工作|停止|错误]";
VAL_ 2552315154 DCDC当前工作状态 0 "待机" 1 "准备" 2 "预充" 3 "工作" 4 "停止" 5 "错误";
CM_ SG_ 2552315154 DCDC故障等级 "DCDC故障等级 [枚举: 无故障|故障不需要处理,故障消除后,故障码自动清除|DCDC自动降载,清除此故障需重新复位开 机命令|DCDC立即关机,清除此故障需重新上电]";
VAL_ 2552315154 DCDC故障等级 0 "无故障" 1 "故障不需要处理,故障消除后,故障码自动清除" 2 "DCDC自动降载,清除此故障需重新复位开 机命令" 3 "DCDC立即关机,清除此故障需重新上电";
CM_ SG_ 2552315154 DCDC心跳信号1 "DCDC心跳信号1";
CM_ SG_ 2552315154 DCDC输出电压 "DCDC输出电压";
CM_ SG_ 2552315154 DCDC输出电流 "DCDC输出电流";
CM_ SG_ 2552315154 DCDC输出功率限值 "DCDC输出功率限值";

BO_ 2552342427 ZT_1821A79B: 8 Vector__XXX
 SG_ 油泵逆变器输出V相电压 : 0|16@1+ (1,0) [0|1000] "V" Vector__XXX
 SG_ 油泵逆变器输出V相电流 : 16|16@1+ (0.1,0) [0|100] "A" Vector__XXX
 SG_ 油泵逆变器输出W相电压 : 32|16@1+ (1,0) [0|1000] "V" Vector__XXX
 SG_ 油泵逆变器输出W相电流 : 48|16@1+ (0.1,0) [0|100] "A" Vector__XXX

BA_ "VFrameFormat" BO_ 2552342427 1;
CM_ BO_ 2552342427 "油泵逆变器输出V相电压 / 油泵逆变器输出V相电流 | 信号数 13";
CM_ SG_ 2552342427 油泵逆变器输出V相电压 "油泵逆变器输出V相电压";
CM_ SG_ 2552342427 油泵逆变器输出V相电流 "油泵逆变器输出V相电流";
CM_ SG_ 2552342427 油泵逆变器输出W相电压 "油泵逆变器输出W相电压";
CM_ SG_ 2552342427 油泵逆变器输出W相电流 "油泵逆变器输出W相电流";

BO_ 2552342429 ZT_1821A79D: 8 Vector__XXX
 SG_ 气泵DC/AC输出V相电压 : 0|16@1+ (1,0) [0|1000] "V" Vector__XXX
 SG_ 气泵DC/AC输出V相电流 : 16|16@1+ (0.1,0) [0|100] "A" Vector__XXX
 SG_ 气泵DC/AC输出W相电压 : 32|16@1+ (1,0) [0|1000] "V" Vector__XXX
 SG_ 气泵DC/AC输出W相电流 : 48|16@1+ (0.1,0) [0|100] "A" Vector__XXX

BA_ "VFrameFormat" BO_ 2552342429 1;
CM_ BO_ 2552342429 "气泵DC/AC输出V相电压 / 气泵DC/AC输出V相电流 | 信号数 5";
CM_ SG_ 2552342429 气泵DC/AC输出V相电压 "气泵DC/AC输出V相电压";
CM_ SG_ 2552342429 气泵DC/AC输出V相电流 "气泵DC/AC输出V相电流";
CM_ SG_ 2552342429 气泵DC/AC输出W相电压 "气泵DC/AC输出W相电压";
CM_ SG_ 2552342429 气泵DC/AC输出W相电流 "气泵DC/AC输出W相电流";

BO_ 2552353267 ZT_1821D1F3: 8 Vector__XXX
 SG_ 电压129 : 0|8@1+ (1,0) [0|0] "V" Vector__XXX
 SG_ 电压130 : 16|8@1+ (1,0) [0|0] "V" Vector__XXX
 SG_ 电压131 : 32|8@1+ (1,0) [0|0] "V" Vector__XXX
 SG_ 电压132 : 48|8@1+ (1,0) [0|0] "V" Vector__XXX

BA_ "VFrameFormat" BO_ 2552353267 1;
CM_ BO_ 2552353267 "电压129 / 电压130 | 信号数 4";
CM_ SG_ 2552353267 电压129 "电压129 [原始公式: (x1+x2%16*256)/1000.000]";
CM_ SG_ 2552353267 电压130 "电压130 [原始公式: (x1+x2%16*256)/1000.000]";
CM_ SG_ 2552353267 电压131 "电压131 [原始公式: (x1+x2%16*256)/1000.000]";
CM_ SG_ 2552353267 电压132 "电压132 [原始公式: (x1+x2%16*256)/1000.000]";

BO_ 2552380690 ZT_18223D12: 8 Vector__XXX
 SG_ DCDC温度 : 48|8@1+ (1,0) [-40|150] "℃" Vector__XXX
 SG_ DCDC心跳信号2 : 56|8@1+ (1,0) [0|255] "" Vector__XXX
 SG_ DCDC输入电压 : 0|16@1+ (0.1,0) [0|1000] "V" Vector__XXX
 SG_ DCDC输入电流 : 16|16@1+ (0.1,0) [0|1000] "V" Vector__XXX
 SG_ DCDC可输入最大电流 : 32|16@1+ (0.1,0) [0|1000] "V" Vector__XXX

BA_ "VFrameFormat" BO_ 2552380690 1;
CM_ BO_ 2552380690 "DCDC可输入最大电流 / DCDC心跳信号2 | 信号数 5";
CM_ SG_ 2552380690 DCDC温度 "DCDC温度";
CM_ SG_ 2552380690 DCDC心跳信号2 "DCDC心跳信号2";
CM_ SG_ 2552380690 DCDC输入电压 "DCDC输入电压";
CM_ SG_ 2552380690 DCDC输入电流 "DCDC输入电流";
CM_ SG_ 2552380690 DCDC可输入最大电流 "DCDC可输入最大电流";

BO_ 2552418803 ZT_1822D1F3: 8 Vector__XXX
 SG_ 电压133 : 0|8@1+ (1,0) [0|0] "V" Vector__XXX
 SG_ 电压134 : 16|8@1+ (1,0) [0|0] "V" Vector__XXX
 SG_ 电压135 : 32|8@1+ (1,0) [0|0] "V" Vector__XXX
 SG_ 电压136 : 48|8@1+ (1,0) [0|0] "V" Vector__XXX

BA_ "VFrameFormat" BO_ 2552418803 1;
CM_ BO_ 2552418803 "电压133 / 电压134 | 信号数 4";
CM_ SG_ 2552418803 电压133 "电压133 [原始公式: (x1+x2%16*256)/1000.000]";
CM_ SG_ 2552418803 电压134 "电压134 [原始公式: (x1+x2%16*256)/1000.000]";
CM_ SG_ 2552418803 电压135 "电压135 [原始公式: (x1+x2%16*256)/1000.000]";
CM_ SG_ 2552418803 电压136 "电压136 [原始公式: (x1+x2%16*256)/1000.000]";

BO_ 2552446226 ZT_18233D12: 8 Vector__XXX
 SG_ 硬件版本号 : 40|8@1+ (1,0) [0|255] "" Vector__XXX
 SG_ 软件版本号 : 48|8@1+ (1,0) [0|255] "" Vector__XXX
 SG_ DCDC心跳信号3 : 56|8@1+ (1,0) [0|255] "" Vector__XXX
 SG_ DCDC模块电量积累 : 0|16@1+ (0.1,0) [0|60000] "kwh" Vector__XXX

BA_ "VFrameFormat" BO_ 2552446226 1;
CM_ BO_ 2552446226 "DCDC心跳信号3 / DCDC模块电量积累 | 信号数 4";
CM_ SG_ 2552446226 硬件版本号 "硬件版本号 [原始公式: if((BYTE[5])==1) 0; else if((BYTE[5])==2) 1; else if((BYTE[5])==3) 2; else if((BYTE[5])==4) 3; else if((BYTE[5])==5) 4; else if((BYTE[5])==6) 5; else if((BYTE[5])==7) 6; else if((BYTE[5])==8) 7; else if((BYTE[5])==9) 8; else if((BYTE[5])==10) 9; else 10] [枚举: V0.1|V0.2|V0.3|V0.4|V0.5|V0.6|V0.7|V0.8|V0.9|V1.0|预留]";
CM_ SG_ 2552446226 软件版本号 "软件版本号 [原始公式: if((BYTE[6])==1) 0; else if((BYTE[6])==2) 1; else if((BYTE[6])==3) 2; else if((BYTE[6])==4) 3; else if((BYTE[6])==5) 4; else if((BYTE[6])==6) 5; else if((BYTE[6])==7) 6; else if((BYTE[6])==8) 7; else if((BYTE[6])==9) 8; else if((BYTE[6])==10) 9; else 10] [枚举: V0.1|V0.2|V0.3|V0.4|V0.5|V0.6|V0.7|V0.8|V0.9|V1.0|预留]";
CM_ SG_ 2552446226 DCDC心跳信号3 "DCDC心跳信号3";
CM_ SG_ 2552446226 DCDC模块电量积累 "DCDC模块电量积累";

BO_ 2552484339 ZT_1823D1F3: 8 Vector__XXX
 SG_ 电压137 : 0|8@1+ (1,0) [0|0] "V" Vector__XXX
 SG_ 电压138 : 16|8@1+ (1,0) [0|0] "V" Vector__XXX
 SG_ 电压139 : 32|8@1+ (1,0) [0|0] "V" Vector__XXX
 SG_ 电压140 : 48|8@1+ (1,0) [0|0] "V" Vector__XXX

BA_ "VFrameFormat" BO_ 2552484339 1;
CM_ BO_ 2552484339 "电压137 / 电压138 | 信号数 4";
CM_ SG_ 2552484339 电压137 "电压137 [原始公式: (x1+x2%16*256)/1000.000]";
CM_ SG_ 2552484339 电压138 "电压138 [原始公式: (x1+x2%16*256)/1000.000]";
CM_ SG_ 2552484339 电压139 "电压139 [原始公式: (x1+x2%16*256)/1000.000]";
CM_ SG_ 2552484339 电压140 "电压140 [原始公式: (x1+x2%16*256)/1000.000]";

BO_ 2552511762 ZT_18243D12: 8 Vector__XXX
 SG_ 输入欠压3级故障 : 0|1@1+ (1,0) [0|1] "" Vector__XXX
 SG_ 输入过压3级故障 : 1|1@1+ (1,0) [0|1] "" Vector__XXX
 SG_ 输出欠压3级故障 : 2|1@1+ (1,0) [0|1] "" Vector__XXX
 SG_ 输出过压3级故障 : 3|1@1+ (1,0) [0|1] "" Vector__XXX
 SG_ 输入过流3级故障 : 4|1@1+ (1,0) [0|1] "" Vector__XXX
 SG_ 输出过流3级故障 : 5|1@1+ (1,0) [0|1] "" Vector__XXX
 SG_ DCDC过温3级故障 : 6|1@1+ (1,0) [0|1] "" Vector__XXX
 SG_ DCDC内部故障3级故障 : 7|1@1+ (1,0) [0|1] "" Vector__XXX
 SG_ 输入欠压2级故障 : 16|1@1+ (1,0) [0|1] "" Vector__XXX
 SG_ 输入过压2级故障 : 17|1@1+ (1,0) [0|1] "" Vector__XXX
 SG_ 输出欠压2级故障 : 18|1@1+ (1,0) [0|1] "" Vector__XXX
 SG_ 输出过压2级故障 : 19|1@1+ (1,0) [0|1] "" Vector__XXX
 SG_ 输入过流2级故障 : 20|1@1+ (1,0) [0|1] "" Vector__XXX
 SG_ 输出过流2级故障 : 21|1@1+ (1,0) [0|1] "" Vector__XXX
 SG_ DCDC过温2级故障 : 22|1@1+ (1,0) [0|1] "" Vector__XXX
 SG_ DCDC内部故障2级故障 : 23|1@1+ (1,0) [0|1] "" Vector__XXX
 SG_ 输入欠压1级故障 : 32|1@1+ (1,0) [0|1] "" Vector__XXX
 SG_ 输入过压1级故障 : 33|1@1+ (1,0) [0|1] "" Vector__XXX
 SG_ 输出欠压1级故障 : 34|1@1+ (1,0) [0|1] "" Vector__XXX
 SG_ 输出过压1级故障 : 35|1@1+ (1,0) [0|1] "" Vector__XXX
 SG_ 输入过流1级故障 : 36|1@1+ (1,0) [0|1] "" Vector__XXX
 SG_ 输出过流1级故障 : 37|1@1+ (1,0) [0|1] "" Vector__XXX
 SG_ DCDC过温1级故障 : 38|1@1+ (1,0) [0|1] "" Vector__XXX
 SG_ 通信故障1级故障 : 39|1@1+ (1,0) [0|1] "" Vector__XXX
 SG_ 高压互锁故障 : 40|1@1+ (1,0) [0|1] "" Vector__XXX
 SG_ DCDC内部故障1级故障 : 41|1@1+ (1,0) [0|1] "" Vector__XXX
 SG_ 输入预充失败 : 42|1@1+ (1,0) [0|1] "" Vector__XXX
 SG_ 输出预充失败 : 43|1@1+ (1,0) [0|1] "" Vector__XXX

BA_ "VFrameFormat" BO_ 2552511762 1;
CM_ BO_ 2552511762 "DCDC内部故障1级故障 / DCDC内部故障2级故障 | 信号数 28";
CM_ SG_ 2552511762 输入欠压3级故障 "输入欠压3级故障";
CM_ SG_ 2552511762 输入过压3级故障 "输入过压3级故障";
CM_ SG_ 2552511762 输出欠压3级故障 "输出欠压3级故障";
CM_ SG_ 2552511762 输出过压3级故障 "输出过压3级故障";
CM_ SG_ 2552511762 输入过流3级故障 "输入过流3级故障";
CM_ SG_ 2552511762 输出过流3级故障 "输出过流3级故障";
CM_ SG_ 2552511762 DCDC过温3级故障 "DCDC过温3级故障";
CM_ SG_ 2552511762 DCDC内部故障3级故障 "DCDC内部故障3级故障";
CM_ SG_ 2552511762 输入欠压2级故障 "输入欠压2级故障";
CM_ SG_ 2552511762 输入过压2级故障 "输入过压2级故障";
CM_ SG_ 2552511762 输出欠压2级故障 "输出欠压2级故障";
CM_ SG_ 2552511762 输出过压2级故障 "输出过压2级故障";
CM_ SG_ 2552511762 输入过流2级故障 "输入过流2级故障";
CM_ SG_ 2552511762 输出过流2级故障 "输出过流2级故障";
CM_ SG_ 2552511762 DCDC过温2级故障 "DCDC过温2级故障";
CM_ SG_ 2552511762 DCDC内部故障2级故障 "DCDC内部故障2级故障";
CM_ SG_ 2552511762 输入欠压1级故障 "输入欠压1级故障";
CM_ SG_ 2552511762 输入过压1级故障 "输入过压1级故障";
CM_ SG_ 2552511762 输出欠压1级故障 "输出欠压1级故障";
CM_ SG_ 2552511762 输出过压1级故障 "输出过压1级故障";
CM_ SG_ 2552511762 输入过流1级故障 "输入过流1级故障";
CM_ SG_ 2552511762 输出过流1级故障 "输出过流1级故障";
CM_ SG_ 2552511762 DCDC过温1级故障 "DCDC过温1级故障";
CM_ SG_ 2552511762 通信故障1级故障 "通信故障1级故障";
CM_ SG_ 2552511762 高压互锁故障 "高压互锁故障";
CM_ SG_ 2552511762 DCDC内部故障1级故障 "DCDC内部故障1级故障";
CM_ SG_ 2552511762 输入预充失败 "输入预充失败";
CM_ SG_ 2552511762 输出预充失败 "输出预充失败";

BO_ 2552549875 ZT_1824D1F3: 8 Vector__XXX
 SG_ 电压141 : 0|8@1+ (1,0) [0|0] "V" Vector__XXX
 SG_ 电压142 : 16|8@1+ (1,0) [0|0] "V" Vector__XXX
 SG_ 电压143 : 32|8@1+ (1,0) [0|0] "V" Vector__XXX
 SG_ 电压144 : 48|8@1+ (1,0) [0|0] "V" Vector__XXX

BA_ "VFrameFormat" BO_ 2552549875 1;
CM_ BO_ 2552549875 "电压141 / 电压142 | 信号数 4";
CM_ SG_ 2552549875 电压141 "电压141 [原始公式: (x1+x2%16*256)/1000.000]";
CM_ SG_ 2552549875 电压142 "电压142 [原始公式: (x1+x2%16*256)/1000.000]";
CM_ SG_ 2552549875 电压143 "电压143 [原始公式: (x1+x2%16*256)/1000.000]";
CM_ SG_ 2552549875 电压144 "电压144 [原始公式: (x1+x2%16*256)/1000.000]";

BO_ 2552615411 ZT_1825D1F3: 8 Vector__XXX
 SG_ 电压145 : 0|8@1+ (1,0) [0|0] "V" Vector__XXX
 SG_ 电压146 : 16|8@1+ (1,0) [0|0] "V" Vector__XXX
 SG_ 电压147 : 32|8@1+ (1,0) [0|0] "V" Vector__XXX
 SG_ 电压148 : 48|8@1+ (1,0) [0|0] "V" Vector__XXX

BA_ "VFrameFormat" BO_ 2552615411 1;
CM_ BO_ 2552615411 "电压145 / 电压146 | 信号数 4";
CM_ SG_ 2552615411 电压145 "电压145 [原始公式: (x1+x2%16*256)/1000.000]";
CM_ SG_ 2552615411 电压146 "电压146 [原始公式: (x1+x2%16*256)/1000.000]";
CM_ SG_ 2552615411 电压147 "电压147 [原始公式: (x1+x2%16*256)/1000.000]";
CM_ SG_ 2552615411 电压148 "电压148 [原始公式: (x1+x2%16*256)/1000.000]";

BO_ 2552680947 ZT_1826D1F3: 8 Vector__XXX
 SG_ 电压149 : 0|8@1+ (1,0) [0|0] "V" Vector__XXX
 SG_ 电压150 : 16|8@1+ (1,0) [0|0] "V" Vector__XXX
 SG_ 电压151 : 32|8@1+ (1,0) [0|0] "V" Vector__XXX
 SG_ 电压152 : 48|8@1+ (1,0) [0|0] "V" Vector__XXX

BA_ "VFrameFormat" BO_ 2552680947 1;
CM_ BO_ 2552680947 "电压149 / 电压150 | 信号数 4";
CM_ SG_ 2552680947 电压149 "电压149 [原始公式: (x1+x2%16*256)/1000.000]";
CM_ SG_ 2552680947 电压150 "电压150 [原始公式: (x1+x2%16*256)/1000.000]";
CM_ SG_ 2552680947 电压151 "电压151 [原始公式: (x1+x2%16*256)/1000.000]";
CM_ SG_ 2552680947 电压152 "电压152 [原始公式: (x1+x2%16*256)/1000.000]";

BO_ 2552746483 ZT_1827D1F3: 8 Vector__XXX
 SG_ 电压153 : 0|8@1+ (1,0) [0|0] "V" Vector__XXX
 SG_ 电压154 : 16|8@1+ (1,0) [0|0] "V" Vector__XXX
 SG_ 电压155 : 32|8@1+ (1,0) [0|0] "V" Vector__XXX
 SG_ 电压156 : 48|8@1+ (1,0) [0|0] "V" Vector__XXX

BA_ "VFrameFormat" BO_ 2552746483 1;
CM_ BO_ 2552746483 "电压153 / 电压154 | 信号数 4";
CM_ SG_ 2552746483 电压153 "电压153 [原始公式: (x1+x2%16*256)/1000.000]";
CM_ SG_ 2552746483 电压154 "电压154 [原始公式: (x1+x2%16*256)/1000.000]";
CM_ SG_ 2552746483 电压155 "电压155 [原始公式: (x1+x2%16*256)/1000.000]";
CM_ SG_ 2552746483 电压156 "电压156 [原始公式: (x1+x2%16*256)/1000.000]";

BO_ 2552812019 ZT_1828D1F3: 8 Vector__XXX
 SG_ 电压157 : 0|8@1+ (1,0) [0|0] "V" Vector__XXX
 SG_ 电压158 : 16|8@1+ (1,0) [0|0] "V" Vector__XXX
 SG_ 电压159 : 32|8@1+ (1,0) [0|0] "V" Vector__XXX
 SG_ 电压160 : 48|8@1+ (1,0) [0|0] "V" Vector__XXX

BA_ "VFrameFormat" BO_ 2552812019 1;
CM_ BO_ 2552812019 "电压157 / 电压158 | 信号数 4";
CM_ SG_ 2552812019 电压157 "电压157 [原始公式: (x1+x2%16*256)/1000.000]";
CM_ SG_ 2552812019 电压158 "电压158 [原始公式: (x1+x2%16*256)/1000.000]";
CM_ SG_ 2552812019 电压159 "电压159 [原始公式: (x1+x2%16*256)/1000.000]";
CM_ SG_ 2552812019 电压160 "电压160 [原始公式: (x1+x2%16*256)/1000.000]";

BO_ 2552877555 ZT_1829D1F3: 8 Vector__XXX
 SG_ 电压161 : 0|8@1+ (1,0) [0|0] "V" Vector__XXX
 SG_ 电压162 : 16|8@1+ (1,0) [0|0] "V" Vector__XXX
 SG_ 电压163 : 32|8@1+ (1,0) [0|0] "V" Vector__XXX
 SG_ 电压164 : 48|8@1+ (1,0) [0|0] "V" Vector__XXX

BA_ "VFrameFormat" BO_ 2552877555 1;
CM_ BO_ 2552877555 "电压161 / 电压162 | 信号数 4";
CM_ SG_ 2552877555 电压161 "电压161 [原始公式: (x1+x2%16*256)/1000.000]";
CM_ SG_ 2552877555 电压162 "电压162 [原始公式: (x1+x2%16*256)/1000.000]";
CM_ SG_ 2552877555 电压163 "电压163 [原始公式: (x1+x2%16*256)/1000.000]";
CM_ SG_ 2552877555 电压164 "电压164 [原始公式: (x1+x2%16*256)/1000.000]";

BO_ 2552943091 ZT_182AD1F3: 8 Vector__XXX
 SG_ 电压165 : 0|8@1+ (1,0) [0|0] "V" Vector__XXX
 SG_ 电压166 : 16|8@1+ (1,0) [0|0] "V" Vector__XXX
 SG_ 电压167 : 32|8@1+ (1,0) [0|0] "V" Vector__XXX
 SG_ 电压168 : 48|8@1+ (1,0) [0|0] "V" Vector__XXX

BA_ "VFrameFormat" BO_ 2552943091 1;
CM_ BO_ 2552943091 "电压165 / 电压166 | 信号数 4";
CM_ SG_ 2552943091 电压165 "电压165 [原始公式: (x1+x2%16*256)/1000.000]";
CM_ SG_ 2552943091 电压166 "电压166 [原始公式: (x1+x2%16*256)/1000.000]";
CM_ SG_ 2552943091 电压167 "电压167 [原始公式: (x1+x2%16*256)/1000.000]";
CM_ SG_ 2552943091 电压168 "电压168 [原始公式: (x1+x2%16*256)/1000.000]";

BO_ 2553391003 ZT_1831A79B: 8 Vector__XXX
 SG_ 油泵电机转速 : 0|16@1+ (1,-15000) [-15000|15000] "rpm" Vector__XXX
 SG_ 油泵输出频率 : 16|16@1+ (0.01,0) [0|600] "Hz" Vector__XXX
 SG_ 油泵电机转矩 : 32|16@1+ (1,0) [0|500] "Nm" Vector__XXX

BA_ "VFrameFormat" BO_ 2553391003 1;
CM_ BO_ 2553391003 "油泵电机转矩 / 油泵电机转速 | 信号数 7";
CM_ SG_ 2553391003 油泵电机转速 "油泵电机转速";
CM_ SG_ 2553391003 油泵输出频率 "油泵输出频率";
CM_ SG_ 2553391003 油泵电机转矩 "油泵电机转矩";

BO_ 2553391005 ZT_1831A79D: 8 Vector__XXX
 SG_ 气泵电机转速 : 0|16@1+ (1,-15000) [-15000|15000] "rpm" Vector__XXX
 SG_ 气泵输出频率 : 16|16@1+ (0.01,0) [0|600] "Hz" Vector__XXX
 SG_ 气泵电机转矩 : 32|16@1+ (1,0) [0|500] "Nm" Vector__XXX

BA_ "VFrameFormat" BO_ 2553391005 1;
CM_ BO_ 2553391005 "气泵电机转矩 / 气泵电机转速 | 信号数 4";
CM_ SG_ 2553391005 气泵电机转速 "气泵电机转速";
CM_ SG_ 2553391005 气泵输出频率 "气泵输出频率";
CM_ SG_ 2553391005 气泵电机转矩 "气泵电机转矩";

BO_ 2554188275 ZT_183DD1F3: 8 Vector__XXX
 SG_ 温度1 : 0|8@1+ (1,-40) [0|0] "℃" Vector__XXX
 SG_ 温度2 : 8|8@1+ (1,-40) [0|0] "℃" Vector__XXX
 SG_ 温度3 : 16|8@1+ (1,-40) [0|0] "℃" Vector__XXX
 SG_ 温度4 : 24|8@1+ (1,-40) [0|0] "℃" Vector__XXX
 SG_ 温度5 : 32|8@1+ (1,-40) [0|0] "℃" Vector__XXX
 SG_ 温度6 : 40|8@1+ (1,-40) [0|0] "℃" Vector__XXX
 SG_ 温度7 : 48|8@1+ (1,-40) [0|0] "℃" Vector__XXX
 SG_ 温度8 : 56|8@1+ (1,-40) [0|0] "℃" Vector__XXX

BA_ "VFrameFormat" BO_ 2554188275 1;
CM_ BO_ 2554188275 "温度1 / 温度2 | 信号数 8";
CM_ SG_ 2554188275 温度1 "温度1";
CM_ SG_ 2554188275 温度2 "温度2";
CM_ SG_ 2554188275 温度3 "温度3";
CM_ SG_ 2554188275 温度4 "温度4";
CM_ SG_ 2554188275 温度5 "温度5";
CM_ SG_ 2554188275 温度6 "温度6";
CM_ SG_ 2554188275 温度7 "温度7";
CM_ SG_ 2554188275 温度8 "温度8";

BO_ 2554253811 ZT_183ED1F3: 8 Vector__XXX
 SG_ 温度9 : 0|8@1+ (1,-40) [0|0] "℃" Vector__XXX
 SG_ 温度10 : 8|8@1+ (1,-40) [0|0] "℃" Vector__XXX
 SG_ 温度11 : 16|8@1+ (1,-40) [0|0] "℃" Vector__XXX
 SG_ 温度12 : 24|8@1+ (1,-40) [0|0] "℃" Vector__XXX
 SG_ 温度13 : 32|8@1+ (1,-40) [0|0] "℃" Vector__XXX
 SG_ 温度14 : 40|8@1+ (1,-40) [0|0] "℃" Vector__XXX

BA_ "VFrameFormat" BO_ 2554253811 1;
CM_ BO_ 2554253811 "温度10 / 温度11 | 信号数 6";
CM_ SG_ 2554253811 温度9 "温度9";
CM_ SG_ 2554253811 温度10 "温度10";
CM_ SG_ 2554253811 温度11 "温度11";
CM_ SG_ 2554253811 温度12 "温度12";
CM_ SG_ 2554253811 温度13 "温度13";
CM_ SG_ 2554253811 温度14 "温度14";

BO_ 2556206245 ZT_185C9CA5: 8 Vector__XXX
 SG_ 控制器故障信号 : 56|8@1+ (1,0) [0|255] "" Vector__XXX
 SG_ DCAC故障代码1 : 0|8@1+ (1,0) [0|255] "" Vector__XXX
 SG_ DCAC故障代码2 : 8|8@1+ (1,0) [0|255] "" Vector__XXX
 SG_ DCAC控制器温度 : 48|8@1+ (1,-40) [-40|215] "℃" Vector__XXX
 SG_ DCAC输入电压 : 16|16@1+ (0.1,0) [0|655] "V" Vector__XXX
 SG_ DCAC输入电流 : 32|16@1+ (0.1,0) [0|655] "A" Vector__XXX

BA_ "VFrameFormat" BO_ 2556206245 1;
CM_ BO_ 2556206245 "DCAC控制器温度 / DCAC故障代码1 | 信号数 6";
CM_ SG_ 2556206245 控制器故障信号 "控制器故障信号 [枚举: 正常|故障]";
VAL_ 2556206245 控制器故障信号 0 "正常" 1 "故障";
CM_ SG_ 2556206245 DCAC故障代码1 "DCAC故障代码1";
CM_ SG_ 2556206245 DCAC故障代码2 "DCAC故障代码2";
CM_ SG_ 2556206245 DCAC控制器温度 "DCAC控制器温度";
CM_ SG_ 2556206245 DCAC输入电压 "DCAC输入电压";
CM_ SG_ 2556206245 DCAC输入电流 "DCAC输入电流";

BO_ 2556271781 ZT_185D9CA5: 8 Vector__XXX
 SG_ 油泵电机转速 : 0|16@1+ (0.5,-3000) [-3000|29767.5] "rpm" Vector__XXX
 SG_ DCAC输出电压 : 16|16@1+ (0.1,0) [0|655] "V" Vector__XXX
 SG_ DCAC输出电流 : 32|16@1+ (0.1,0) [0|655] "A" Vector__XXX
 SG_ 油泵电机转矩 : 48|16@1+ (1,0) [0|5000] "N.m" Vector__XXX

BA_ "VFrameFormat" BO_ 2556271781 1;
CM_ BO_ 2556271781 "DCAC输出电压 / DCAC输出电流 | 信号数 4";
CM_ SG_ 2556271781 油泵电机转速 "油泵电机转速";
CM_ SG_ 2556271781 DCAC输出电压 "DCAC输出电压";
CM_ SG_ 2556271781 DCAC输出电流 "DCAC输出电流";
CM_ SG_ 2556271781 油泵电机转矩 "油泵电机转矩";

BO_ 2557254822 ZT_186C9CA6: 8 Vector__XXX
 SG_ 控制器故障信号 : 56|8@1+ (1,0) [0|2] "" Vector__XXX
 SG_ DCAC故障代码1 : 0|8@1+ (1,0) [0|255] "" Vector__XXX
 SG_ DCAC故障代码2 : 8|8@1+ (1,0) [0|255] "" Vector__XXX
 SG_ DCAC控制器温度 : 48|8@1+ (1,-40) [-40|215] "℃" Vector__XXX
 SG_ DCAC输入电压 : 16|16@1+ (0.1,0) [0|655] "V" Vector__XXX
 SG_ DCAC输入电流 : 32|16@1+ (0.1,0) [0|655] "A" Vector__XXX

BA_ "VFrameFormat" BO_ 2557254822 1;
CM_ BO_ 2557254822 "DCAC控制器温度 / DCAC故障代码1 | 信号数 6";
CM_ SG_ 2557254822 控制器故障信号 "控制器故障信号 [枚举: 正常|故障]";
VAL_ 2557254822 控制器故障信号 0 "正常" 1 "故障";
CM_ SG_ 2557254822 DCAC故障代码1 "DCAC故障代码1";
CM_ SG_ 2557254822 DCAC故障代码2 "DCAC故障代码2";
CM_ SG_ 2557254822 DCAC控制器温度 "DCAC控制器温度";
CM_ SG_ 2557254822 DCAC输入电压 "DCAC输入电压";
CM_ SG_ 2557254822 DCAC输入电流 "DCAC输入电流";

BO_ 2557320358 ZT_186D9CA6: 8 Vector__XXX
 SG_ 气泵电机转速 : 0|16@1+ (0.5,-3000) [-3000|3000] "rpm" Vector__XXX
 SG_ DCAC输出电压 : 16|16@1+ (0.1,0) [0|655] "V" Vector__XXX
 SG_ DCAC输出电流 : 32|16@1+ (0.1,0) [0|655] "A" Vector__XXX
 SG_ 气泵电机转矩 : 48|16@1+ (1,0) [0|5000] "N.m" Vector__XXX

BA_ "VFrameFormat" BO_ 2557320358 1;
CM_ BO_ 2557320358 "DCAC输出电压 / DCAC输出电流 | 信号数 4";
CM_ SG_ 2557320358 气泵电机转速 "气泵电机转速";
CM_ SG_ 2557320358 DCAC输出电压 "DCAC输出电压";
CM_ SG_ 2557320358 DCAC输出电流 "DCAC输出电流";
CM_ SG_ 2557320358 气泵电机转矩 "气泵电机转矩";

BO_ 2558303399 ZT_187C9CA7: 8 Vector__XXX
 SG_ DCDC输入欠压 : 48|1@1+ (1,0) [0|1] "" Vector__XXX
 SG_ DCDC硬件古 : 55|1@1+ (1,0) [0|1] "" Vector__XXX
 SG_ DCDC过热故障 : 54|1@1+ (1,0) [0|1] "" Vector__XXX
 SG_ DCDC短路故障 : 53|1@1+ (1,0) [0|1] "" Vector__XXX
 SG_ DCDC过流故障 : 52|1@1+ (1,0) [0|1] "" Vector__XXX
 SG_ DCDC限流故障 : 51|1@1+ (1,0) [0|1] "" Vector__XXX
 SG_ DCDC输出过压故障 : 50|1@1+ (1,0) [0|1] "" Vector__XXX
 SG_ DCDC输入过压故障 : 49|1@1+ (1,0) [0|1] "" Vector__XXX
 SG_ DCDC工作状态 : 1|2@1+ (1,0) [0|3] "" Vector__XXX
 SG_ DCDC故障级别 : 3|2@1+ (1,0) [0|3] "" Vector__XXX
 SG_ DCDC输出电压 : 8|8@1+ (0.2,0) [0|50] "V" Vector__XXX
 SG_ DCDC输出电流 : 16|8@1+ (1,0) [0|250] "A" Vector__XXX
 SG_ DCDC控制器温度 : 24|8@1+ (1,-40) [-40|150] "℃" Vector__XXX
 SG_ DCDC输入功率 : 32|8@1+ (0.1,0) [0|25] "kW" Vector__XXX
 SG_ DCDC-Life信号 : 40|8@1+ (1,0) [0|255] "" Vector__XXX
 SG_ 通讯协议版本 : 56|8@1+ (1,0) [1|255] "" Vector__XXX

BA_ "VFrameFormat" BO_ 2558303399 1;
CM_ BO_ 2558303399 "DCDC-Life信号 / DCDC基本状态 | 信号数 17";
CM_ SG_ 2558303399 DCDC输入欠压 "DCDC输入欠压 [枚举: 正常|故障]";
VAL_ 2558303399 DCDC输入欠压 0 "正常" 1 "故障";
CM_ SG_ 2558303399 DCDC硬件古 "DCDC硬件古 [枚举: 正常|故障]";
VAL_ 2558303399 DCDC硬件古 0 "正常" 1 "故障";
CM_ SG_ 2558303399 DCDC过热故障 "DCDC过热故障 [枚举: 正常|故障]";
VAL_ 2558303399 DCDC过热故障 0 "正常" 1 "故障";
CM_ SG_ 2558303399 DCDC短路故障 "DCDC短路故障 [枚举: 正常|故障]";
VAL_ 2558303399 DCDC短路故障 0 "正常" 1 "故障";
CM_ SG_ 2558303399 DCDC过流故障 "DCDC过流故障 [枚举: 正常|故障]";
VAL_ 2558303399 DCDC过流故障 0 "正常" 1 "故障";
CM_ SG_ 2558303399 DCDC限流故障 "DCDC限流故障 [枚举: 正常|故障]";
VAL_ 2558303399 DCDC限流故障 0 "正常" 1 "故障";
CM_ SG_ 2558303399 DCDC输出过压故障 "DCDC输出过压故障 [枚举: 正常|故障]";
VAL_ 2558303399 DCDC输出过压故障 0 "正常" 1 "故障";
CM_ SG_ 2558303399 DCDC输入过压故障 "DCDC输入过压故障 [枚举: 正常|故障]";
VAL_ 2558303399 DCDC输入过压故障 0 "正常" 1 "故障";
CM_ SG_ 2558303399 DCDC工作状态 "DCDC工作状态 [枚举: 停机|充电|充电完成|预留]";
VAL_ 2558303399 DCDC工作状态 0 "停机" 1 "充电" 2 "充电完成" 3 "预留";
CM_ SG_ 2558303399 DCDC故障级别 "DCDC故障级别 [枚举: 一级故障|二级故障|三级故障|无故障]";
VAL_ 2558303399 DCDC故障级别 0 "一级故障" 1 "二级故障" 2 "三级故障" 3 "无故障";
CM_ SG_ 2558303399 DCDC输出电压 "DCDC输出电压";
CM_ SG_ 2558303399 DCDC输出电流 "DCDC输出电流";
CM_ SG_ 2558303399 DCDC控制器温度 "DCDC控制器温度";
CM_ SG_ 2558303399 DCDC输入功率 "DCDC输入功率";
CM_ SG_ 2558303399 DCDC-Life信号 "DCDC-Life信号";
CM_ SG_ 2558303399 通讯协议版本 "通讯协议版本";

BO_ 2559351976 ZT_188C9CA8: 8 Vector__XXX
 SG_ 油泵控制器输入欠压 : 48|1@1+ (1,0) [0|1] "" Vector__XXX
 SG_ 油泵控制器输入过压 : 49|1@1+ (1,0) [0|1] "" Vector__XXX
 SG_ 油泵控制器输出过流 : 50|1@1+ (1,0) [0|1] "" Vector__XXX
 SG_ 油泵控制器温度过高 : 51|1@1+ (1,0) [0|1] "" Vector__XXX
 SG_ 油泵控制器输出缺相 : 52|1@1+ (1,0) [0|1] "" Vector__XXX
 SG_ 油泵控制器过载 : 53|1@1+ (1,0) [0|1] "" Vector__XXX
 SG_ 其它故障 : 54|1@1+ (1,0) [0|1] "" Vector__XXX
 SG_ 生命信号 : 56|8@1+ (1,0) [0|255] "" Vector__XXX
 SG_ 输入电压 : 0|8@1+ (0.2,0) [18|36] "V" Vector__XXX
 SG_ 工作状态 : 32|8@1+ (1,0) [0|255] "" Vector__XXX
 SG_ 控制器温度 : 40|8@1+ (1,-40) [-40|150] "℃" Vector__XXX
 SG_ 输出电流 : 16|16@1+ (0.1,0) [0|150] "A" Vector__XXX

BA_ "VFrameFormat" BO_ 2559351976 1;
CM_ BO_ 2559351976 "其它故障 / 工作状态 | 信号数 13";
CM_ SG_ 2559351976 油泵控制器输入欠压 "油泵控制器输入欠压 [枚举: 正常|故障]";
VAL_ 2559351976 油泵控制器输入欠压 0 "正常" 1 "故障";
CM_ SG_ 2559351976 油泵控制器输入过压 "油泵控制器输入过压 [枚举: 正常|故障]";
VAL_ 2559351976 油泵控制器输入过压 0 "正常" 1 "故障";
CM_ SG_ 2559351976 油泵控制器输出过流 "油泵控制器输出过流 [枚举: 正常|故障]";
VAL_ 2559351976 油泵控制器输出过流 0 "正常" 1 "故障";
CM_ SG_ 2559351976 油泵控制器温度过高 "油泵控制器温度过高 [枚举: 正常|故障]";
VAL_ 2559351976 油泵控制器温度过高 0 "正常" 1 "故障";
CM_ SG_ 2559351976 油泵控制器输出缺相 "油泵控制器输出缺相 [枚举: 正常|故障]";
VAL_ 2559351976 油泵控制器输出缺相 0 "正常" 1 "故障";
CM_ SG_ 2559351976 油泵控制器过载 "油泵控制器过载 [枚举: 正常|故障]";
VAL_ 2559351976 油泵控制器过载 0 "正常" 1 "故障";
CM_ SG_ 2559351976 其它故障 "其它故障 [枚举: 正常|故障]";
VAL_ 2559351976 其它故障 0 "正常" 1 "故障";
CM_ SG_ 2559351976 生命信号 "生命信号 [枚举: 正常|故障]";
VAL_ 2559351976 生命信号 0 "正常" 1 "故障";
CM_ SG_ 2559351976 输入电压 "输入电压";
CM_ SG_ 2559351976 工作状态 "工作状态";
CM_ SG_ 2559351976 控制器温度 "控制器温度";
CM_ SG_ 2559351976 输出电流 "输出电流";

BO_ 2559352232 ZT_188C9DA8: 8 Vector__XXX
 SG_ 低压油泵 DCAC 工作状态 : 0|2@1+ (1,0) [0|3] "" Vector__XXX
 SG_ 故障代码 : 32|8@1+ (1,0) [0|0] "" Vector__XXX
 SG_ 心跳信号 : 16|6@1+ (1,0) [0|63] "" Vector__XXX
 SG_ 低压油泵输出相电流 : 24|8@1+ (1,0) [0|250] "A" Vector__XXX
 SG_ 低压油泵控制器温度 : 56|8@1+ (1,0) [-40|250] "deg C" Vector__XXX
 SG_ 低压油泵电机转速 : 40|16@1+ (1,0) [0|3000] "rpm" Vector__XXX

BA_ "VFrameFormat" BO_ 2559352232 1;
CM_ BO_ 2559352232 "低压油泵 DCAC 工作状态 / 低压油泵控制器温度 | 信号数 9";
CM_ SG_ 2559352232 低压油泵 DCAC 工作状态 "低压油泵 DCAC 工作状态 [枚举: 关机|待机|运行|故障停机]";
VAL_ 2559352232 低压油泵 DCAC 工作状态 0 "关机" 1 "待机" 2 "运行" 3 "故障停机";
CM_ SG_ 2559352232 故障代码 "故障代码 [枚举: 无故障|输入过流|输入过压|输入欠压|过载保护|输出缺相|电机失速|电流检测故障]";
VAL_ 2559352232 故障代码 0 "无故障" 1 "输入过流" 2 "输入过压" 3 "输入欠压" 4 "过载保护" 5 "输出缺相" 6 "电机失速" 7 "电流检测故障";
CM_ SG_ 2559352232 心跳信号 "心跳信号";
CM_ SG_ 2559352232 低压油泵输出相电流 "低压油泵输出相电流";
CM_ SG_ 2559352232 低压油泵控制器温度 "低压油泵控制器温度";
CM_ SG_ 2559352232 低压油泵电机转速 "低压油泵电机转速";

BO_ 2559574255 ZT_189000EF: 8 Vector__XXX
 SG_ DCDC温度报警状态 : 16|1@1+ (1,0) [0|1] "" Vector__XXX
 SG_ 制动系统报警状态 : 17|1@1+ (1,0) [0|1] "" Vector__XXX
 SG_ DCDC状态报警状态 : 18|1@1+ (1,0) [0|1] "" Vector__XXX
 SG_ 电机控制器温度状态 : 19|1@1+ (1,0) [0|1] "" Vector__XXX
 SG_ 高压互锁状态 : 20|1@1+ (1,0) [0|1] "" Vector__XXX
 SG_ 电机温度报警状态 : 21|1@1+ (1,0) [0|1] "" Vector__XXX
 SG_ 发动机高温报警状态 : 22|1@1+ (1,0) [0|1] "" Vector__XXX
 SG_ 最高故障等级 : 0|4@1+ (1,0) [0|15] "" Vector__XXX
 SG_ 驱动电机故障总数 : 4|4@1+ (1,0) [0|15] "" Vector__XXX
 SG_ 发动机故障总数 : 8|4@1+ (1,0) [0|15] "" Vector__XXX
 SG_ 其他故障总数 : 12|4@1+ (1,0) [0|15] "" Vector__XXX

BA_ "VFrameFormat" BO_ 2559574255 1;
CM_ BO_ 2559574255 "DCDC温度报警-1 / DCDC温度报警-2 | 信号数 29";
CM_ SG_ 2559574255 DCDC温度报警状态 "DCDC温度报警状态 [枚举: 无故障|有故障]";
VAL_ 2559574255 DCDC温度报警状态 0 "无故障" 1 "有故障";
CM_ SG_ 2559574255 制动系统报警状态 "制动系统报警状态 [枚举: 无故障|有故障]";
VAL_ 2559574255 制动系统报警状态 0 "无故障" 1 "有故障";
CM_ SG_ 2559574255 DCDC状态报警状态 "DCDC状态报警状态 [枚举: 无故障|有故障]";
VAL_ 2559574255 DCDC状态报警状态 0 "无故障" 1 "有故障";
CM_ SG_ 2559574255 电机控制器温度状态 "电机控制器温度状态 [枚举: 无故障|有故障]";
VAL_ 2559574255 电机控制器温度状态 0 "无故障" 1 "有故障";
CM_ SG_ 2559574255 高压互锁状态 "高压互锁状态 [枚举: 无故障|有故障]";
VAL_ 2559574255 高压互锁状态 0 "无故障" 1 "有故障";
CM_ SG_ 2559574255 电机温度报警状态 "电机温度报警状态 [枚举: 无故障|有故障]";
VAL_ 2559574255 电机温度报警状态 0 "无故障" 1 "有故障";
CM_ SG_ 2559574255 发动机高温报警状态 "发动机高温报警状态 [枚举: 无故障|有故障]";
VAL_ 2559574255 发动机高温报警状态 0 "无故障" 1 "有故障";
CM_ SG_ 2559574255 最高故障等级 "最高故障等级";
CM_ SG_ 2559574255 驱动电机故障总数 "驱动电机故障总数";
CM_ SG_ 2559574255 发动机故障总数 "发动机故障总数";
CM_ SG_ 2559574255 其他故障总数 "其他故障总数";

BO_ 2559645423 ZT_189116EF: 8 Vector__XXX
 SG_ 助力转向使能信号 : 0|1@1+ (1,0) [0|0] "" Vector__XXX
 SG_ 水泵使能信号 : 1|1@1+ (1,0) [0|0] "" Vector__XXX
 SG_ 电机控制器使能信号-1 : 2|1@1+ (1,0) [0|0] "" Vector__XXX
 SG_ 电池管理系统使能信号 : 3|1@1+ (1,0) [0|0] "" Vector__XXX
 SG_ ON档信号 : 4|1@1+ (1,0) [0|0] "" Vector__XXX
 SG_ 空调开机信号 : 10|1@1+ (1,0) [0|0] "" Vector__XXX
 SG_ 充电枪信号 : 11|1@1+ (1,0) [0|0] "" Vector__XXX
 SG_ DCDC使能信号 : 12|1@1+ (1,0) [0|0] "" Vector__XXX
 SG_ 暖风使能信号 : 13|1@1+ (1,0) [0|0] "" Vector__XXX
 SG_ 除霜使能信号 : 14|1@1+ (1,0) [0|0] "" Vector__XXX
 SG_ 空调使能信号 : 15|1@1+ (1,0) [0|0] "" Vector__XXX
 SG_ 干燥器排气开关信号 : 16|1@1+ (1,0) [0|0] "" Vector__XXX
 SG_ 打气泵使能信号 : 17|1@1+ (1,0) [0|0] "" Vector__XXX
 SG_ 每天首次打气信号 : 18|1@1+ (1,0) [0|0] "" Vector__XXX
 SG_ 后舱门信号 : 19|1@1+ (1,0) [0|0] "" Vector__XXX
 SG_ 助力转向停机信号 : 20|1@1+ (1,0) [0|0] "" Vector__XXX
 SG_ 助力转向限功信号 : 21|1@1+ (1,0) [0|0] "" Vector__XXX
 SG_ 充电口接近开关信号 : 22|1@1+ (1,0) [0|0] "" Vector__XXX
 SG_ 高压急断信号 : 23|1@1+ (1,0) [0|0] "" Vector__XXX
 SG_ 钥匙启动信号 : 24|1@1+ (1,0) [0|0] "" Vector__XXX
 SG_ 制动踏板开关量信号 : 25|1@1+ (1,0) [0|0] "" Vector__XXX
 SG_ 滑行能量回收一档 : 26|1@1+ (1,0) [0|0] "" Vector__XXX
 SG_ 滑行能量回收二档 : 27|1@1+ (1,0) [0|0] "" Vector__XXX
 SG_ 雪地模式触发信号 : 28|1@1+ (1,0) [0|0] "" Vector__XXX
 SG_ 手刹信号-1 : 29|1@1+ (1,0) [0|0] "" Vector__XXX
 SG_ 起步阻止信号 : 30|1@1+ (1,0) [0|0] "" Vector__XXX
 SG_ ABS工作信号 : 31|1@1+ (1,0) [0|0] "" Vector__XXX
 SG_ R 倒档硬线信号 : 32|1@1+ (1,0) [0|0] "" Vector__XXX
 SG_ N 空档硬线信号 : 33|1@1+ (1,0) [0|0] "" Vector__XXX
 SG_ D 前进档硬线信号 : 34|1@1+ (1,0) [0|0] "" Vector__XXX
 SG_ 散热风扇使能信号 : 35|1@1+ (1,0) [0|0] "" Vector__XXX
 SG_ 倒车提示信号 : 36|1@1+ (1,0) [0|0] "" Vector__XXX
 SG_ 电暖风（PTC）加热使能信号 : 37|1@1+ (1,0) [0|0] "" Vector__XXX
 SG_ 制动信号-1 : 38|1@1+ (1,0) [0|0] "" Vector__XXX
 SG_ 动力电池散热风扇使能信号 : 39|1@1+ (1,0) [0|0] "" Vector__XXX
 SG_ 电加热冷凝器信号 : 48|1@1+ (1,0) [0|0] "" Vector__XXX
 SG_ 制动灯信号 : 49|1@1+ (1,0) [0|0] "" Vector__XXX
 SG_ 门控继电器信号 : 50|1@1+ (1,0) [0|0] "" Vector__XXX
 SG_ PEM管脚输出占空比 : 40|8@1+ (0.4,0) [0|100] "%" Vector__XXX

BA_ "VFrameFormat" BO_ 2559645423 1;
CM_ BO_ 2559645423 "ABS工作信号 / ABS工作信号（输入） | 信号数 80";
CM_ SG_ 2559645423 助力转向使能信号 "助力转向使能信号 [枚举: 无效|有效]";
VAL_ 2559645423 助力转向使能信号 0 "无效" 1 "有效";
CM_ SG_ 2559645423 水泵使能信号 "水泵使能信号 [枚举: 无效|有效]";
VAL_ 2559645423 水泵使能信号 0 "无效" 1 "有效";
CM_ SG_ 2559645423 电机控制器使能信号-1 "电机控制器使能信号-1 [枚举: 无效|有效]";
VAL_ 2559645423 电机控制器使能信号-1 0 "无效" 1 "有效";
CM_ SG_ 2559645423 电池管理系统使能信号 "电池管理系统使能信号 [枚举: 无效|有效]";
VAL_ 2559645423 电池管理系统使能信号 0 "无效" 1 "有效";
CM_ SG_ 2559645423 ON档信号 "ON档信号 [枚举: 无效|有效]";
VAL_ 2559645423 ON档信号 0 "无效" 1 "有效";
CM_ SG_ 2559645423 空调开机信号 "空调开机信号 [枚举: 无效|有效]";
VAL_ 2559645423 空调开机信号 0 "无效" 1 "有效";
CM_ SG_ 2559645423 充电枪信号 "充电枪信号 [枚举: 无效|有效]";
VAL_ 2559645423 充电枪信号 0 "无效" 1 "有效";
CM_ SG_ 2559645423 DCDC使能信号 "DCDC使能信号 [枚举: 无效|有效]";
VAL_ 2559645423 DCDC使能信号 0 "无效" 1 "有效";
CM_ SG_ 2559645423 暖风使能信号 "暖风使能信号 [枚举: 无效|有效]";
VAL_ 2559645423 暖风使能信号 0 "无效" 1 "有效";
CM_ SG_ 2559645423 除霜使能信号 "除霜使能信号 [枚举: 无效|有效]";
VAL_ 2559645423 除霜使能信号 0 "无效" 1 "有效";
CM_ SG_ 2559645423 空调使能信号 "空调使能信号 [枚举: 无效|有效]";
VAL_ 2559645423 空调使能信号 0 "无效" 1 "有效";
CM_ SG_ 2559645423 干燥器排气开关信号 "干燥器排气开关信号 [枚举: 无效|有效]";
VAL_ 2559645423 干燥器排气开关信号 0 "无效" 1 "有效";
CM_ SG_ 2559645423 打气泵使能信号 "打气泵使能信号 [枚举: 无效|有效]";
VAL_ 2559645423 打气泵使能信号 0 "无效" 1 "有效";
CM_ SG_ 2559645423 每天首次打气信号 "每天首次打气信号 [枚举: 无效|有效]";
VAL_ 2559645423 每天首次打气信号 0 "无效" 1 "有效";
CM_ SG_ 2559645423 后舱门信号 "后舱门信号 [枚举: 无效|有效]";
VAL_ 2559645423 后舱门信号 0 "无效" 1 "有效";
CM_ SG_ 2559645423 助力转向停机信号 "助力转向停机信号 [枚举: 无效|有效]";
VAL_ 2559645423 助力转向停机信号 0 "无效" 1 "有效";
CM_ SG_ 2559645423 助力转向限功信号 "助力转向限功信号 [枚举: 无效|有效]";
VAL_ 2559645423 助力转向限功信号 0 "无效" 1 "有效";
CM_ SG_ 2559645423 充电口接近开关信号 "充电口接近开关信号 [枚举: 无效|有效]";
VAL_ 2559645423 充电口接近开关信号 0 "无效" 1 "有效";
CM_ SG_ 2559645423 高压急断信号 "高压急断信号 [枚举: 无效|有效]";
VAL_ 2559645423 高压急断信号 0 "无效" 1 "有效";
CM_ SG_ 2559645423 钥匙启动信号 "钥匙启动信号 [枚举: 无效|有效]";
VAL_ 2559645423 钥匙启动信号 0 "无效" 1 "有效";
CM_ SG_ 2559645423 制动踏板开关量信号 "制动踏板开关量信号 [枚举: 无效|有效]";
VAL_ 2559645423 制动踏板开关量信号 0 "无效" 1 "有效";
CM_ SG_ 2559645423 滑行能量回收一档 "滑行能量回收一档 [枚举: 无效|有效]";
VAL_ 2559645423 滑行能量回收一档 0 "无效" 1 "有效";
CM_ SG_ 2559645423 滑行能量回收二档 "滑行能量回收二档 [枚举: 无效|有效]";
VAL_ 2559645423 滑行能量回收二档 0 "无效" 1 "有效";
CM_ SG_ 2559645423 雪地模式触发信号 "雪地模式触发信号 [枚举: 无效|有效]";
VAL_ 2559645423 雪地模式触发信号 0 "无效" 1 "有效";
CM_ SG_ 2559645423 手刹信号-1 "手刹信号-1 [枚举: 无效|有效]";
VAL_ 2559645423 手刹信号-1 0 "无效" 1 "有效";
CM_ SG_ 2559645423 起步阻止信号 "起步阻止信号 [枚举: 无效|有效]";
VAL_ 2559645423 起步阻止信号 0 "无效" 1 "有效";
CM_ SG_ 2559645423 ABS工作信号 "ABS工作信号 [枚举: 无效|有效]";
VAL_ 2559645423 ABS工作信号 0 "无效" 1 "有效";
CM_ SG_ 2559645423 R 倒档硬线信号 "R 倒档硬线信号 [枚举: 无效|有效]";
VAL_ 2559645423 R 倒档硬线信号 0 "无效" 1 "有效";
CM_ SG_ 2559645423 N 空档硬线信号 "N 空档硬线信号 [枚举: 无效|有效]";
VAL_ 2559645423 N 空档硬线信号 0 "无效" 1 "有效";
CM_ SG_ 2559645423 D 前进档硬线信号 "D 前进档硬线信号 [枚举: 无效|有效]";
VAL_ 2559645423 D 前进档硬线信号 0 "无效" 1 "有效";
CM_ SG_ 2559645423 散热风扇使能信号 "散热风扇使能信号 [枚举: 无效|有效]";
VAL_ 2559645423 散热风扇使能信号 0 "无效" 1 "有效";
CM_ SG_ 2559645423 倒车提示信号 "倒车提示信号 [枚举: 无效|有效]";
VAL_ 2559645423 倒车提示信号 0 "无效" 1 "有效";
CM_ SG_ 2559645423 电暖风（PTC）加热使能信号 "电暖风（PTC）加热使能信号 [枚举: 无效|有效]";
VAL_ 2559645423 电暖风（PTC）加热使能信号 0 "无效" 1 "有效";
CM_ SG_ 2559645423 制动信号-1 "制动信号-1 [枚举: 无效|有效]";
VAL_ 2559645423 制动信号-1 0 "无效" 1 "有效";
CM_ SG_ 2559645423 动力电池散热风扇使能信号 "动力电池散热风扇使能信号 [枚举: 无效|有效]";
VAL_ 2559645423 动力电池散热风扇使能信号 0 "无效" 1 "有效";
CM_ SG_ 2559645423 电加热冷凝器信号 "电加热冷凝器信号 [枚举: 无效|有效]";
VAL_ 2559645423 电加热冷凝器信号 0 "无效" 1 "有效";
CM_ SG_ 2559645423 制动灯信号 "制动灯信号 [枚举: 无效|有效]";
VAL_ 2559645423 制动灯信号 0 "无效" 1 "有效";
CM_ SG_ 2559645423 门控继电器信号 "门控继电器信号 [枚举: 无效|有效]";
VAL_ 2559645423 门控继电器信号 0 "无效" 1 "有效";
CM_ SG_ 2559645423 PEM管脚输出占空比 "PEM管脚输出占空比";

BO_ 2559677596 ZT_1891949C: 8 Vector__XXX
 SG_ 高压急停请求 : 3|1@1+ (1,0) [0|1] "" Vector__XXX
 SG_ RCU故障等级 : 0|3@1+ (1,0) [0|7] "" Vector__XXX
 SG_ RCU状态 : 4|4@1+ (1,0) [0|15] "" Vector__XXX
 SG_ FISG电机控制器温度 : 40|8@1+ (1,-40) [-40|210] "degC" Vector__XXX
 SG_ FISG电机绕组温度 : 48|8@1+ (1,-40) [-40|210] "degC" Vector__XXX
 SG_ FISG电机实际转速 : 8|16@1+ (1,0) [0|8032] "rpm" Vector__XXX
 SG_ FISG电机实际扭矩 : 24|16@1+ (1,-5000) [-5000|5000] "Nm" Vector__XXX

BA_ "VFrameFormat" BO_ 2559677596 1;
CM_ BO_ 2559677596 "FISG电机实际扭矩 / FISG电机实际转速 | 信号数 8";
CM_ SG_ 2559677596 高压急停请求 "高压急停请求 [枚举: OFF|ON]";
VAL_ 2559677596 高压急停请求 0 "OFF" 1 "ON";
CM_ SG_ 2559677596 RCU故障等级 "RCU故障等级 [枚举: 正常|降功率|强制怠速|RCU不激活|高压断开]";
VAL_ 2559677596 RCU故障等级 0 "正常" 1 "降功率" 2 "强制怠速" 3 "RCU不激活" 4 "高压断开";
CM_ SG_ 2559677596 RCU状态 "RCU状态 [枚举: 程序初始化|RCU未激活|RCU准备就绪|启动发动机|停机|怠速|怠速充电|正常充电|靠边|高压电池主动放电]";
VAL_ 2559677596 RCU状态 0 "程序初始化" 1 "RCU未激活" 2 "RCU准备就绪" 3 "启动发动机" 4 "停机" 5 "怠速" 6 "怠速充电" 7 "正常充电" 8 "靠边" 9 "高压电池主动放电";
CM_ SG_ 2559677596 FISG电机控制器温度 "FISG电机控制器温度";
CM_ SG_ 2559677596 FISG电机绕组温度 "FISG电机绕组温度";
CM_ SG_ 2559677596 FISG电机实际转速 "FISG电机实际转速";
CM_ SG_ 2559677596 FISG电机实际扭矩 "FISG电机实际扭矩";

BO_ 2559743132 ZT_1892949C: 8 Vector__XXX
 SG_ 供能系统功率受限（RCU及电池输出功率） : 48|1@1+ (1,0) [0|1] "" Vector__XXX
 SG_ RCU原始故障等级 : 49|4@1+ (1,0) [0|15] "" Vector__XXX
 SG_ 电机输出电流 : 0|16@1+ (1,-5000) [-5000|1000] "A" Vector__XXX
 SG_ FISG电机输出功率 : 16|16@1+ (1,-2000) [-2000|2000] "kW" Vector__XXX
 SG_ 增程器最大允许功率值 : 32|16@1+ (1,-2000) [-2000|2000] "kW" Vector__XXX

BA_ "VFrameFormat" BO_ 2559743132 1;
CM_ BO_ 2559743132 "FISG电机输出功率 / GCU主动放电状态反馈 | 信号数 7";
CM_ SG_ 2559743132 供能系统功率受限（RCU及电池输出功率） "供能系统功率受限（RCU及电池输出功率） [枚举: OFF|ON]";
VAL_ 2559743132 供能系统功率受限（RCU及电池输出功率） 0 "OFF" 1 "ON";
CM_ SG_ 2559743132 RCU原始故障等级 "RCU原始故障等级 [枚举: 正常|警告|降功率|强制怠速|RCU 停机禁止|条件RCU禁止|靠边停车|RCU 禁止|紧急关闭]";
VAL_ 2559743132 RCU原始故障等级 0 "正常" 1 "警告" 2 "降功率" 3 "强制怠速" 4 "RCU 停机禁止" 5 "条件RCU禁止" 6 "靠边停车" 7 "RCU 禁止" 8 "紧急关闭";
CM_ SG_ 2559743132 电机输出电流 "电机输出电流";
CM_ SG_ 2559743132 FISG电机输出功率 "FISG电机输出功率";
CM_ SG_ 2559743132 增程器最大允许功率值 "增程器最大允许功率值";

BO_ 2559808668 ZT_1893949C: 8 Vector__XXX
 SG_ 增程器FISG电机电压 : 24|16@1+ (1,0) [0|65535] "V" Vector__XXX
 SG_ 増程器累积发电量 : 0|24@1+ (1,0) [0|999999] "kWh" Vector__XXX

BA_ "VFrameFormat" BO_ 2559808668 1;
CM_ BO_ 2559808668 "増程器累积发电量 / 增程器FISG电机电压 | 信号数 3";
CM_ SG_ 2559808668 增程器FISG电机电压 "增程器FISG电机电压";
CM_ SG_ 2559808668 増程器累积发电量 "増程器累积发电量";

BO_ 2565865739 ZT_18F0010B: 8 Vector__XXX
 SG_ ABS激活 : 4|2@1+ (1,0) [0|255] "" Vector__XXX
 SG_ ABS报警 : 44|2@1+ (1,0) [0|255] "" Vector__XXX

BA_ "VFrameFormat" BO_ 2565865739 1;
CM_ BO_ 2565865739 "ABS报警 / ABS激活 | 信号数 2";
CM_ SG_ 2565865739 ABS激活 "ABS激活 [枚举: 关闭|激活|保留|无效]";
VAL_ 2565865739 ABS激活 0 "关闭" 1 "激活" 2 "保留" 3 "无效";
CM_ SG_ 2565865739 ABS报警 "ABS报警 [枚举: 关闭|打开|保留|无动作]";
VAL_ 2565865739 ABS报警 0 "关闭" 1 "打开" 2 "保留" 3 "无动作";

BO_ 2565931216 ZT_18F100D0: 8 Vector__XXX
 SG_ 电助力状态 : 0|2@1+ (1,0) [0|0] "" Vector__XXX

BA_ "VFrameFormat" BO_ 2565931216 1;
CM_ BO_ 2565931216 "DCDC状态 / 电助力状态 | 信号数 3";
CM_ SG_ 2565931216 电助力状态 "电助力状态 [枚举: 停止|运行中|故障|无效数据]";
VAL_ 2565931216 电助力状态 0 "停止" 1 "运行中" 2 "故障";

BO_ 2565931287 ZT_18F10117: 8 Vector__XXX
 SG_ 助力转向温度限功和停机信号 : 0|2@1+ (1,0) [0|0] "" Vector__XXX
 SG_ 打气泵使能信号 : 4|2@1+ (1,0) [0|0] "" Vector__XXX
 SG_ 后舱门互锁状态 : 6|2@1+ (1,0) [0|0] "" Vector__XXX
 SG_ 充电舱门互锁状态 : 8|2@1+ (1,0) [0|0] "" Vector__XXX
 SG_ 乘客门状态 : 22|2@1+ (1,0) [0|0] "" Vector__XXX
 SG_ 右前乘客门 : 24|2@1+ (1,0) [0|0] "" Vector__XXX
 SG_ 转向灯信号 : 26|2@1+ (1,0) [0|0] "" Vector__XXX
 SG_ 后舱门状态 : 28|2@1+ (1,0) [0|0] "" Vector__XXX
 SG_ 右中门状态 : 30|2@1+ (1,0) [0|0] "" Vector__XXX
 SG_ 右后门状态 : 32|2@1+ (1,0) [0|0] "" Vector__XXX
 SG_ 左前门状态 : 34|2@1+ (1,0) [0|0] "" Vector__XXX
 SG_ 左中门状态 : 36|2@1+ (1,0) [0|0] "" Vector__XXX
 SG_ 左后门状态 : 38|2@1+ (1,0) [0|0] "" Vector__XXX
 SG_ 安全带状态 : 40|2@1+ (1,0) [0|0] "" Vector__XXX

BA_ "VFrameFormat" BO_ 2565931287 1;
CM_ BO_ 2565931287 "乘客门 / 乘客门状态 | 信号数 14";
CM_ SG_ 2565931287 助力转向温度限功和停机信号 "助力转向温度限功和停机信号 [枚举: 正常|温度≥120℃|温度≥140℃|无效]";
VAL_ 2565931287 助力转向温度限功和停机信号 0 "正常" 1 "温度≥120℃" 2 "温度≥140℃" 3 "无效";
CM_ SG_ 2565931287 打气泵使能信号 "打气泵使能信号 [枚举: 无使能|有使能|错误|未激活]";
VAL_ 2565931287 打气泵使能信号 0 "无使能" 1 "有使能" 2 "错误" 3 "未激活";
CM_ SG_ 2565931287 后舱门互锁状态 "后舱门互锁状态 [枚举: 开启|闭合|保留|无效]";
VAL_ 2565931287 后舱门互锁状态 0 "开启" 1 "闭合" 2 "保留" 3 "无效";
CM_ SG_ 2565931287 充电舱门互锁状态 "充电舱门互锁状态 [枚举: 开启|闭合|保留|无效]";
VAL_ 2565931287 充电舱门互锁状态 0 "开启" 1 "闭合" 2 "保留" 3 "无效";
CM_ SG_ 2565931287 乘客门状态 "乘客门状态 [枚举: 开启,乘客门其中一个开则为开|闭合 ,乘客门全部关则为关|保留|无效]";
VAL_ 2565931287 乘客门状态 0 "开启,乘客门其中一个开则为开" 1 "闭合 ,乘客门全部关则为关" 2 "保留" 3 "无效";
CM_ SG_ 2565931287 右前乘客门 "右前乘客门 [枚举: 关闭|开启]";
VAL_ 2565931287 右前乘客门 0 "关闭" 1 "开启";
CM_ SG_ 2565931287 转向灯信号 "转向灯信号 [枚举: 未激活|右转向灯激活|左转向灯激活|左右转向灯激活]";
VAL_ 2565931287 转向灯信号 0 "未激活" 1 "右转向灯激活" 2 "左转向灯激活" 3 "左右转向灯激活";
CM_ SG_ 2565931287 后舱门状态 "后舱门状态 [枚举: 关闭|开启]";
VAL_ 2565931287 后舱门状态 0 "关闭" 1 "开启";
CM_ SG_ 2565931287 右中门状态 "右中门状态 [枚举: 关闭|开启]";
VAL_ 2565931287 右中门状态 0 "关闭" 1 "开启";
CM_ SG_ 2565931287 右后门状态 "右后门状态 [枚举: 关闭|开启]";
VAL_ 2565931287 右后门状态 0 "关闭" 1 "开启";
CM_ SG_ 2565931287 左前门状态 "左前门状态 [枚举: 关闭|开启]";
VAL_ 2565931287 左前门状态 0 "关闭" 1 "开启";
CM_ SG_ 2565931287 左中门状态 "左中门状态 [枚举: 关闭|开启]";
VAL_ 2565931287 左中门状态 0 "关闭" 1 "开启";
CM_ SG_ 2565931287 左后门状态 "左后门状态 [枚举: 关闭|开启]";
VAL_ 2565931287 左后门状态 0 "关闭" 1 "开启";
CM_ SG_ 2565931287 安全带状态 "安全带状态 [枚举: 锁止|解开]";
VAL_ 2565931287 安全带状态 0 "锁止" 1 "解开";

BO_ 2565931472 ZT_18F101D0: 8 Vector__XXX
 SG_ VCU(整车控制器)故障(与MCU(驱动电机控制单元)故障点亮同一个符号片) : 32|1@1+ (1,0) [0|0] "" Vector__XXX
 SG_ 变速器故障 : 33|1@1+ (1,0) [0|0] "" Vector__XXX
 SG_ VCU(整车控制器)通信故障 : 34|1@1+ (1,0) [0|0] "" Vector__XXX
 SG_ BMS(电池管理系统)接触器状态命令 : 0|2@1+ (1,0) [0|0] "" Vector__XXX
 SG_ 档位状态 : 24|8@1+ (1,0) [0|0] "" Vector__XXX
 SG_ VCU(整车控制器)系统故障码 : 40|8@1+ (1,0) [0|0] "" Vector__XXX
 SG_ Life(生命值) : 56|8@1+ (1,0) [0|0] "" Vector__XXX
 SG_ 车速 : 8|16@1+ (1,0) [0|0] "km/h" Vector__XXX

BA_ "VFrameFormat" BO_ 2565931472 1;
CM_ BO_ 2565931472 "BMS(电池管理系统)接触器状态命令 / Life(生命值) | 信号数 11";
CM_ SG_ 2565931472 VCU(整车控制器)故障(与MCU(驱动电机控制单元)故障点亮同一个符号片) "VCU(整车控制器)故障(与MCU(驱动电机控制单元)故障点亮同一个符号片) [枚举: 系统故障|无故障]";
VAL_ 2565931472 VCU(整车控制器)故障(与MCU(驱动电机控制单元)故障点亮同一个符号片) 0 "无故障" 1 "系统故障";
CM_ SG_ 2565931472 变速器故障 "变速器故障 [枚举: 系统故障|无故障]";
VAL_ 2565931472 变速器故障 0 "无故障" 1 "系统故障";
CM_ SG_ 2565931472 VCU(整车控制器)通信故障 "VCU(整车控制器)通信故障 [枚举: 报警|正常]";
VAL_ 2565931472 VCU(整车控制器)通信故障 0 "正常" 1 "报警";
CM_ SG_ 2565931472 BMS(电池管理系统)接触器状态命令 "BMS(电池管理系统)接触器状态命令 [枚举: 闭合|切断|未定义]";
VAL_ 2565931472 BMS(电池管理系统)接触器状态命令 0 "闭合" 1 "切断";
CM_ SG_ 2565931472 档位状态 "档位状态 [枚举: 前进档(D)|倒档(R)|空档(N)|前进档(D1)|前进档(D2)|前进档(D3)|前进档(D4)|前进档(D5)|前进档(D6)|前进档(D7)|前进档(D8)|前进档(D9)|前进档(D10)|前进档(D11)|前进档(D12)|无效数据]";
VAL_ 2565931472 档位状态 127 "前进档(D)" 128 "倒档(R)" 129 "空档(N)" 130 "前进档(D1)" 131 "前进档(D2)" 132 "前进档(D3)" 133 "前进档(D4)" 134 "前进档(D5)" 135 "前进档(D6)" 136 "前进档(D7)" 137 "前进档(D8)" 138 "前进档(D9)" 139 "前进档(D10)" 140 "前进档(D11)" 157 "前进档(D12)";
CM_ SG_ 2565931472 VCU(整车控制器)系统故障码 "VCU(整车控制器)系统故障码 [枚举: 无故障|一级故障-VCU(整车控制器) 硬件故障|一级故障-VCU(整车控制器) 供电异常|一级故障-电机控制器预充电故障|一级故障-VCU(整车控制器)与BMS(电池管理系统)通信故障|一级故障-VCU(整车控制器)与MCU(驱动电机控制单元)通信故障|一级故障-VCU(整车控制器)与换档面板通信故障|一级故障-制动踏板故障|一级故障-加速踏板故障|一级故障-换档面板故障|一级故障-电机转速传感器故障|一级故障-变速器故障|一级故障-变速器转速传感器故障|一级故障-变速器位置传感器1故障|一级故障-变速器位置传感器2故障|一级故障-变速器位置传感器3故障|一级故障-变速器位置传感器4故障|一级故障-变速器位置传感器5故障|一级故障-变速器执行器1故障|一级故障-变速器执行器2故障|一级故障-变速器执行器3故障|一级故障-变速器执行器4故障|一级故障-档位啮合故障|一级故障-摘挡故障|一级故障-选档故障|一级故障-挂档故障|一级故障-主接触器常闭故障|一级故障-主接触器常开故障|一级故障-预充接触器故障|MCU(驱动电机控制单元)一级故障|BMS(电池管理系统)一级故障|一级故障-VCU(整车控制器)系统故障|二级故障-车速故障|MCU(驱动电机控制单元)二级故障|BMS(电池管理系统)二级故障|MCU(驱动电机控制单元)三级故障|BMS(电池管理系统)三级故障|无效数据]";
VAL_ 2565931472 VCU(整车控制器)系统故障码 0 "无故障" 1 "一级故障-VCU(整车控制器) 硬件故障" 2 "一级故障-VCU(整车控制器) 供电异常" 3 "一级故障-电机控制器预充电故障" 5 "一级故障-VCU(整车控制器)与BMS(电池管理系统)通信故障" 6 "一级故障-VCU(整车控制器)与MCU(驱动电机控制单元)通信故障" 7 "一级故障-VCU(整车控制器)与换档面板通信故障" 10 "一级故障-制动踏板故障" 11 "一级故障-加速踏板故障" 13 "一级故障-换档面板故障" 15 "一级故障-电机转速传感器故障" 20 "一级故障-变速器故障" 21 "一级故障-变速器转速传感器故障" 23 "一级故障-变速器位置传感器1故障" 24 "一级故障-变速器位置传感器2故障" 25 "一级故障-变速器位置传感器3故障" 26 "一级故障-变速器位置传感器4故障" 27 "一级故障-变速器位置传感器5故障" 29 "一级故障-变速器执行器1故障" 30 "一级故障-变速器执行器2故障" 31 "一级故障-变速器执行器3故障" 32 "一级故障-变速器执行器4故障" 33 "一级故障-档位啮合故障" 34 "一级故障-摘挡故障" 35 "一级故障-选档故障" 36 "一级故障-挂档故障" 37 "一级故障-主接触器常闭故障" 38 "一级故障-主接触器常开故障" 39 "一级故障-预充接触器故障" 40 "MCU(驱动电机控制单元)一级故障" 41 "BMS(电池管理系统)一级故障" 42 "一级故障-VCU(整车控制器)系统故障" 51 "二级故障-车速故障" 52 "MCU(驱动电机控制单元)二级故障" 53 "BMS(电池管理系统)二级故障" 151 "MCU(驱动电机控制单元)三级故障" 152 "BMS(电池管理系统)三级故障";
CM_ SG_ 2565931472 Life(生命值) "Life(生命值)";
CM_ SG_ 2565931472 车速 "车速";

BO_ 2565931507 ZT_UNKNOWN_18F101F3: 8 Vector__XXX
 SG_ 字节0 : 0|8@1+ (1,0) [0|255] "" Vector__XXX
 SG_ 字节1 : 8|8@1+ (1,0) [0|255] "" Vector__XXX
 SG_ 字节2 : 16|8@1+ (1,0) [0|255] "" Vector__XXX
 SG_ 字节3 : 24|8@1+ (1,0) [0|255] "" Vector__XXX
 SG_ 字节4 : 32|8@1+ (1,0) [0|255] "" Vector__XXX
 SG_ 字节5 : 40|8@1+ (1,0) [0|255] "" Vector__XXX
 SG_ 字节6 : 48|8@1+ (1,0) [0|255] "" Vector__XXX
 SG_ 字节7 : 56|8@1+ (1,0) [0|255] "" Vector__XXX

BA_ "VFrameFormat" BO_ 2565931507 1;
CM_ BO_ 2565931507 "电池管理系统 | 无信号定义, 按原始字节输出";
CM_ SG_ 2565931507 字节0 "字节0（原始值，无信号定义）";
CM_ SG_ 2565931507 字节1 "字节1（原始值，无信号定义）";
CM_ SG_ 2565931507 字节2 "字节2（原始值，无信号定义）";
CM_ SG_ 2565931507 字节3 "字节3（原始值，无信号定义）";
CM_ SG_ 2565931507 字节4 "字节4（原始值，无信号定义）";
CM_ SG_ 2565931507 字节5 "字节5（原始值，无信号定义）";
CM_ SG_ 2565931507 字节6 "字节6（原始值，无信号定义）";
CM_ SG_ 2565931507 字节7 "字节7（原始值，无信号定义）";

BO_ 2565931515 ZT_18F101FB: 8 Vector__XXX
 SG_ 发送包序号 : 0|8@1+ (1,0) [0|0] "" Vector__XXX

BA_ "VFrameFormat" BO_ 2565931515 1;
CM_ BO_ 2565931515 "发送包序号 | 信号数 1";
CM_ SG_ 2565931515 发送包序号 "发送包序号";

BO_ 2565931763 ZT_UNKNOWN_18F102F3: 8 Vector__XXX
 SG_ 字节0 : 0|8@1+ (1,0) [0|255] "" Vector__XXX
 SG_ 字节1 : 8|8@1+ (1,0) [0|255] "" Vector__XXX
 SG_ 字节2 : 16|8@1+ (1,0) [0|255] "" Vector__XXX
 SG_ 字节3 : 24|8@1+ (1,0) [0|255] "" Vector__XXX
 SG_ 字节4 : 32|8@1+ (1,0) [0|255] "" Vector__XXX
 SG_ 字节5 : 40|8@1+ (1,0) [0|255] "" Vector__XXX
 SG_ 字节6 : 48|8@1+ (1,0) [0|255] "" Vector__XXX
 SG_ 字节7 : 56|8@1+ (1,0) [0|255] "" Vector__XXX

BA_ "VFrameFormat" BO_ 2565931763 1;
CM_ BO_ 2565931763 "电池管理系统 | 无信号定义, 按原始字节输出";
CM_ SG_ 2565931763 字节0 "字节0（原始值，无信号定义）";
CM_ SG_ 2565931763 字节1 "字节1（原始值，无信号定义）";
CM_ SG_ 2565931763 字节2 "字节2（原始值，无信号定义）";
CM_ SG_ 2565931763 字节3 "字节3（原始值，无信号定义）";
CM_ SG_ 2565931763 字节4 "字节4（原始值，无信号定义）";
CM_ SG_ 2565931763 字节5 "字节5（原始值，无信号定义）";
CM_ SG_ 2565931763 字节6 "字节6（原始值，无信号定义）";
CM_ SG_ 2565931763 字节7 "字节7（原始值，无信号定义）";

BO_ 2565931771 ZT_18F102FB: 8 Vector__XXX
 SG_ 关闭空调 : 16|1@1+ (1,0) [0|0] "" Vector__XXX
 SG_ 关闭PTC(加热器) : 17|1@1+ (1,0) [0|0] "" Vector__XXX
 SG_ 锁车门 : 18|1@1+ (1,0) [0|0] "" Vector__XXX
 SG_ 开车门 : 19|1@1+ (1,0) [0|0] "" Vector__XXX
 SG_ 车载终端自检状态 : 0|8@1+ (1,0) [0|0] "" Vector__XXX
 SG_ 停车指令 : 8|8@1+ (1,0) [0|0] "" Vector__XXX
 SG_ 整车功率限制 : 24|8@1+ (1,-100) [0|0] "%" Vector__XXX

BA_ "VFrameFormat" BO_ 2565931771 1;
CM_ BO_ 2565931771 "停车指令 / 关闭PTC(加热器) | 信号数 7";
CM_ SG_ 2565931771 关闭空调 "关闭空调 [枚举: 有效|无效]";
VAL_ 2565931771 关闭空调 0 "无效" 1 "有效";
CM_ SG_ 2565931771 关闭PTC(加热器) "关闭PTC(加热器) [枚举: 有效|无效]";
VAL_ 2565931771 关闭PTC(加热器) 0 "无效" 1 "有效";
CM_ SG_ 2565931771 锁车门 "锁车门 [枚举: 有效|无效]";
VAL_ 2565931771 锁车门 0 "无效" 1 "有效";
CM_ SG_ 2565931771 开车门 "开车门 [枚举: 有效|无效]";
VAL_ 2565931771 开车门 0 "无效" 1 "有效";
CM_ SG_ 2565931771 车载终端自检状态 "车载终端自检状态 [枚举: 自检通过|车载终端故障|无效数据]";
VAL_ 2565931771 车载终端自检状态 0 "自检通过" 1 "车载终端故障";
CM_ SG_ 2565931771 停车指令 "停车指令 [枚举: 停车|无效|无效数据]";
VAL_ 2565931771 停车指令 170 "停车" 255 "无效";
CM_ SG_ 2565931771 整车功率限制 "整车功率限制";

BO_ 2565931984 ZT_18F103D0: 8 Vector__XXX
 SG_ 车辆行驶模式 : 40|1@1+ (1,0) [0|0] "" Vector__XXX
 SG_ 换档模式 : 41|1@1+ (1,0) [0|0] "" Vector__XXX
 SG_ 动力经济模式 : 42|1@1+ (1,0) [0|0] "" Vector__XXX
 SG_ 拖车模式 : 43|1@1+ (1,0) [0|0] "" Vector__XXX
 SG_ 跛行模式 : 44|1@1+ (1,0) [0|0] "" Vector__XXX
 SG_ 能量回收模式 : 45|1@1+ (1,0) [0|0] "" Vector__XXX
 SG_ 脚刹 : 48|1@1+ (1,0) [0|0] "" Vector__XXX
 SG_ 手刹 : 49|1@1+ (1,0) [0|0] "" Vector__XXX
 SG_ 急停开关 : 50|1@1+ (1,0) [0|0] "" Vector__XXX
 SG_ 转向泵使能 : 56|1@1+ (1,0) [0|0] "" Vector__XXX
 SG_ 打气泵使能 : 57|1@1+ (1,0) [0|0] "" Vector__XXX
 SG_ DC/DC(直流转化器)使能 : 58|1@1+ (1,0) [0|0] "" Vector__XXX
 SG_ 空调使能 : 59|1@1+ (1,0) [0|0] "" Vector__XXX
 SG_ 风扇使能 : 60|1@1+ (1,0) [0|0] "" Vector__XXX
 SG_ 水泵使能 : 61|1@1+ (1,0) [0|0] "" Vector__XXX
 SG_ 加热使能 : 62|1@1+ (1,0) [0|0] "" Vector__XXX
 SG_ 除霜使能 : 63|1@1+ (1,0) [0|0] "" Vector__XXX
 SG_ VCU(整车控制器)版本信息 : 0|8@1+ (0.1,0) [0|0] "" Vector__XXX
 SG_ 油门踏板状态 : 24|8@1+ (0.4,0) [0|0] "%" Vector__XXX
 SG_ 制动踏板状态 : 32|8@1+ (0.4,0) [0|0] "%" Vector__XXX
 SG_ 续航里程 : 8|16@1+ (0.125,0) [0|0] "km" Vector__XXX

BA_ "VFrameFormat" BO_ 2565931984 1;
CM_ BO_ 2565931984 "DC/DC(直流转化器)使能 / VCU(整车控制器)版本信息 | 信号数 21";
CM_ SG_ 2565931984 车辆行驶模式 "车辆行驶模式 [枚举: 爬坡模式|正常模式]";
VAL_ 2565931984 车辆行驶模式 0 "正常模式" 1 "爬坡模式";
CM_ SG_ 2565931984 换档模式 "换档模式 [枚举: 手动模式|自动模式]";
VAL_ 2565931984 换档模式 0 "自动模式" 1 "手动模式";
CM_ SG_ 2565931984 动力经济模式 "动力经济模式 [枚举: 动力模式|经济模式]";
VAL_ 2565931984 动力经济模式 0 "经济模式" 1 "动力模式";
CM_ SG_ 2565931984 拖车模式 "拖车模式 [枚举: 拖车模式|正常模式]";
VAL_ 2565931984 拖车模式 0 "正常模式" 1 "拖车模式";
CM_ SG_ 2565931984 跛行模式 "跛行模式 [枚举: 跛行模式|正常模式]";
VAL_ 2565931984 跛行模式 0 "正常模式" 1 "跛行模式";
CM_ SG_ 2565931984 能量回收模式 "能量回收模式 [枚举: 回收模式|正常模式]";
VAL_ 2565931984 能量回收模式 0 "正常模式" 1 "回收模式";
CM_ SG_ 2565931984 脚刹 "脚刹 [枚举: 有效|无效]";
VAL_ 2565931984 脚刹 0 "无效" 1 "有效";
CM_ SG_ 2565931984 手刹 "手刹 [枚举: 有效|无效]";
VAL_ 2565931984 手刹 0 "无效" 1 "有效";
CM_ SG_ 2565931984 急停开关 "急停开关 [枚举: 有效|无效]";
VAL_ 2565931984 急停开关 0 "无效" 1 "有效";
CM_ SG_ 2565931984 转向泵使能 "转向泵使能 [枚举: 开机|关机]";
VAL_ 2565931984 转向泵使能 0 "关机" 1 "开机";
CM_ SG_ 2565931984 打气泵使能 "打气泵使能 [枚举: 开机|关机]";
VAL_ 2565931984 打气泵使能 0 "关机" 1 "开机";
CM_ SG_ 2565931984 DC/DC(直流转化器)使能 "DC/DC(直流转化器)使能 [枚举: 开机|关机]";
VAL_ 2565931984 DC/DC(直流转化器)使能 0 "关机" 1 "开机";
CM_ SG_ 2565931984 空调使能 "空调使能 [枚举: 开机|关机]";
VAL_ 2565931984 空调使能 0 "关机" 1 "开机";
CM_ SG_ 2565931984 风扇使能 "风扇使能 [枚举: 开机|关机]";
VAL_ 2565931984 风扇使能 0 "关机" 1 "开机";
CM_ SG_ 2565931984 水泵使能 "水泵使能 [枚举: 开机|关机]";
VAL_ 2565931984 水泵使能 0 "关机" 1 "开机";
CM_ SG_ 2565931984 加热使能 "加热使能 [枚举: 开机|关机]";
VAL_ 2565931984 加热使能 0 "关机" 1 "开机";
CM_ SG_ 2565931984 除霜使能 "除霜使能 [枚举: 开机|关机]";
VAL_ 2565931984 除霜使能 0 "关机" 1 "开机";
CM_ SG_ 2565931984 VCU(整车控制器)版本信息 "VCU(整车控制器)版本信息";
CM_ SG_ 2565931984 油门踏板状态 "油门踏板状态";
CM_ SG_ 2565931984 制动踏板状态 "制动踏板状态";
CM_ SG_ 2565931984 续航里程 "续航里程";

BO_ 2565932019 ZT_UNKNOWN_18F103F3: 8 Vector__XXX
 SG_ 字节0 : 0|8@1+ (1,0) [0|255] "" Vector__XXX
 SG_ 字节1 : 8|8@1+ (1,0) [0|255] "" Vector__XXX
 SG_ 字节2 : 16|8@1+ (1,0) [0|255] "" Vector__XXX
 SG_ 字节3 : 24|8@1+ (1,0) [0|255] "" Vector__XXX
 SG_ 字节4 : 32|8@1+ (1,0) [0|255] "" Vector__XXX
 SG_ 字节5 : 40|8@1+ (1,0) [0|255] "" Vector__XXX
 SG_ 字节6 : 48|8@1+ (1,0) [0|255] "" Vector__XXX
 SG_ 字节7 : 56|8@1+ (1,0) [0|255] "" Vector__XXX

BA_ "VFrameFormat" BO_ 2565932019 1;
CM_ BO_ 2565932019 "电池管理系统 | 无信号定义, 按原始字节输出";
CM_ SG_ 2565932019 字节0 "字节0（原始值，无信号定义）";
CM_ SG_ 2565932019 字节1 "字节1（原始值，无信号定义）";
CM_ SG_ 2565932019 字节2 "字节2（原始值，无信号定义）";
CM_ SG_ 2565932019 字节3 "字节3（原始值，无信号定义）";
CM_ SG_ 2565932019 字节4 "字节4（原始值，无信号定义）";
CM_ SG_ 2565932019 字节5 "字节5（原始值，无信号定义）";
CM_ SG_ 2565932019 字节6 "字节6（原始值，无信号定义）";
CM_ SG_ 2565932019 字节7 "字节7（原始值，无信号定义）";

BO_ 2565932240 ZT_18F104D0: 8 Vector__XXX
 SG_ 车辆信息-车辆状态 : 0|4@1+ (1,0) [0|0] "" Vector__XXX

BA_ "VFrameFormat" BO_ 2565932240 1;
CM_ BO_ 2565932240 "车辆信息-车辆状态 / 车辆信息-运行状态 | 信号数 2";
CM_ SG_ 2565932240 车辆信息-车辆状态 "车辆信息-车辆状态 [枚举: 车辆启动状态|熄火|其他状态|异常|无效|无效数据]";
VAL_ 2565932240 车辆信息-车辆状态 1 "车辆启动状态" 2 "熄火" 3 "其他状态" 14 "异常" 15 "无效";

BO_ 2565932275 ZT_UNKNOWN_18F104F3: 8 Vector__XXX
 SG_ 字节0 : 0|8@1+ (1,0) [0|255] "" Vector__XXX
 SG_ 字节1 : 8|8@1+ (1,0) [0|255] "" Vector__XXX
 SG_ 字节2 : 16|8@1+ (1,0) [0|255] "" Vector__XXX
 SG_ 字节3 : 24|8@1+ (1,0) [0|255] "" Vector__XXX
 SG_ 字节4 : 32|8@1+ (1,0) [0|255] "" Vector__XXX
 SG_ 字节5 : 40|8@1+ (1,0) [0|255] "" Vector__XXX
 SG_ 字节6 : 48|8@1+ (1,0) [0|255] "" Vector__XXX
 SG_ 字节7 : 56|8@1+ (1,0) [0|255] "" Vector__XXX

BA_ "VFrameFormat" BO_ 2565932275 1;
CM_ BO_ 2565932275 "电池管理系统 | 无信号定义, 按原始字节输出";
CM_ SG_ 2565932275 字节0 "字节0（原始值，无信号定义）";
CM_ SG_ 2565932275 字节1 "字节1（原始值，无信号定义）";
CM_ SG_ 2565932275 字节2 "字节2（原始值，无信号定义）";
CM_ SG_ 2565932275 字节3 "字节3（原始值，无信号定义）";
CM_ SG_ 2565932275 字节4 "字节4（原始值，无信号定义）";
CM_ SG_ 2565932275 字节5 "字节5（原始值，无信号定义）";
CM_ SG_ 2565932275 字节6 "字节6（原始值，无信号定义）";
CM_ SG_ 2565932275 字节7 "字节7（原始值，无信号定义）";

BO_ 2565932496 ZT_18F105D0: 8 Vector__XXX
 SG_ 制动力 : 44|1@1+ (1,0) [0|0] "" Vector__XXX
 SG_ 驱动力 : 45|1@1+ (1,0) [0|0] "" Vector__XXX
 SG_ 档位 : 40|4@1+ (1,0) [0|0] "" Vector__XXX
 SG_ DCDC(直流转化直流)状态 : 32|8@1+ (1,0) [0|0] "" Vector__XXX

BA_ "VFrameFormat" BO_ 2565932496 1;
CM_ BO_ 2565932496 "DCDC(直流转化直流)状态 / 制动力 | 信号数 5";
CM_ SG_ 2565932496 制动力 "制动力 [枚举: 有|无]";
VAL_ 2565932496 制动力 0 "无" 1 "有";
CM_ SG_ 2565932496 驱动力 "驱动力 [枚举: 有|无]";
VAL_ 2565932496 驱动力 0 "无" 1 "有";
CM_ SG_ 2565932496 档位 "档位 [枚举: 空档|1档|2档|3档|4档|5档|6档|倒档|自动D档|停车P档|无效数据]";
VAL_ 2565932496 档位 0 "空档" 1 "1档" 2 "2档" 3 "3档" 4 "4档" 5 "5档" 6 "6档" 13 "倒档" 14 "自动D档" 15 "停车P档";
CM_ SG_ 2565932496 DCDC(直流转化直流)状态 "DCDC(直流转化直流)状态 [枚举: 工作|断开|异常|无效|无效数据]";
VAL_ 2565932496 DCDC(直流转化直流)状态 1 "工作" 2 "断开" 254 "异常" 255 "无效";

BO_ 2565932531 ZT_UNKNOWN_18F105F3: 8 Vector__XXX
 SG_ 字节0 : 0|8@1+ (1,0) [0|255] "" Vector__XXX
 SG_ 字节1 : 8|8@1+ (1,0) [0|255] "" Vector__XXX
 SG_ 字节2 : 16|8@1+ (1,0) [0|255] "" Vector__XXX
 SG_ 字节3 : 24|8@1+ (1,0) [0|255] "" Vector__XXX
 SG_ 字节4 : 32|8@1+ (1,0) [0|255] "" Vector__XXX
 SG_ 字节5 : 40|8@1+ (1,0) [0|255] "" Vector__XXX
 SG_ 字节6 : 48|8@1+ (1,0) [0|255] "" Vector__XXX
 SG_ 字节7 : 56|8@1+ (1,0) [0|255] "" Vector__XXX

BA_ "VFrameFormat" BO_ 2565932531 1;
CM_ BO_ 2565932531 "电池管理系统 | 无信号定义, 按原始字节输出";
CM_ SG_ 2565932531 字节0 "字节0（原始值，无信号定义）";
CM_ SG_ 2565932531 字节1 "字节1（原始值，无信号定义）";
CM_ SG_ 2565932531 字节2 "字节2（原始值，无信号定义）";
CM_ SG_ 2565932531 字节3 "字节3（原始值，无信号定义）";
CM_ SG_ 2565932531 字节4 "字节4（原始值，无信号定义）";
CM_ SG_ 2565932531 字节5 "字节5（原始值，无信号定义）";
CM_ SG_ 2565932531 字节6 "字节6（原始值，无信号定义）";
CM_ SG_ 2565932531 字节7 "字节7（原始值，无信号定义）";

BO_ 2565932787 ZT_UNKNOWN_18F106F3: 8 Vector__XXX
 SG_ 字节0 : 0|8@1+ (1,0) [0|255] "" Vector__XXX
 SG_ 字节1 : 8|8@1+ (1,0) [0|255] "" Vector__XXX
 SG_ 字节2 : 16|8@1+ (1,0) [0|255] "" Vector__XXX
 SG_ 字节3 : 24|8@1+ (1,0) [0|255] "" Vector__XXX
 SG_ 字节4 : 32|8@1+ (1,0) [0|255] "" Vector__XXX
 SG_ 字节5 : 40|8@1+ (1,0) [0|255] "" Vector__XXX
 SG_ 字节6 : 48|8@1+ (1,0) [0|255] "" Vector__XXX
 SG_ 字节7 : 56|8@1+ (1,0) [0|255] "" Vector__XXX

BA_ "VFrameFormat" BO_ 2565932787 1;
CM_ BO_ 2565932787 "电池管理系统 | 无信号定义, 按原始字节输出";
CM_ SG_ 2565932787 字节0 "字节0（原始值，无信号定义）";
CM_ SG_ 2565932787 字节1 "字节1（原始值，无信号定义）";
CM_ SG_ 2565932787 字节2 "字节2（原始值，无信号定义）";
CM_ SG_ 2565932787 字节3 "字节3（原始值，无信号定义）";
CM_ SG_ 2565932787 字节4 "字节4（原始值，无信号定义）";
CM_ SG_ 2565932787 字节5 "字节5（原始值，无信号定义）";
CM_ SG_ 2565932787 字节6 "字节6（原始值，无信号定义）";
CM_ SG_ 2565932787 字节7 "字节7（原始值，无信号定义）";
