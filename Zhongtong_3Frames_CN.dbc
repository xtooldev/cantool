VERSION ""

NS_ :

BS_:

BU_: Vector__XXX

BA_DEF_ "BusType" STRING ;
BA_DEF_ BO_ "VFrameFormat" ENUM "StandardCAN","ExtendedCAN","reserved","J1939PG";
BA_DEF_ BO_ "GenMsgCycleTime" INT 0 60000;
BA_DEF_DEF_ "BusType" "CAN";
BA_DEF_DEF_ "VFrameFormat" 0;
BA_DEF_DEF_ "GenMsgCycleTime" 0;

BO_ 2550245277 ZT_AirPumpInv_1801A79D: 8 Vector__XXX
 SG_ 气泵输入欠压 : 56|1@1+ (1,0) [0|0] "" Vector__XXX
 SG_ 气泵输入过压 : 57|1@1+ (1,0) [0|0] "" Vector__XXX
 SG_ 气泵低压电源 : 58|1@1+ (1,0) [0|0] "" Vector__XXX
 SG_ 气泵温度过高 : 60|1@1+ (1,0) [0|0] "" Vector__XXX
 SG_ 气泵输出短路 : 61|1@1+ (1,0) [0|0] "" Vector__XXX
 SG_ 气泵输出过载 : 62|1@1+ (1,0) [0|0] "" Vector__XXX
 SG_ 气泵输出缺相 : 63|1@1+ (1,0) [0|0] "" Vector__XXX
 SG_ 气泵 DC/AC 散热器温度 : 48|8@1+ (1,-40) [-40|200] "deg C" Vector__XXX
 SG_ 气泵 DC/AC 输入电压 : 0|16@1+ (1,0) [0|1000] "V" Vector__XXX
 SG_ 气泵 DC/AC 输出电压 : 16|16@1+ (1,0) [0|1000] "V" Vector__XXX
 SG_ 气泵 DC/AC 输出电流 : 32|16@1+ (0.1,0) [0|100] "A" Vector__XXX
BA_ "VFrameFormat" BO_ 2550245277 1;
BA_ "GenMsgCycleTime" BO_ 2550245277 1000;
CM_ BO_ 2550245277 "气泵 DC/AC 逆变器（AIR）第 1 帧 | idm 0xB3000008";
CM_ SG_ 2550245277 气泵输入欠压 "气泵输入欠压 [枚举: 正常|故障]";
VAL_ 2550245277 气泵输入欠压 0 "正常" 1 "故障";
CM_ SG_ 2550245277 气泵输入过压 "气泵输入过压 [枚举: 正常|故障]";
VAL_ 2550245277 气泵输入过压 0 "正常" 1 "故障";
CM_ SG_ 2550245277 气泵低压电源 "气泵低压电源 [枚举: 正常|故障]";
VAL_ 2550245277 气泵低压电源 0 "正常" 1 "故障";
CM_ SG_ 2550245277 气泵温度过高 "气泵温度过高 [枚举: 正常|故障]";
VAL_ 2550245277 气泵温度过高 0 "正常" 1 "故障";
CM_ SG_ 2550245277 气泵输出短路 "气泵输出短路 [枚举: 正常|故障]";
VAL_ 2550245277 气泵输出短路 0 "正常" 1 "故障";
CM_ SG_ 2550245277 气泵输出过载 "气泵输出过载 [枚举: 正常|故障]";
VAL_ 2550245277 气泵输出过载 0 "正常" 1 "故障";
CM_ SG_ 2550245277 气泵输出缺相 "气泵输出缺相 [枚举: 正常|故障]";
VAL_ 2550245277 气泵输出缺相 0 "正常" 1 "故障";
CM_ SG_ 2550245277 气泵 DC/AC 散热器温度 "气泵 DC/AC 散热器温度";
CM_ SG_ 2550245277 气泵 DC/AC 输入电压 "气泵 DC/AC 输入电压";
CM_ SG_ 2550245277 气泵 DC/AC 输出电压 "气泵 DC/AC 输出电压";
CM_ SG_ 2550245277 气泵 DC/AC 输出电流 "气泵 DC/AC 输出电流";

BO_ 2550245275 ZT_OilPumpInv_1801A79B: 8 Vector__XXX
 SG_ 油泵输入欠压 : 56|1@1+ (1,0) [0|0] "" Vector__XXX
 SG_ 油泵输入过压 : 57|1@1+ (1,0) [0|0] "" Vector__XXX
 SG_ 油泵低压电源 : 58|1@1+ (1,0) [0|0] "" Vector__XXX
 SG_ 油泵温度过高 : 60|1@1+ (1,0) [0|0] "" Vector__XXX
 SG_ 油泵输出短路 : 61|1@1+ (1,0) [0|0] "" Vector__XXX
 SG_ 油泵输出过载 : 62|1@1+ (1,0) [0|0] "" Vector__XXX
 SG_ 油泵输出缺相 : 63|1@1+ (1,0) [0|0] "" Vector__XXX
 SG_ 油泵DC/AC 散热器温度 : 48|8@1+ (1,-40) [-40|210] "deg C" Vector__XXX
 SG_ 油泵DC/AC 输入电压 : 0|16@1+ (1,0) [0|1000] "V" Vector__XXX
 SG_ 油泵DC/AC 输出电压 : 16|16@1+ (1,0) [0|1000] "V" Vector__XXX
 SG_ 油泵DC/AC 输出电流 : 32|16@1+ (0.1,0) [0|100] "A" Vector__XXX
BA_ "VFrameFormat" BO_ 2550245275 1;
BA_ "GenMsgCycleTime" BO_ 2550245275 1000;
CM_ BO_ 2550245275 "油泵 DC/AC 逆变器（OIL）第 1 帧 | idm 0xB3000009";
CM_ SG_ 2550245275 油泵输入欠压 "油泵输入欠压 [枚举: 正常|故障]";
VAL_ 2550245275 油泵输入欠压 0 "正常" 1 "故障";
CM_ SG_ 2550245275 油泵输入过压 "油泵输入过压 [枚举: 正常|故障]";
VAL_ 2550245275 油泵输入过压 0 "正常" 1 "故障";
CM_ SG_ 2550245275 油泵低压电源 "油泵低压电源 [枚举: 正常|故障]";
VAL_ 2550245275 油泵低压电源 0 "正常" 1 "故障";
CM_ SG_ 2550245275 油泵温度过高 "油泵温度过高 [枚举: 正常|故障]";
VAL_ 2550245275 油泵温度过高 0 "正常" 1 "故障";
CM_ SG_ 2550245275 油泵输出短路 "油泵输出短路 [枚举: 正常|故障]";
VAL_ 2550245275 油泵输出短路 0 "正常" 1 "故障";
CM_ SG_ 2550245275 油泵输出过载 "油泵输出过载 [枚举: 正常|故障]";
VAL_ 2550245275 油泵输出过载 0 "正常" 1 "故障";
CM_ SG_ 2550245275 油泵输出缺相 "油泵输出缺相 [枚举: 正常|故障]";
VAL_ 2550245275 油泵输出缺相 0 "正常" 1 "故障";
CM_ SG_ 2550245275 油泵DC/AC 散热器温度 "油泵DC/AC 散热器温度";
CM_ SG_ 2550245275 油泵DC/AC 输入电压 "油泵DC/AC 输入电压";
CM_ SG_ 2550245275 油泵DC/AC 输出电压 "油泵DC/AC 输出电压";
CM_ SG_ 2550245275 油泵DC/AC 输出电流 "油泵DC/AC 输出电流";

BO_ 2550245274 ZT_DCDC_1801A79A: 8 Vector__XXX
 SG_ DCDC输入欠压 : 48|1@1+ (1,0) [0|0] "" Vector__XXX
 SG_ DCDC输入过压 : 49|1@1+ (1,0) [0|0] "" Vector__XXX
 SG_ DCDC输出状态 : 50|1@1+ (1,0) [0|0] "" Vector__XXX
 SG_ DCDC温度过高 : 52|1@1+ (1,0) [0|0] "" Vector__XXX
 SG_ DCDC短路 : 53|1@1+ (1,0) [0|0] "" Vector__XXX
 SG_ DC/DC输出电压 : 16|8@1+ (0.2,0) [0|50] "V" Vector__XXX
 SG_ DC/DC散热器温度 : 40|8@1+ (1,-40) [-40|210] "deg C" Vector__XXX
 SG_ DC/DC输入电压 : 0|16@1+ (1,0) [0|1000] "V" Vector__XXX
 SG_ DC/DC输出电流 : 24|16@1+ (0.01,0) [0|200] "A" Vector__XXX
BA_ "VFrameFormat" BO_ 2550245274 1;
BA_ "GenMsgCycleTime" BO_ 2550245274 10000;
CM_ BO_ 2550245274 "DCDC 直流变压器 第 1 帧 | idm 0xB3000006";
CM_ SG_ 2550245274 DCDC输入欠压 "DCDC输入欠压 [枚举: 正常|故障]";
VAL_ 2550245274 DCDC输入欠压 0 "正常" 1 "故障";
CM_ SG_ 2550245274 DCDC输入过压 "DCDC输入过压 [枚举: 正常|故障]";
VAL_ 2550245274 DCDC输入过压 0 "正常" 1 "故障";
CM_ SG_ 2550245274 DCDC输出状态 "DCDC输出状态 [枚举: 正常|故障]";
VAL_ 2550245274 DCDC输出状态 0 "正常" 1 "故障";
CM_ SG_ 2550245274 DCDC温度过高 "DCDC温度过高 [枚举: 正常|故障]";
VAL_ 2550245274 DCDC温度过高 0 "正常" 1 "故障";
CM_ SG_ 2550245274 DCDC短路 "DCDC短路 [枚举: 正常|故障]";
VAL_ 2550245274 DCDC短路 0 "正常" 1 "故障";
CM_ SG_ 2550245274 DC/DC输出电压 "DC/DC输出电压";
CM_ SG_ 2550245274 DC/DC散热器温度 "DC/DC散热器温度";
CM_ SG_ 2550245274 DC/DC输入电压 "DC/DC输入电压";
CM_ SG_ 2550245274 DC/DC输出电流 "DC/DC输出电流";
